; VICEROY.EXE Overlay Disassembly
; 99 functions, 3081 instructions
; Generated by disassemble_viceroy.py


======================================================================
FUNCTION 000 at overlay+0x01383 (file 0x219E8), 44 bytes
  Tags: structs:UnitRecord (28B)
======================================================================
  0x219E8: push     bp
  0x219E9: mov      bp, sp
  0x219EB: push     word ptr [bp + 6]
  0x219EE: lcall    0x181f, 0xb78
  0x219F3: mov      sp, bp
  0x219F5: or       ax, ax
  0x219F7: jl       0x21a00
  0x219F9: mov      bx, word ptr [bp + 8]
  0x219FC: mov      word ptr [bx], 1
  0x21A00: imul     bx, word ptr [bp + 6], 0x1c  ; × UnitRecord (28B)
  0x21A04: cmp      byte ptr [bx + 0x3146], 2
  0x21A09: jne      0x21a12
  0x21A0B: mov      bx, word ptr [bp + 0xa]
  0x21A0E: mov      word ptr [bx], 1
  0x21A12: leave    
  0x21A13: retf     

======================================================================
FUNCTION 001 at overlay+0x0180D (file 0x21E72), 72 bytes
======================================================================
  0x21E72: push     bp
  0x21E73: mov      bp, sp
  0x21E75: mov      ax, word ptr [bp + 6]
  0x21E78: or       ax, ax
  0x21E7A: jge      0x21e7e
  0x21E7C: sub      ax, ax
  0x21E7E: mov      word ptr [bp + 6], ax
  0x21E81: cmp      ax, 3
  0x21E84: jle      0x21e89
  0x21E86: mov      ax, 3
  0x21E89: mov      word ptr [bp + 6], ax
  0x21E8C: mov      word ptr [0x184], ax
  0x21E8F: lcall    0x191f, 0x18e
  0x21E94: push     0
  0x21E96: push     word ptr [0x853e]
  0x21E9A: push     word ptr [0x8540]
  0x21E9E: push     word ptr [0x853e]
  0x21EA2: push     word ptr [0x8540]
  0x21EA6: lcall    0x181f, 0x352
  0x21EAB: mov      sp, bp
  0x21EAD: or       ax, ax
  0x21EAF: jne      0x21eb8
  0x21EB1: push     1
  0x21EB3: lcall    0x181f, 0xe1c
  0x21EB8: leave    
  0x21EB9: retf     

======================================================================
FUNCTION 002 at overlay+0x03CBD (file 0x24322), 21 bytes
======================================================================
  0x24322: push     bp
  0x24323: mov      bp, sp
  0x24325: push     word ptr [0x83c]
  0x24329: push     word ptr [0x83a]
  0x2432D: mov      ax, word ptr [bp + 6]
  0x24330: lcall    0x191f, 0x468
  0x24335: leave    
  0x24336: retf     

======================================================================
FUNCTION 003 at overlay+0x05CD9 (file 0x2633E), 54 bytes
  Tags: globals:map_terrain
======================================================================
  0x2633E: push     bp
  0x2633F: mov      bp, sp
  0x26341: push     word ptr [0x83a4]
  0x26345: push     word ptr [0x83a2]
  0x26349: push     word ptr [0x83a0]
  0x2634D: push     word ptr [0x839e]
  0x26351: push     word ptr [0x2dae]
  0x26355: push     word ptr [0x2dac]
  0x26359: push     word ptr [0x2daa]
  0x2635D: push     word ptr [0x2da8]  ; map_terrain
  0x26361: push     word ptr [bp + 0xc]  ; PowerRecord.congress_progress
  0x26364: mov      ax, word ptr [bp + 6]
  0x26367: mov      dx, word ptr [bp + 8]
  0x2636A: mov      bx, word ptr [bp + 0xa]
  0x2636D: lcall    0x181f, 0x444
  0x26372: leave    
  0x26373: retf     

======================================================================
FUNCTION 004 at overlay+0x0771F (file 0x27D84), 46 bytes
======================================================================
  0x27D84: push     bp
  0x27D85: mov      bp, sp
  0x27D87: mov      ax, word ptr [bp + 6]
  0x27D8A: mov      cx, ax
  0x27D8C: shl      ax, 1
  0x27D8E: add      ax, cx
  0x27D90: shl      ax, 2
  0x27D93: add      ax, 0x7f
  0x27D96: mov      bx, word ptr [bp + 8]
  0x27D99: mov      word ptr [bx], ax
  0x27D9B: mov      bx, word ptr [bp + 0xa]
  0x27D9E: mov      word ptr [bx], 0xa5
  0x27DA2: mov      bx, word ptr [bp + 0xc]  ; PowerRecord.congress_progress
  0x27DA5: mov      word ptr [bx], 0xa
  0x27DA9: mov      bx, word ptr [bp + 0xe]  ; PowerRecord.liberty_bells
  0x27DAC: mov      word ptr [bx], 0x16
  0x27DB0: leave    
  0x27DB1: retf     

======================================================================
FUNCTION 005 at overlay+0x07AE7 (file 0x2814C), 82 bytes
======================================================================
  0x2814C: push     bp
  0x2814D: mov      bp, sp
  0x2814F: push     0x30
  0x28151: push     0x5b
  0x28153: push     0x82
  0x28156: push     0xd3
  0x28159: push     cs
  0x2815A: call     0x2cac3
  0x2815D: mov      sp, bp
  0x2815F: mov      al, byte ptr [0x337]
  0x28162: sub      ah, ah
  0x28164: jmp      0x28178
  0x28166: push     cs
  0x28167: call     0x2c9b0
  0x2816A: jmp      0x28182
  0x2816C: push     cs
  0x2816D: call     0x2ca50
  0x28170: jmp      0x28182
  0x28172: push     cs
  0x28173: call     0x2caa0
  0x28176: jmp      0x28182
  0x28178: or       ax, ax
  0x2817A: je       0x28166
  0x2817C: dec      ax
  0x2817D: je       0x2816c
  0x2817F: dec      ax
  0x28180: je       0x28172
  0x28182: cmp      word ptr [bp + 6], 0
  0x28186: je       0x2819c
  0x28188: push     0x82
  0x2818B: push     0x5b
  0x2818D: push     0x30
  0x2818F: mov      ax, 0xd3
  0x28192: mov      dx, 0x82
  0x28195: mov      bx, ax
  0x28197: lcall    0x181f, 0xe2
  0x2819C: leave    
  0x2819D: retf     

======================================================================
FUNCTION 006 at overlay+0x07DC7 (file 0x2842C), 9 bytes
======================================================================
  0x2842C: push     bp
  0x2842D: mov      bp, sp
  0x2842F: push     si
  0x28430: mov      bx, word ptr [bp + 8]
  0x28433: mov      ax, bx

======================================================================
FUNCTION 007 at overlay+0x07F2D (file 0x28592), 124 bytes
======================================================================
  0x28592: push     bp
  0x28593: mov      bp, sp
  0x28595: lcall    0x181f, 0xc22
  0x2859A: push     cs
  0x2859B: call     0x2ca5a
  0x2859E: push     cs
  0x2859F: call     0x2cacd
  0x285A2: push     0xc8
  0x285A5: push     0x140
  0x285A8: push     0
  0x285AA: push     0
  0x285AC: push     cs
  0x285AD: call     0x2cac3
  0x285B0: mov      sp, bp
  0x285B2: push     0
  0x285B4: push     cs
  0x285B5: call     0x2cae6
  0x285B8: mov      sp, bp
  0x285BA: push     0
  0x285BC: push     cs
  0x285BD: call     0x2c9a1
  0x285C0: mov      sp, bp
  0x285C2: push     0
  0x285C4: push     cs
  0x285C5: call     0x2c9dd
  0x285C8: mov      sp, bp
  0x285CA: push     0
  0x285CC: push     cs
  0x285CD: call     0x2ca19
  0x285D0: mov      sp, bp
  0x285D2: push     0
  0x285D4: push     0
  0x285D6: push     cs
  0x285D7: call     0x2c9e7
  0x285DA: mov      sp, bp
  0x285DC: push     0
  0x285DE: push     cs
  0x285DF: call     0x2c9fb
  0x285E2: mov      sp, bp
  0x285E4: push     0
  0x285E6: push     cs
  0x285E7: call     0x2c983
  0x285EA: mov      sp, bp
  0x285EC: push     0
  0x285EE: push     cs
  0x285EF: call     0x2c97e
  0x285F2: mov      sp, bp
  0x285F4: cmp      word ptr [bp + 6], 0
  0x285F8: je       0x2860c
  0x285FA: push     0
  0x285FC: push     0x140
  0x285FF: push     0xc8
  0x28602: sub      ax, ax
  0x28604: cdq      
  0x28605: sub      bx, bx
  0x28607: lcall    0x181f, 0xe2
  0x2860C: leave    
  0x2860D: retf     

======================================================================
FUNCTION 008 at overlay+0x0812D (file 0x28792), 32 bytes
======================================================================
  0x28792: push     bp
  0x28793: mov      bp, sp
  0x28795: push     word ptr [bp + 0xa]
  0x28798: push     word ptr [bp + 8]
  0x2879B: push     word ptr [bp + 6]
  0x2879E: lcall    0x181f, 0x92
  0x287A3: mov      sp, bp
  0x287A5: push     0
  0x287A7: push     0
  0x287A9: push     1
  0x287AB: lcall    0x181f, 0xb0
  0x287B0: leave    
  0x287B1: retf     

======================================================================
FUNCTION 009 at overlay+0x0814D (file 0x287B2), 19 bytes
======================================================================
  0x287B2: push     bp
  0x287B3: mov      bp, sp
  0x287B5: mov      bx, word ptr [bp + 6]
  0x287B8: shl      bx, 1
  0x287BA: push     word ptr [bx - 0x6c4e]
  0x287BE: lcall    0x181f, 0x74
  0x287C3: leave    
  0x287C4: retf     

======================================================================
FUNCTION 010 at overlay+0x08161 (file 0x287C6), 32 bytes
======================================================================
  0x287C6: push     bp
  0x287C7: mov      bp, sp
  0x287C9: push     1
  0x287CB: lcall    0x181f, 0x56
  0x287D0: mov      sp, bp
  0x287D2: push     word ptr [bp + 6]
  0x287D5: push     cs
  0x287D6: call     0x2cab9
  0x287D9: mov      sp, bp
  0x287DB: push     word ptr [bp + 0xa]
  0x287DE: push     word ptr [bp + 8]
  0x287E1: push     3
  0x287E3: push     cs

======================================================================
FUNCTION 011 at overlay+0x08185 (file 0x287EA), 60 bytes
======================================================================
  0x287EA: push     bp
  0x287EB: mov      bp, sp
  0x287ED: push     1
  0x287EF: lcall    0x181f, 0x56
  0x287F4: mov      sp, bp
  0x287F6: cmp      word ptr [bp + 0xa], 0
  0x287FA: je       0x28800
  0x287FC: push     0xf
  0x287FE: jmp      0x28802
  0x28800: push     0x10
  0x28802: push     cs
  0x28803: call     0x2cab9
  0x28806: add      sp, 2
  0x28809: mov      bx, word ptr [bp + 6]
  0x2880C: shl      bx, 1
  0x2880E: push     word ptr [bx - 0x6840]
  0x28812: lcall    0x181f, 0x74
  0x28817: add      sp, 2
  0x2881A: push     0
  0x2881C: push     0
  0x2881E: push     1
  0x28820: push     cs
  0x28821: call     0x2caaa
  0x28824: leave    
  0x28825: retf     

======================================================================
FUNCTION 012 at overlay+0x081C1 (file 0x28826), 23 bytes
======================================================================
  0x28826: push     bp
  0x28827: mov      bp, sp
  0x28829: mov      word ptr [0xbb8], 1
  0x2882F: mov      ax, word ptr [bp + 6]
  0x28832: mov      word ptr [0x9cce], ax
  0x28835: mov      ax, word ptr [bp + 8]
  0x28838: mov      word ptr [0x9cd0], ax
  0x2883B: leave    
  0x2883C: retf     

======================================================================
FUNCTION 013 at overlay+0x0951F (file 0x29B84), 57 bytes
======================================================================
  0x29B84: push     bp
  0x29B85: mov      bp, sp
  0x29B87: push     word ptr [0x840]
  0x29B8B: push     word ptr [0x83e]
  0x29B8F: push     word ptr [bp + 6]
  0x29B92: lcall    0x181f, 0xa74
  0x29B97: add      sp, 2
  0x29B9A: mov      dx, 1
  0x29B9D: lcall    0x191f, 0x8f8
  0x29BA2: mov      word ptr [0x344], 1
  0x29BA8: mov      word ptr [0x8d54], 6
  0x29BAE: mov      ax, word ptr [bp + 6]
  0x29BB1: mov      word ptr [0x8d7c], ax
  0x29BB4: mov      word ptr [0x8d7e], ax
  0x29BB7: push     cs
  0x29BB8: call     0x2ca78
  0x29BBB: leave    
  0x29BBC: retf     

======================================================================
FUNCTION 014 at overlay+0x0E4B7 (file 0x2EB1C), 42 bytes
  Tags: structs:ColonyRecord (202B)
======================================================================
  0x2EB1C: push     bp
  0x2EB1D: mov      bp, sp
  0x2EB1F: push     si
  0x2EB20: imul     bx, word ptr [bp + 6], 0xca  ; × ColonyRecord (202B)
  0x2EB25: mov      al, byte ptr [bx + 0x5d65]
  0x2EB29: add      bx, word ptr [bp + 8]
  0x2EB2C: mov      byte ptr [bx + 0x5e00], al
  0x2EB30: push     0
  0x2EB32: push     word ptr [bp + 6]
  0x2EB35: mov      si, bx
  0x2EB37: lcall    0x181f, 0xb14
  0x2EB3C: add      sp, 4
  0x2EB3F: mov      byte ptr [si + 0x5e04], al
  0x2EB43: pop      si
  0x2EB44: leave    
  0x2EB45: retf     

======================================================================
FUNCTION 015 at overlay+0x0E4E1 (file 0x2EB46), 43 bytes
  Tags: structs:ColonyRecord (202B), globals:colony_table
======================================================================
  0x2EB46: push     bp
  0x2EB47: mov      bp, sp
  0x2EB49: push     si
  0x2EB4A: mov      al, byte ptr [bp + 8]
  0x2EB4D: imul     bx, word ptr [bp + 6], 0xca  ; × ColonyRecord (202B)
  0x2EB52: cmp      byte ptr [bx + 0x5d60], al  ; colony_table
  0x2EB56: je       0x2eb6b
  0x2EB58: cmp      word ptr [0x53a2], 0
  0x2EB5D: jne      0x2eb6b
  0x2EB5F: mov      si, bx
  0x2EB61: mov      bx, word ptr [bp + 8]
  0x2EB64: cmp      byte ptr [bx + si + 0x5e00], 0
  0x2EB69: je       0x2eb72
  0x2EB6B: mov      ax, 1
  0x2EB6E: pop      si
  0x2EB6F: leave    
  0x2EB70: retf     

======================================================================
FUNCTION 016 at overlay+0x0FEEB (file 0x30550), 21 bytes
  Tags: structs:PowerRecord (316B)
======================================================================
  0x30550: push     bp
  0x30551: mov      bp, sp
  0x30553: mov      ax, word ptr [bp + 6]
  0x30556: mov      word ptr [0x9e12], ax
  0x30559: imul     ax, ax, 0x13c  ; × PowerRecord (316B)
  0x3055D: add      ax, 0x8808
  0x30560: mov      word ptr [0x84fc], ax
  0x30563: leave    
  0x30564: retf     

======================================================================
FUNCTION 017 at overlay+0x104D3 (file 0x30B38), 20 bytes
======================================================================
  0x30B38: push     bp
  0x30B39: mov      bp, sp
  0x30B3B: mov      ax, 1
  0x30B3E: mov      cl, byte ptr [bp + 6]
  0x30B41: shl      ax, cl
  0x30B43: mov      bx, word ptr [0x84fc]
  0x30B47: and      ax, word ptr [bx + 0x20]
  0x30B4A: leave    
  0x30B4B: retf     

======================================================================
FUNCTION 018 at overlay+0x10721 (file 0x30D86), 54 bytes
  Tags: globals:map_terrain
======================================================================
  0x30D86: push     bp
  0x30D87: mov      bp, sp
  0x30D89: push     word ptr [0x83a4]
  0x30D8D: push     word ptr [0x83a2]
  0x30D91: push     word ptr [0x83a0]
  0x30D95: push     word ptr [0x839e]
  0x30D99: push     word ptr [0x2dae]
  0x30D9D: push     word ptr [0x2dac]
  0x30DA1: push     word ptr [0x2daa]
  0x30DA5: push     word ptr [0x2da8]  ; map_terrain
  0x30DA9: push     word ptr [bp + 0xc]  ; PowerRecord.congress_progress
  0x30DAC: mov      ax, word ptr [bp + 6]
  0x30DAF: mov      dx, word ptr [bp + 8]
  0x30DB2: mov      bx, word ptr [bp + 0xa]
  0x30DB5: lcall    0x181f, 0x444
  0x30DBA: leave    
  0x30DBB: retf     

======================================================================
FUNCTION 019 at overlay+0x10E49 (file 0x314AE), 46 bytes
======================================================================
  0x314AE: push     bp
  0x314AF: mov      bp, sp
  0x314B1: mov      ax, word ptr [bp + 6]
  0x314B4: mov      cx, ax
  0x314B6: shl      ax, 1
  0x314B8: add      ax, cx
  0x314BA: shl      ax, 2
  0x314BD: add      ax, 0x93
  0x314C0: mov      bx, word ptr [bp + 8]
  0x314C3: mov      word ptr [bx], ax
  0x314C5: mov      bx, word ptr [bp + 0xa]
  0x314C8: mov      word ptr [bx], 0xa5
  0x314CC: mov      bx, word ptr [bp + 0xc]  ; PowerRecord.congress_progress
  0x314CF: mov      word ptr [bx], 0xa
  0x314D3: mov      bx, word ptr [bp + 0xe]  ; PowerRecord.liberty_bells
  0x314D6: mov      word ptr [bx], 0xc
  0x314DA: leave    
  0x314DB: retf     

======================================================================
FUNCTION 020 at overlay+0x11341 (file 0x319A6), 21 bytes
======================================================================
  0x319A6: push     bp
  0x319A7: mov      bp, sp
  0x319A9: push     word ptr [bp + 6]
  0x319AC: push     cs
  0x319AD: call     0x3690d
  0x319B0: mov      sp, bp
  0x319B2: push     word ptr [bp + 6]
  0x319B5: push     cs
  0x319B6: call     0x3695d
  0x319B9: leave    
  0x319BA: retf     

======================================================================
FUNCTION 021 at overlay+0x118C3 (file 0x31F28), 32 bytes
======================================================================
  0x31F28: push     bp
  0x31F29: mov      bp, sp
  0x31F2B: push     word ptr [bp + 0xa]
  0x31F2E: push     word ptr [bp + 8]
  0x31F31: push     word ptr [bp + 6]
  0x31F34: lcall    0x181f, 0x92
  0x31F39: mov      sp, bp
  0x31F3B: push     0
  0x31F3D: push     0
  0x31F3F: push     1
  0x31F41: lcall    0x181f, 0xb0
  0x31F46: leave    
  0x31F47: retf     

======================================================================
FUNCTION 022 at overlay+0x118E3 (file 0x31F48), 19 bytes
======================================================================
  0x31F48: push     bp
  0x31F49: mov      bp, sp
  0x31F4B: mov      bx, word ptr [bp + 6]
  0x31F4E: shl      bx, 1
  0x31F50: push     word ptr [bx - 0x6c4e]
  0x31F54: lcall    0x181f, 0x74
  0x31F59: leave    
  0x31F5A: retf     

======================================================================
FUNCTION 023 at overlay+0x118F7 (file 0x31F5C), 32 bytes
======================================================================
  0x31F5C: push     bp
  0x31F5D: mov      bp, sp
  0x31F5F: push     1
  0x31F61: lcall    0x181f, 0x56
  0x31F66: mov      sp, bp
  0x31F68: push     word ptr [bp + 6]
  0x31F6B: push     cs
  0x31F6C: call     0x36854
  0x31F6F: mov      sp, bp
  0x31F71: push     word ptr [bp + 0xa]
  0x31F74: push     word ptr [bp + 8]
  0x31F77: push     3
  0x31F79: push     cs

======================================================================
FUNCTION 024 at overlay+0x1191B (file 0x31F80), 87 bytes
======================================================================
  0x31F80: push     bp
  0x31F81: mov      bp, sp
  0x31F83: push     1
  0x31F85: lcall    0x181f, 0x56
  0x31F8A: mov      sp, bp
  0x31F8C: cmp      word ptr [bp + 0xa], 0
  0x31F90: je       0x31f96
  0x31F92: push     0xd
  0x31F94: jmp      0x31f98
  0x31F96: push     0xe
  0x31F98: push     cs
  0x31F99: call     0x36854
  0x31F9C: add      sp, 2
  0x31F9F: mov      bx, word ptr [bp + 6]
  0x31FA2: shl      bx, 1
  0x31FA4: push     word ptr [bx - 0x6840]
  0x31FA8: lcall    0x181f, 0x74
  0x31FAD: add      sp, 2
  0x31FB0: push     0xc
  0x31FB2: push     cs
  0x31FB3: call     0x36854
  0x31FB6: add      sp, 2
  0x31FB9: mov      ax, word ptr [bp + 0xc]  ; PowerRecord.congress_progress
  0x31FBC: imul     word ptr [bp + 8]
  0x31FBF: push     ax
  0x31FC0: lcall    0x181f, 0x7e
  0x31FC5: add      sp, 2
  0x31FC8: push     word ptr [0x93a0]
  0x31FCC: lcall    0x181f, 0x74
  0x31FD1: add      sp, 2
  0x31FD4: push     ds

======================================================================
FUNCTION 025 at overlay+0x11ABD (file 0x32122), 43 bytes
  Tags: structs:UnitRecord (28B)
======================================================================
  0x32122: push     bp
  0x32123: mov      bp, sp
  0x32125: push     1
  0x32127: lcall    0x181f, 0x56
  0x3212C: mov      sp, bp
  0x3212E: push     word ptr [0x9e12]
  0x32132: lcall    0x181f, 0x9a4
  0x32137: mov      sp, bp
  0x32139: push     ax
  0x3213A: lcall    0x181f, 0x74
  0x3213F: mov      sp, bp
  0x32141: imul     bx, word ptr [bp + 6], 0x1c  ; × UnitRecord (28B)
  0x32145: mov      bl, byte ptr [bx + 0x3146]
  0x32149: sub      bh, bh
  0x3214B: mov      ax, bx

======================================================================
FUNCTION 026 at overlay+0x16D65 (file 0x373CA), 68 bytes
  Tags: globals:map_terrain
======================================================================
  0x373CA: push     bp
  0x373CB: mov      bp, sp
  0x373CD: cmp      word ptr [bp + 8], 0
  0x373D1: jge      0x373d8
  0x373D3: mov      word ptr [bp + 8], 0xb8
  0x373D8: cmp      word ptr [bp + 6], -1
  0x373DC: jne      0x373e3
  0x373DE: mov      word ptr [bp + 6], 0x91
  0x373E3: cmp      word ptr [bp + 6], -2
  0x373E7: jne      0x373ee
  0x373E9: mov      word ptr [bp + 6], 0x11e
  0x373EE: push     word ptr [0x2dae]
  0x373F2: push     word ptr [0x2dac]
  0x373F6: push     word ptr [0x2daa]
  0x373FA: push     word ptr [0x2da8]  ; map_terrain
  0x373FE: mov      ax, word ptr [bp + 8]
  0x37401: add      ax, 0xd
  0x37404: push     ax
  0x37405: push     0x77
  0x37407: mov      ax, word ptr [bp + 6]
  0x3740A: mov      bx, ax

======================================================================
FUNCTION 027 at overlay+0x19833 (file 0x39E98), 73 bytes
  Tags: globals:map_terrain
======================================================================
  0x39E98: push     bp
  0x39E99: mov      bp, sp
  0x39E9B: add      word ptr [0x2d0e], 8
  0x39EA0: cmp      word ptr [0x2d0e], 0x124
  0x39EA6: jl       0x39ebb
  0x39EA8: add      word ptr [0x2d10], 8
  0x39EAD: mov      al, byte ptr [0x2d0e]
  0x39EB0: and      ax, 8
  0x39EB3: sar      ax, 1
  0x39EB5: add      ax, 0x10
  0x39EB8: mov      word ptr [0x2d0e], ax
  0x39EBB: cmp      word ptr [0x2d10], 0x90
  0x39EC1: jge      0x39edf
  0x39EC3: push     word ptr [0x840]
  0x39EC7: push     word ptr [0x83e]
  0x39ECB: push     word ptr [0x2d10]
  0x39ECF: mov      ax, word ptr [bp + 4]
  0x39ED2: lea      bx, [0x2da8]  ; map_terrain
  0x39ED6: mov      dx, word ptr [0x2d0e]
  0x39EDA: lcall    0x181f, 0x254
  0x39EDF: leave    
  0x39EE0: ret      

======================================================================
FUNCTION 028 at overlay+0x1B2D7 (file 0x3B93C), 24 bytes
======================================================================
  0x3B93C: push     bp
  0x3B93D: mov      bp, sp
  0x3B93F: push     word ptr [bp + 8]
  0x3B942: push     word ptr [bp + 6]
  0x3B945: lcall    0x181f, 0x7b4
  0x3B94A: mov      sp, bp
  0x3B94C: or       ax, ax
  0x3B94E: je       0x3b954
  0x3B950: sub      ax, ax
  0x3B952: leave    
  0x3B953: retf     

======================================================================
FUNCTION 029 at overlay+0x1BCBD (file 0x3C322), 207 bytes
======================================================================
  0x3C322: push     bp
  0x3C323: mov      bp, sp
  0x3C325: push     word ptr [bp + 6]
  0x3C328: lcall    0x181f, 0x582
  0x3C32D: mov      sp, bp
  0x3C32F: mov      ax, word ptr [bp + 8]
  0x3C332: mov      bx, word ptr [0x84fc]
  0x3C336: add      word ptr [bx + 0xc], ax  ; PowerRecord.congress_progress
  0x3C339: add      word ptr [bx + 0xe], ax  ; PowerRecord.liberty_bells
  0x3C33C: test     byte ptr [0x5382], 1
  0x3C341: jne      0x3c352
  0x3C343: cmp      word ptr [bx + 0x12], 0
  0x3C347: jge      0x3c352
  0x3C349: push     word ptr [bp + 6]
  0x3C34C: push     cs
  0x3C34D: call     0x3c401
  0x3C350: mov      sp, bp
  0x3C352: test     byte ptr [0x5382], 1
  0x3C357: je       0x3c3ad
  0x3C359: test     byte ptr [0x5382], 6
  0x3C35E: jne      0x3c3ad
  0x3C360: mov      ax, word ptr [bp + 8]
  0x3C363: mov      bx, word ptr [0x84fc]
  0x3C367: cmp      word ptr [bx + 0xc], ax  ; PowerRecord.congress_progress
  0x3C36A: jle      0x3c3ad
  0x3C36C: push     word ptr [0x53d4]
  0x3C370: push     1
  0x3C372: push     0
  0x3C374: lcall    0x191f, 0xac8
  0x3C379: mov      sp, bp
  0x3C37B: push     word ptr [bp + 6]
  0x3C37E: push     cs
  0x3C37F: call     0x3c3f2
  0x3C382: mov      sp, bp
  0x3C384: cdq      
  0x3C385: push     dx
  0x3C386: push     ax
  0x3C387: push     0
  0x3C389: lcall    0x181f, 0x9ae
  0x3C38E: mov      sp, bp
  0x3C390: push     1
  0x3C392: push     0x126f
  0x3C395: lcall    0x181f, 0x652
  0x3C39A: mov      sp, bp
  0x3C39C: push     1
  0x3C39E: push     0x127a
  0x3C3A1: lcall    0x181f, 0x652
  0x3C3A6: mov      sp, bp
  0x3C3A8: or       byte ptr [0x5382], 4
  0x3C3AD: push     word ptr [bp + 6]
  0x3C3B0: push     cs
  0x3C3B1: call     0x3c3f2
  0x3C3B4: mov      sp, bp
  0x3C3B6: mov      bx, word ptr [0x84fc]
  0x3C3BA: cmp      ax, word ptr [bx + 0xc]  ; PowerRecord.congress_progress
  0x3C3BD: jg       0x3c3ef
  0x3C3BF: test     byte ptr [0x5382], 1
  0x3C3C4: je       0x3c3d4
  0x3C3C6: test     byte ptr [0x5382], 2
  0x3C3CB: jne      0x3c3ef
  0x3C3CD: lcall    0x191f, 0x348
  0x3C3D2: jmp      0x3c3e6
  0x3C3D4: cmp      word ptr [bx + 0x12], 0
  0x3C3D8: jl       0x3c3e6
  0x3C3DA: push     0
  0x3C3DC: push     word ptr [bx + 0x12]
  0x3C3DF: push     word ptr [bp + 6]
  0x3C3E2: push     cs
  0x3C3E3: call     0x3c3fc
  0x3C3E6: mov      bx, word ptr [0x84fc]
  0x3C3EA: mov      word ptr [bx + 0xc], 0  ; PowerRecord.congress_progress
  0x3C3EF: leave    
  0x3C3F0: retf     

======================================================================
FUNCTION 030 at overlay+0x1F2A9 (file 0x3F90E), 50 bytes
  Tags: structs:UnitRecord (28B)
======================================================================
  0x3F90E: push     bp
  0x3F90F: mov      bp, sp
  0x3F911: push     si
  0x3F912: mov      bx, word ptr [bp + 8]
  0x3F915: mov      al, byte ptr [bx + 0xbe]
  0x3F919: cwde     
  0x3F91A: imul     si, word ptr [bp + 6], 0x1c  ; × UnitRecord (28B)
  0x3F91E: mov      cl, byte ptr [si + 0x3145]
  0x3F922: sub      ch, ch
  0x3F924: add      ax, cx
  0x3F926: push     ax
  0x3F927: mov      al, byte ptr [bx + 0xb4]
  0x3F92B: cwde     
  0x3F92C: mov      cl, byte ptr [si + 0x3144]
  0x3F930: add      cx, ax
  0x3F932: push     cx
  0x3F933: push     word ptr [bp + 6]
  0x3F936: push     cs
  0x3F937: call     0x3f940
  0x3F93A: add      sp, 6
  0x3F93D: pop      si
  0x3F93E: leave    
  0x3F93F: retf     

======================================================================
FUNCTION 031 at overlay+0x1F99D (file 0x40002), 42 bytes
======================================================================
  0x40002: push     bp
  0x40003: mov      bp, sp
  0x40005: mov      word ptr [0x5372], 0
  0x4000B: mov      al, byte ptr [bp + 6]
  0x4000E: mov      byte ptr [0x5374], al
  0x40011: mov      al, byte ptr [bp + 8]
  0x40014: mov      byte ptr [0x5377], al
  0x40017: mov      byte ptr [0x5378], al
  0x4001A: sub      al, al
  0x4001C: mov      byte ptr [0x5379], al
  0x4001F: mov      byte ptr [0x5376], al
  0x40022: mov      byte ptr [0x537d], al
  0x40025: mov      byte ptr [0x537b], 1
  0x4002A: leave    
  0x4002B: retf     

======================================================================
FUNCTION 032 at overlay+0x1FFA3 (file 0x40608), 78 bytes
  Tags: structs:UnitRecord (28B),AIPersonality (52B), globals:ai_personality
======================================================================
  0x40608: push     bp
  0x40609: mov      bp, sp
  0x4060B: imul     bx, word ptr [bp + 6], 0x1c  ; × UnitRecord (28B)
  0x4060F: sub      byte ptr [bx + 0x3159], 0x14
  0x40614: cmp      byte ptr [bx + 0x3159], 0x14
  0x40619: jae      0x40654
  0x4061B: sub      al, al
  0x4061D: mov      byte ptr [bx + 0x3159], al
  0x40621: mov      byte ptr [bx + 0x3146], al
  0x40625: cmp      byte ptr [bx + 0x315b], 0x18
  0x4062A: jne      0x40631
  0x4062C: mov      byte ptr [bx + 0x3146], 3
  0x40631: imul     bx, word ptr [bp + 6], 0x1c  ; × UnitRecord (28B)
  0x40635: mov      al, byte ptr [bx + 0x3147]
  0x40639: and      al, 0xf
  0x4063B: cmp      al, 4
  0x4063D: jae      0x40654
  0x4063F: sub      ah, ah
  0x40641: imul     bx, ax, 0x34  ; × AIPersonality (52B)
  0x40644: cmp      byte ptr [bx + 0x543f], ah  ; ai_personality
  0x40648: jne      0x40654
  0x4064A: push     3
  0x4064C: push     0x145a
  0x4064F: lcall    0x181f, 0x652
  0x40654: leave    
  0x40655: retf     

======================================================================
FUNCTION 033 at overlay+0x228BB (file 0x42F20), 56 bytes
======================================================================
  0x42F20: push     bp
  0x42F21: mov      bp, sp
  0x42F23: push     word ptr [bp + 0xa]
  0x42F26: push     word ptr [bp + 8]
  0x42F29: lcall    0x181f, 0x302
  0x42F2E: mov      sp, bp
  0x42F30: or       ax, ax
  0x42F32: jne      0x42f5e
  0x42F34: cmp      word ptr [bp + 0xc], ax  ; PowerRecord.congress_progress
  0x42F37: jl       0x42f58
  0x42F39: mov      al, byte ptr [bp + 0xc]  ; PowerRecord.congress_progress
  0x42F3C: sub      al, byte ptr [bp + 8]
  0x42F3F: cmp      al, 0x14
  0x42F41: jne      0x42f58
  0x42F43: mov      bx, word ptr [bp + 0xc]  ; PowerRecord.congress_progress
  0x42F46: shl      bx, 1
  0x42F48: push     word ptr [bx - 0x7c74]
  0x42F4C: push     word ptr [bp + 6]
  0x42F4F: lcall    0x181f, 0x16e
  0x42F54: mov      sp, bp
  0x42F56: leave    
  0x42F57: retf     

======================================================================
FUNCTION 034 at overlay+0x23EDB (file 0x44540), 19 bytes
======================================================================
  0x44540: push     bp
  0x44541: mov      bp, sp
  0x44543: les      bx, ptr [bp + 4]
  0x44546: mov      bl, byte ptr es:[bx]
  0x44549: sub      bh, bh
  0x4454B: cmp      bx, 6
  0x4454E: jne      0x44551
  0x44550: dec      bx
  0x44551: mov      ax, bx

======================================================================
FUNCTION 035 at overlay+0x23EF1 (file 0x44556), 52 bytes
======================================================================
  0x44556: push     bp
  0x44557: mov      bp, sp
  0x44559: mov      bx, word ptr [bp + 6]
  0x4455C: mov      ax, word ptr [bp + 0xe]  ; PowerRecord.liberty_bells
  0x4455F: mov      es, word ptr [bp + 8]
  0x44562: mov      word ptr es:[bx], ax
  0x44565: mov      ax, word ptr [bp + 0x10]  ; PowerRecord.crosses
  0x44568: mov      word ptr es:[bx + 2], ax
  0x4456C: mov      ax, word ptr [bp + 0x12]
  0x4456F: mov      word ptr es:[bx + 4], ax
  0x44573: mov      ax, word ptr [bp + 0x14]  ; PowerRecord.founding_fathers_count
  0x44576: mov      word ptr es:[bx + 6], ax
  0x4457A: mov      ax, word ptr [bp + 0xa]
  0x4457D: mov      dx, word ptr [bp + 0xc]  ; PowerRecord.congress_progress
  0x44580: mov      word ptr es:[bx + 8], ax
  0x44584: mov      word ptr es:[bx + 0xa], dx
  0x44588: leave    
  0x44589: retf     

======================================================================
FUNCTION 036 at overlay+0x23F25 (file 0x4458A), 186 bytes
======================================================================
  0x4458A: push     bp
  0x4458B: mov      bp, sp
  0x4458D: push     ax
  0x4458E: cmp      word ptr [0x14ba], 0
  0x44593: je       0x445ce
  0x44595: cmp      byte ptr [bp + 0xa], 7
  0x44599: jne      0x445ce
  0x4459B: push     word ptr [bp + 0xe]  ; PowerRecord.liberty_bells
  0x4459E: push     word ptr [bp + 0x10]  ; PowerRecord.crosses
  0x445A1: push     word ptr [bp + 0x12]
  0x445A4: push     bx
  0x445A5: push     dx
  0x445A6: push     ax
  0x445A7: mov      bx, word ptr [0x14ba]
  0x445AB: push     word ptr [bx + 6]
  0x445AE: push     word ptr [bx + 4]
  0x445B1: push     word ptr [bx + 2]
  0x445B4: push     word ptr [bx]
  0x445B6: push     word ptr [bp + 0x1a]
  0x445B9: push     word ptr [bp + 0x18]
  0x445BC: push     word ptr [bp + 0x16]
  0x445BF: push     word ptr [bp + 0x14]  ; PowerRecord.founding_fathers_count
  0x445C2: lcall    0x181f, 0xc4
  0x445C7: add      sp, 0x1c
  0x445CA: leave    
  0x445CB: ret      0x18
  0x445CE: push     word ptr [bp + 0x1a]
  0x445D1: push     word ptr [bp + 0x18]
  0x445D4: push     word ptr [bp + 0x16]
  0x445D7: push     word ptr [bp + 0x14]  ; PowerRecord.founding_fathers_count
  0x445DA: push     word ptr [bp + 0x12]
  0x445DD: mov      al, byte ptr [bp + 0xa]
  0x445E0: push     ax
  0x445E1: mov      ax, word ptr [bp - 2]
  0x445E4: lcall    0x181f, 0xba
  0x445E9: leave    
  0x445EA: ret      0x18
  0x445ED: nop      
  0x445EE: enter    0x50, 0
  0x445F2: push     si
  0x445F3: push     word ptr [bp + 0xc]  ; PowerRecord.congress_progress
  0x445F6: push     word ptr [bp + 0xa]
  0x445F9: lea      ax, [bp - 0x50]
  0x445FC: push     ss
  0x445FD: push     ax
  0x445FE: lcall    0xd1d, 0x117e
  0x44603: add      sp, 8
  0x44606: push     0x7e
  0x44608: lea      ax, [bp - 0x50]
  0x4460B: push     ax
  0x4460C: lcall    0xd1d, 0xc56
  0x44611: add      sp, 4
  0x44614: mov      si, ax
  0x44616: or       si, si
  0x44618: je       0x44629
  0x4461A: lea      ax, [si + 1]
  0x4461D: push     ds
  0x4461E: push     ax
  0x4461F: push     ds
  0x44620: push     si
  0x44621: lcall    0xd1d, 0x117e
  0x44626: add      sp, 8
  0x44629: les      bx, ptr [bp + 6]
  0x4462C: push     word ptr es:[bx + 0xa]
  0x44630: push     word ptr es:[bx + 8]
  0x44634: lea      ax, [bp - 0x50]
  0x44637: push     ss
  0x44638: push     ax
  0x44639: mov      ax, word ptr es:[bx]
  0x4463C: lcall    0x181f, 0x204
  0x44641: pop      si
  0x44642: leave    
  0x44643: retf     

======================================================================
FUNCTION 037 at overlay+0x2572D (file 0x45D92), 95 bytes
  Tags: structs:AIPersonality (52B), globals:ai_personality
======================================================================
  0x45D92: push     bp
  0x45D93: mov      bp, sp
  0x45D95: cmp      word ptr [bp + 0xa], 4
  0x45D99: jge      0x45dd2
  0x45D9B: imul     bx, word ptr [bp + 0xa], 0x34  ; × AIPersonality (52B)
  0x45D9F: cmp      byte ptr [bx + 0x543f], 0  ; ai_personality
  0x45DA4: jne      0x45dd2
  0x45DA6: cmp      word ptr [bp + 6], 0
  0x45DAA: je       0x45dd2
  0x45DAC: mov      ax, word ptr [bp + 8]
  0x45DAF: add      ax, 4
  0x45DB2: push     ax
  0x45DB3: lcall    0x181f, 0xa1a
  0x45DB8: mov      sp, bp
  0x45DBA: push     ax
  0x45DBB: push     0
  0x45DBD: lcall    0x181f, 0x438
  0x45DC2: mov      sp, bp
  0x45DC4: lea      bx, [0x87c]
  0x45DC8: mov      ax, word ptr [bp + 6]
  0x45DCB: sub      dx, dx
  0x45DCD: lcall    0x181f, 0x998
  0x45DD2: push     0x40
  0x45DD4: push     word ptr [bp + 0xa]
  0x45DD7: mov      ax, word ptr [bp + 8]
  0x45DDA: add      ax, 4
  0x45DDD: push     ax
  0x45DDE: lcall    0x181f, 0xa10
  0x45DE3: mov      sp, bp
  0x45DE5: push     word ptr [bp + 0xa]
  0x45DE8: push     word ptr [bp + 8]
  0x45DEB: push     cs
  0x45DEC: call     0x465ee
  0x45DEF: leave    
  0x45DF0: retf     

======================================================================
FUNCTION 038 at overlay+0x2BB8B (file 0x4C1F0), 27 bytes
======================================================================
  0x4C1F0: push     bp
  0x4C1F1: mov      bp, sp
  0x4C1F3: mov      bx, word ptr [bp + 6]
  0x4C1F6: shl      bx, 6
  0x4C1F9: add      bx, word ptr [bp + 8]
  0x4C1FC: shl      bx, 2
  0x4C1FF: mov      byte ptr [bx - 0x674e], 0xff
  0x4C204: mov      byte ptr [bx - 0x674d], 0
  0x4C209: leave    
  0x4C20A: retf     

======================================================================
FUNCTION 039 at overlay+0x2DC51 (file 0x4E2B6), 1074 bytes
  Tags: structs:UnitRecord (28B), globals:current_year,unk_threshold, RANDOM
======================================================================
  0x4E2B6: push     bp
  0x4E2B7: mov      bp, sp
  0x4E2B9: push     si
  0x4E2BA: imul     si, ax, 0x1c  ; × UnitRecord (28B)
  0x4E2BD: mov      byte ptr [si + 0x314b], dl
  0x4E2C1: mov      byte ptr [si + 0x314c], 0xb
  0x4E2C6: mov      byte ptr [si + 0x314d], bl
  0x4E2CA: mov      al, byte ptr [bp + 4]
  0x4E2CD: mov      byte ptr [si + 0x314e], al
  0x4E2D1: pop      si
  0x4E2D2: leave    
  0x4E2D3: ret      2
  0x4E2D6: enter    0xee, 0
  0x4E2DA: push     di
  0x4E2DB: push     si
  0x4E2DC: mov      word ptr [bp - 0xb6], 1
  0x4E2E2: sub      ax, ax
  0x4E2E4: mov      word ptr [bp - 0x8c], ax
  0x4E2E8: mov      word ptr [bp - 0x10], ax
  0x4E2EB: mov      word ptr [bp - 0xac], ax
  0x4E2EF: imul     bx, word ptr [bp + 6], 0x1c  ; × UnitRecord (28B)
  0x4E2F3: mov      al, byte ptr [bx + 0x3147]
  0x4E2F7: and      ax, 0xf  ; rand() & 15 = 1/16 probability
  0x4E2FA: mov      word ptr [bp - 0xe4], ax
  0x4E2FE: cmp      byte ptr [bx + 0x314c], 0
  0x4E303: je       0x4e31d
  0x4E305: cmp      byte ptr [bx + 0x314c], 5
  0x4E30A: je       0x4e31d
  0x4E30C: cmp      byte ptr [bx + 0x314c], 6
  0x4E311: je       0x4e31d
  0x4E313: cmp      byte ptr [bx + 0x314c], 0xa
  0x4E318: jae      0x4e31d
  0x4E31A: jmp      0x51c68
  0x4E31D: imul     bx, word ptr [bp + 6], 0x1c  ; × UnitRecord (28B)
  0x4E321: mov      al, byte ptr [bx + 0x3144]
  0x4E325: sub      ah, ah
  0x4E327: mov      word ptr [bp - 0x86], ax
  0x4E32B: mov      cl, byte ptr [bx + 0x3145]
  0x4E32F: sub      ch, ch
  0x4E331: mov      word ptr [bp - 0x92], cx
  0x4E335: mov      word ptr [bp - 0x74], 8
  0x4E33A: mov      dl, byte ptr [bx + 0x3146]
  0x4E33E: sub      dh, dh
  0x4E340: mov      word ptr [bp - 0x62], dx
  0x4E343: push     cx
  0x4E344: push     ax
  0x4E345: mov      si, bx
  0x4E347: lcall    0x181f, 0x302
  0x4E34C: add      sp, 4
  0x4E34F: or       ax, ax
  0x4E351: jne      0x4e35c
  0x4E353: mov      byte ptr [si + 0x314b], 0x40
  0x4E358: jmp      0x51c68
  0x4E35B: nop      
  0x4E35C: imul     bx, word ptr [bp + 6], 0x1c  ; × UnitRecord (28B)
  0x4E360: cmp      byte ptr [bx + 0x314b], 0x74
  0x4E365: je       0x4e36e
  0x4E367: cmp      byte ptr [bx + 0x314b], 0x69
  0x4E36C: jne      0x4e376
  0x4E36E: mov      word ptr [bp - 4], 1
  0x4E373: jmp      0x4e37b
  0x4E375: nop      
  0x4E376: mov      word ptr [bp - 4], 0
  0x4E37B: push     word ptr [bp - 0xe4]
  0x4E37F: push     word ptr [bp - 0x92]
  0x4E383: push     word ptr [bp - 0x86]
  0x4E387: lcall    0x181f, 0x952
  0x4E38C: add      sp, 6
  0x4E38F: mov      word ptr [bp - 0x18], ax
  0x4E392: push     -1
  0x4E394: push     -1
  0x4E396: push     word ptr [bp - 0x92]
  0x4E39A: push     word ptr [bp - 0x86]
  0x4E39E: lcall    0x181f, 0x614
  0x4E3A3: add      sp, 8
  0x4E3A6: mov      word ptr [bp - 0xe2], ax
  0x4E3AA: mov      ax, word ptr [0x8db8]
  0x4E3AD: mov      word ptr [bp - 0x72], ax
  0x4E3B0: mov      bx, word ptr [0x8542]
  0x4E3B4: mov      al, byte ptr [bx + 1]
  0x4E3B7: sub      ah, ah
  0x4E3B9: push     ax
  0x4E3BA: mov      al, byte ptr [bx]
  0x4E3BC: push     ax
  0x4E3BD: lcall    0x181f, 0x722
  0x4E3C2: add      sp, 4
  0x4E3C5: mov      word ptr [bp - 0x70], ax
  0x4E3C8: push     -1
  0x4E3CA: push     word ptr [bp - 0xe4]
  0x4E3CE: push     word ptr [bp - 0x92]
  0x4E3D2: push     word ptr [bp - 0x86]
  0x4E3D6: lcall    0x181f, 0x614
  0x4E3DB: add      sp, 8
  0x4E3DE: mov      word ptr [bp - 0x60], ax
  0x4E3E1: mov      ax, word ptr [0x8db8]
  0x4E3E4: mov      word ptr [bp - 0x2c], ax
  0x4E3E7: cmp      word ptr [bp - 0x60], 0
  0x4E3EB: jl       0x4e408
  0x4E3ED: mov      bx, word ptr [0x8542]
  0x4E3F1: mov      al, byte ptr [bx + 1]
  0x4E3F4: sub      ah, ah
  0x4E3F6: push     ax
  0x4E3F7: mov      al, byte ptr [bx]
  0x4E3F9: push     ax
  0x4E3FA: lcall    0x181f, 0x722
  0x4E3FF: add      sp, 4
  0x4E402: mov      word ptr [bp - 0x2a], ax
  0x4E405: jmp      0x4e40d
  0x4E407: nop      
  0x4E408: mov      word ptr [bp - 0x2a], 0xfffe
  0x4E40D: push     -1
  0x4E40F: push     -1
  0x4E411: push     word ptr [bp - 0x92]
  0x4E415: push     word ptr [bp - 0x86]
  0x4E419: lcall    0x181f, 0xd84
  0x4E41E: add      sp, 8
  0x4E421: mov      word ptr [bp - 0xaa], ax
  0x4E425: mov      ax, word ptr [0x8db8]
  0x4E428: mov      word ptr [bp - 0x9e], ax
  0x4E42C: mov      bx, word ptr [0x8d4a]
  0x4E430: mov      al, byte ptr [bx + 1]
  0x4E433: sub      ah, ah
  0x4E435: push     ax
  0x4E436: mov      al, byte ptr [bx]
  0x4E438: push     ax
  0x4E439: lcall    0x181f, 0x722
  0x4E43E: add      sp, 4
  0x4E441: mov      word ptr [bp - 0x9c], ax
  0x4E445: push     word ptr [bp - 0xe4]
  0x4E449: push     word ptr [0x8d52]
  0x4E44D: lcall    0x181f, 0x30c
  0x4E452: add      sp, 4
  0x4E455: push     ax
  0x4E456: lcall    0x181f, 0xa60
  0x4E45B: add      sp, 2
  0x4E45E: mov      word ptr [bp - 0x52], ax
  0x4E461: mov      si, word ptr [bp - 0xe4]
  0x4E465: shl      si, 1
  0x4E467: mov      bx, word ptr [0x8d4a]
  0x4E46B: mov      ax, word ptr [bx + si + 0xa]
  0x4E46E: mov      word ptr [bp - 0x3c], ax
  0x4E471: push     -2
  0x4E473: push     word ptr [bp - 0xe4]
  0x4E477: push     word ptr [bp - 0x92]
  0x4E47B: push     word ptr [bp - 0x86]
  0x4E47F: lcall    0x181f, 0x614
  0x4E484: add      sp, 8
  0x4E487: mov      word ptr [bp - 0x50], ax
  0x4E48A: mov      ax, word ptr [0x8db8]
  0x4E48D: mov      word ptr [bp - 0x3a], ax
  0x4E490: imul     bx, word ptr [bp + 6], 0x1c  ; × UnitRecord (28B)
  0x4E494: cmp      byte ptr [bx + 0x3146], 0xd
  0x4E499: jb       0x4e4aa
  0x4E49B: cmp      byte ptr [bx + 0x3146], 0x12
  0x4E4A0: ja       0x4e4aa
  0x4E4A2: mov      word ptr [bp - 0x32], 1
  0x4E4A7: jmp      0x4e4af
  0x4E4A9: nop      
  0x4E4AA: mov      word ptr [bp - 0x32], 0
  0x4E4AF: push     word ptr [bp - 0x92]
  0x4E4B3: push     word ptr [bp - 0x86]
  0x4E4B7: lcall    0x181f, 0x78c
  0x4E4BC: add      sp, 4
  0x4E4BF: mov      word ptr [bp - 0xa8], ax
  0x4E4C3: cmp      ax, 0x19
  0x4E4C6: je       0x4e4cd
  0x4E4C8: cmp      ax, 0x1a
  0x4E4CB: jne      0x4e4d6
  0x4E4CD: mov      word ptr [bp - 0x8e], 1
  0x4E4D3: jmp      0x4e4dc
  0x4E4D5: nop      
  0x4E4D6: mov      word ptr [bp - 0x8e], 0
  0x4E4DC: push     word ptr [bp - 0x92]
  0x4E4E0: push     word ptr [bp - 0x86]
  0x4E4E4: lcall    0x181f, 0x72c
  0x4E4E9: add      sp, 4
  0x4E4EC: and      ax, 0x40
  0x4E4EF: mov      word ptr [bp - 0x82], ax
  0x4E4F3: push     word ptr [bp - 0x92]
  0x4E4F7: push     word ptr [bp - 0x86]
  0x4E4FB: lcall    0x181f, 0x754
  0x4E500: add      sp, 4
  0x4E503: and      ax, 0xa
  0x4E506: mov      word ptr [bp - 0x58], ax
  0x4E509: push     word ptr [bp - 0x92]
  0x4E50D: push     word ptr [bp - 0x86]
  0x4E511: lcall    0x181f, 0x722
  0x4E516: add      sp, 4
  0x4E519: mov      word ptr [bp - 0x36], ax
  0x4E51C: or       ax, ax
  0x4E51E: jl       0x4e534
  0x4E520: mov      si, ax
  0x4E522: mov      bx, word ptr [bp - 0xe4]
  0x4E526: shl      bx, 4
  0x4E529: mov      al, byte ptr [bx + si - 0x6790]
  0x4E52D: sub      ah, ah
  0x4E52F: mov      word ptr [bp - 0x28], ax
  0x4E532: jmp      0x4e539
  0x4E534: mov      word ptr [bp - 0x28], 5
  0x4E539: push     word ptr [bp - 0x92]
  0x4E53D: push     word ptr [bp - 0x86]
  0x4E541: lcall    0x181f, 0x718
  0x4E546: add      sp, 4
  0x4E549: mov      word ptr [bp - 0x84], ax
  0x4E54D: push     word ptr [bp + 6]
  0x4E550: push     word ptr [bp - 0xe4]
  0x4E554: push     cs
  0x4E555: call     0x53539
  0x4E558: add      sp, 4
  0x4E55B: mov      word ptr [bp - 0x12], ax
  0x4E55E: imul     bx, word ptr [bp + 6], 0x1c  ; × UnitRecord (28B)
  0x4E562: cmp      byte ptr [bx + 0x3146], 2
  0x4E567: je       0x4e570
  0x4E569: cmp      byte ptr [bx + 0x3146], 0
  0x4E56E: jne      0x4e578
  0x4E570: mov      word ptr [bp - 0x68], 1
  0x4E575: jmp      0x4e57d
  0x4E577: nop      
  0x4E578: mov      word ptr [bp - 0x68], 0
  0x4E57D: imul     bx, word ptr [bp + 6], 0x1c  ; × UnitRecord (28B)
  0x4E581: cmp      byte ptr [bx + 0x315b], 0x1b
  0x4E586: jne      0x4e58d
  0x4E588: mov      word ptr [bp - 0x68], 0
  0x4E58D: imul     bx, word ptr [bp + 6], 0x1c  ; × UnitRecord (28B)
  0x4E591: cmp      byte ptr [bx + 0x3146], 1
  0x4E596: je       0x4e5a2
  0x4E598: cmp      byte ptr [bx + 0x3146], 4
  0x4E59D: je       0x4e5a2
  0x4E59F: jmp      0x4e660
  0x4E5A2: imul     bx, word ptr [bp + 6], 0x1c  ; × UnitRecord (28B)
  0x4E5A6: cmp      byte ptr [bx + 0x314c], 0
  0x4E5AB: jne      0x4e5b2
  0x4E5AD: mov      word ptr [bp - 0x68], 1
  0x4E5B2: imul     bx, word ptr [bp + 6], 0x1c  ; × UnitRecord (28B)
  0x4E5B6: cmp      byte ptr [bx + 0x314c], 0xb
  0x4E5BB: jne      0x4e5e3
  0x4E5BD: mov      al, byte ptr [bx + 0x314e]
  0x4E5C1: sub      ah, ah
  0x4E5C3: push     ax
  0x4E5C4: mov      al, byte ptr [bx + 0x314d]
  0x4E5C8: push     ax
  0x4E5C9: push     word ptr [bp - 0x92]
  0x4E5CD: push     word ptr [bp - 0x86]
  0x4E5D1: lcall    0x181f, 0x37a
  0x4E5D6: add      sp, 8
  0x4E5D9: cmp      ax, 0xc
  0x4E5DC: jle      0x4e5e3
  0x4E5DE: mov      word ptr [bp - 0x68], 1
  0x4E5E3: push     word ptr [bp - 0x36]
  0x4E5E6: push     word ptr [bp - 0xe4]
  0x4E5EA: push     cs
  0x4E5EB: call     0x534e9
  0x4E5EE: add      sp, 4
  0x4E5F1: cmp      ax, 2
  0x4E5F4: jle      0x4e5fb
  0x4E5F6: mov      word ptr [bp - 0x68], 1
  0x4E5FB: push     0
  0x4E5FD: push     word ptr [bp - 0xe4]
  0x4E601: push     word ptr [bp - 0x92]
  0x4E605: push     word ptr [bp - 0x86]
  0x4E609: push     cs
  0x4E60A: call     0x534c6
  0x4E60D: add      sp, 8
  0x4E610: or       ax, ax
  0x4E612: jl       0x4e619
  0x4E614: mov      word ptr [bp - 0x68], 0
  0x4E619: imul     bx, word ptr [bp + 6], 0x1c  ; × UnitRecord (28B)
  0x4E61D: cmp      byte ptr [bx + 0x315b], 0x15
  0x4E622: jne      0x4e629
  0x4E624: mov      word ptr [bp - 0x68], 0
  0x4E629: mov      bx, word ptr [bp - 0xe4]
  0x4E62D: shl      bx, 4
  0x4E630: add      bx, word ptr [bp - 0x36]
  0x4E633: cmp      byte ptr [bx - 0x6b1a], 0
  0x4E638: jne      0x4e646
  0x4E63A: cmp      byte ptr [bx - 0x6a8e], 8
  0x4E63F: jae      0x4e646
  0x4E641: mov      word ptr [bp - 0x68], 1
  0x4E646: imul     bx, word ptr [bp + 6], 0x1c  ; × UnitRecord (28B)
  0x4E64A: cmp      byte ptr [bx + 0x3146], 4
  0x4E64F: jne      0x4e660
  0x4E651: mov      bx, word ptr [bp - 0x36]
  0x4E654: test     byte ptr [bx - 0x6a0e], 4
  0x4E659: je       0x4e660
  0x4E65B: mov      word ptr [bp - 0x68], 0
  0x4E660: imul     bx, word ptr [bp + 6], 0x1c  ; × UnitRecord (28B)
  0x4E664: cmp      byte ptr [bx + 0x3146], 5
  0x4E669: jne      0x4e6dc
  0x4E66B: cmp      byte ptr [bx + 0x314b], 0x32
  0x4E670: jne      0x4e677
  0x4E672: mov      word ptr [bp - 0x68], 1
  0x4E677: cmp      word ptr [bp - 0x28], 0
  0x4E67B: jne      0x4e682
  0x4E67D: mov      word ptr [bp - 0x68], 0
  0x4E682: mov      si, word ptr [bp - 0xe4]
  0x4E686: shl      si, 4
  0x4E689: mov      bx, word ptr [bp - 0x36]
  0x4E68C: cmp      byte ptr [bx + si - 0x6b1a], 0
  0x4E691: jne      0x4e6a5
  0x4E693: mov      ax, word ptr [0x538e]  ; unk_threshold
  0x4E696: mov      cx, 0xf
  0x4E699: cdq      
  0x4E69A: idiv     cx
  0x4E69C: or       dx, dx
  0x4E69E: jne      0x4e6a5
  0x4E6A0: mov      word ptr [bp - 0x68], 1
  0x4E6A5: cmp      word ptr [bp - 0x2c], 0xc
  0x4E6A9: jle      0x4e6b6
  0x4E6AB: cmp      word ptr [bp - 0x72], 2
  0x4E6AF: jle      0x4e6b6
  0x4E6B1: mov      word ptr [bp - 0x68], 1
  0x4E6B6: push     0
  0x4E6B8: push     word ptr [bp - 0xe4]
  0x4E6BC: push     word ptr [bp - 0x92]
  0x4E6C0: push     word ptr [bp - 0x86]
  0x4E6C4: push     cs
  0x4E6C5: call     0x534c6
  0x4E6C8: add      sp, 8
  0x4E6CB: or       ax, ax
  0x4E6CD: jge      0x4e6d7
  0x4E6CF: cmp      word ptr [0x538a], 0x672  ; current_year
  0x4E6D5: jle      0x4e6dc
  0x4E6D7: mov      word ptr [bp - 0x68], 0
  0x4E6DC: cmp      word ptr [bp - 0x32], 0
  0x4E6E0: jne      0x4e71f
  0x4E6E2: imul     bx, word ptr [bp + 6], 0x1c  ; × UnitRecord (28B)
  0x4E6E6: mov      ax, bx

======================================================================
FUNCTION 040 at overlay+0x316F1 (file 0x51D56), 29 bytes
  Tags: structs:UnitRecord (28B)
======================================================================
  0x51D56: push     bp
  0x51D57: mov      bp, sp
  0x51D59: imul     bx, word ptr [bp + 6], 0x1c  ; × UnitRecord (28B)
  0x51D5D: cmp      byte ptr [bx + 0x3149], 0
  0x51D62: je       0x51dbd
  0x51D64: cmp      byte ptr [bx + 0x314c], 0xb
  0x51D69: jne      0x51dbd
  0x51D6B: mov      bl, byte ptr [bx + 0x3146]
  0x51D6F: sub      bh, bh
  0x51D71: mov      ax, bx

======================================================================
FUNCTION 041 at overlay+0x31881 (file 0x51EE6), 13 bytes
======================================================================
  0x51EE6: push     bp
  0x51EE7: mov      bp, sp
  0x51EE9: push     word ptr [bp + 6]
  0x51EEC: lcall    0x1a1f, 0x5a8
  0x51EF1: leave    
  0x51EF2: retf     

======================================================================
FUNCTION 042 at overlay+0x334AF (file 0x53B14), 18 bytes
======================================================================
  0x53B14: push     bp
  0x53B15: mov      bp, sp
  0x53B17: mov      bx, word ptr [0x8542]
  0x53B1B: and      byte ptr [bx + 0x1c], 0x7f
  0x53B1F: mov      al, byte ptr [bp + 6]
  0x53B22: add      al, 0x1f
  0x53B24: leave    
  0x53B25: retf     

======================================================================
FUNCTION 043 at overlay+0x334C1 (file 0x53B26), 66 bytes
======================================================================
  0x53B26: push     bp
  0x53B27: mov      bp, sp
  0x53B29: push     si
  0x53B2A: lcall    0x181f, 0xd3a
  0x53B2F: mov      si, word ptr [bp + 6]
  0x53B32: shl      si, 1
  0x53B34: mov      bx, word ptr [0x8542]
  0x53B38: cmp      word ptr [bx + si + 0x9a], ax
  0x53B3C: jl       0x53b43
  0x53B3E: mov      word ptr [bp + 8], 0
  0x53B43: mov      bx, word ptr [bp + 6]
  0x53B46: shl      bx, 1
  0x53B48: cmp      word ptr [bx - 0x7238], 0
  0x53B4D: je       0x53b54
  0x53B4F: mov      word ptr [bp + 8], 0
  0x53B54: cmp      word ptr [bp + 8], 0
  0x53B58: je       0x53b68
  0x53B5A: mov      al, byte ptr [bp + 6]
  0x53B5D: mov      bx, word ptr [0x8542]
  0x53B61: mov      byte ptr [bx + 0x8d], al
  0x53B65: pop      si
  0x53B66: leave    
  0x53B67: retf     

======================================================================
FUNCTION 044 at overlay+0x3775B (file 0x57DC0), 279 bytes
  Tags: structs:PowerRecord (316B), globals:unk_threshold
======================================================================
  0x57DC0: push     bp
  0x57DC1: mov      bp, sp
  0x57DC3: push     si
  0x57DC4: test     byte ptr [0x5382], 1
  0x57DC9: je       0x57dce
  0x57DCB: jmp      0x57f4a
  0x57DCE: mov      ax, word ptr [bp + 6]
  0x57DD1: add      ax, word ptr [0x538e]  ; unk_threshold
  0x57DD5: add      ax, word ptr [bp + 8]
  0x57DD8: mov      cx, 3
  0x57DDB: cdq      
  0x57DDC: idiv     cx
  0x57DDE: or       dx, dx
  0x57DE0: je       0x57df7
  0x57DE2: push     word ptr [bp + 8]
  0x57DE5: push     word ptr [bp + 6]
  0x57DE8: lcall    0x181f, 0xa38
  0x57DED: add      sp, 4
  0x57DF0: test     al, 0x20
  0x57DF2: je       0x57df7
  0x57DF4: jmp      0x57f4a
  0x57DF7: push     word ptr [bp + 8]
  0x57DFA: push     word ptr [bp + 6]
  0x57DFD: lcall    0x181f, 0xa38
  0x57E02: add      sp, 4
  0x57E05: test     al, 2
  0x57E07: je       0x57e0c
  0x57E09: jmp      0x57f4a
  0x57E0C: push     word ptr [bp + 6]
  0x57E0F: push     word ptr [bp + 8]
  0x57E12: lcall    0x181f, 0xa38
  0x57E17: add      sp, 4
  0x57E1A: test     al, 2
  0x57E1C: je       0x57e21
  0x57E1E: jmp      0x57f4a
  0x57E21: push     word ptr [bp + 6]
  0x57E24: lcall    0x181f, 0x9a4
  0x57E29: add      sp, 2
  0x57E2C: push     ax
  0x57E2D: push     0
  0x57E2F: lcall    0x181f, 0x438
  0x57E34: add      sp, 4
  0x57E37: push     word ptr [bp + 8]
  0x57E3A: lcall    0x181f, 0x9a4
  0x57E3F: add      sp, 2
  0x57E42: push     ax
  0x57E43: push     1
  0x57E45: lcall    0x181f, 0x438
  0x57E4A: add      sp, 4
  0x57E4D: push     word ptr [bp + 8]
  0x57E50: push     word ptr [bp + 6]
  0x57E53: push     cs
  0x57E54: call     0x5a208
  0x57E57: add      sp, 4
  0x57E5A: or       ax, ax
  0x57E5C: jne      0x57ed8
  0x57E5E: push     word ptr [bp + 6]
  0x57E61: push     word ptr [bp + 8]
  0x57E64: push     cs
  0x57E65: call     0x5a208
  0x57E68: add      sp, 4
  0x57E6B: or       ax, ax
  0x57E6D: jne      0x57ed8
  0x57E6F: push     word ptr [bp + 8]
  0x57E72: push     word ptr [bp + 6]
  0x57E75: lcall    0x181f, 0xa38
  0x57E7A: add      sp, 4
  0x57E7D: test     al, 0x40
  0x57E7F: je       0x57e84
  0x57E81: jmp      0x57f4a
  0x57E84: push     2
  0x57E86: push     0x188d
  0x57E89: lcall    0x181f, 0x652
  0x57E8E: add      sp, 4
  0x57E91: push     0x40
  0x57E93: push     word ptr [bp + 8]
  0x57E96: push     word ptr [bp + 6]
  0x57E99: lcall    0x181f, 0xa06
  0x57E9E: add      sp, 6
  0x57EA1: push     word ptr [bp + 8]
  0x57EA4: push     word ptr [bp + 6]
  0x57EA7: push     cs
  0x57EA8: call     0x5a1e0
  0x57EAB: add      sp, 4
  0x57EAE: push     word ptr [bp + 6]
  0x57EB1: push     word ptr [bp + 8]
  0x57EB4: push     cs
  0x57EB5: call     0x5a1e0
  0x57EB8: add      sp, 4
  0x57EBB: mov      al, 1
  0x57EBD: imul     si, word ptr [bp + 6], 0x13c  ; × PowerRecord (316B)
  0x57EC2: mov      bx, word ptr [bp + 8]
  0x57EC5: mov      byte ptr [bx + si - 0x77b8], al
  0x57EC9: imul     si, bx, 0x13c  ; × PowerRecord (316B)
  0x57ECD: mov      bx, word ptr [bp + 6]
  0x57ED0: mov      byte ptr [bx + si - 0x77b8], al
  0x57ED4: pop      si
  0x57ED5: leave    
  0x57ED6: retf     

======================================================================
FUNCTION 045 at overlay+0x3F7FB (file 0x5FE60), 26 bytes
======================================================================
  0x5FE60: push     bp
  0x5FE61: mov      bp, sp
  0x5FE63: mov      ax, word ptr [bp + 6]
  0x5FE66: mov      word ptr [0xa15c], ax
  0x5FE69: imul     ax, ax, 0x4a
  0x5FE6C: add      ax, 0
  0x5FE6F: mov      word ptr [0x9e14], ax
  0x5FE72: mov      word ptr [0x9e16], 0x1b22
  0x5FE78: leave    
  0x5FE79: retf     

======================================================================
FUNCTION 046 at overlay+0x3F815 (file 0x5FE7A), 38 bytes
======================================================================
  0x5FE7A: push     bp
  0x5FE7B: mov      bp, sp
  0x5FE7D: mov      ax, word ptr [bp + 6]
  0x5FE80: mov      word ptr [0xa15e], ax
  0x5FE83: mov      cx, ax
  0x5FE85: shl      ax, 2
  0x5FE88: add      ax, cx
  0x5FE8A: shl      ax, 1
  0x5FE8C: add      ax, word ptr [0x9e14]
  0x5FE90: mov      dx, word ptr [0x9e16]
  0x5FE94: add      ax, 0x22
  0x5FE97: mov      word ptr [0x9e18], ax
  0x5FE9A: mov      word ptr [0x9e1a], dx
  0x5FE9E: leave    
  0x5FE9F: retf     

======================================================================
FUNCTION 047 at overlay+0x3FD43 (file 0x603A8), 30 bytes
======================================================================
  0x603A8: push     bp
  0x603A9: mov      bp, sp
  0x603AB: cmp      word ptr [bp + 6], 0
  0x603AF: je       0x603c6
  0x603B1: les      bx, ptr [0x9e18]
  0x603B5: and      byte ptr es:[bx + 2], 0xf
  0x603BA: mov      al, byte ptr [bp + 8]
  0x603BD: shl      al, 4
  0x603C0: or       byte ptr es:[bx + 2], al
  0x603C4: leave    
  0x603C5: retf     

======================================================================
FUNCTION 048 at overlay+0x3FDE7 (file 0x6044C), 33 bytes
======================================================================
  0x6044C: push     bp
  0x6044D: mov      bp, sp
  0x6044F: mov      ax, word ptr [bp + 6]
  0x60452: les      bx, ptr [0x9e18]
  0x60456: mov      word ptr es:[bx], ax
  0x60459: push     0
  0x6045B: push     1
  0x6045D: push     cs
  0x6045E: call     0x6144f
  0x60461: mov      sp, bp
  0x60463: push     0
  0x60465: push     0
  0x60467: push     cs
  0x60468: call     0x6144f
  0x6046B: leave    
  0x6046C: retf     

======================================================================
FUNCTION 049 at overlay+0x43AEF (file 0x64154), 151 bytes
======================================================================
  0x64154: push     bp
  0x64155: mov      bp, sp
  0x64157: cmp      word ptr [bp + 4], 0
  0x6415B: jne      0x64160
  0x6415D: jmp      0x641e4
  0x64160: cmp      word ptr [bp + 6], 0
  0x64164: je       0x641e4
  0x64166: mov      ax, word ptr [0x853a]
  0x64169: cmp      word ptr [bp + 4], ax
  0x6416C: jge      0x641e4
  0x6416E: mov      ax, word ptr [0x853c]
  0x64171: cmp      word ptr [bp + 6], ax
  0x64174: jge      0x641e4
  0x64176: push     word ptr [0x85c6]
  0x6417A: push     word ptr [0x85c4]
  0x6417E: push     word ptr [0x85c2]
  0x64182: push     word ptr [0x85c0]
  0x64186: mov      ax, word ptr [bp + 4]
  0x64189: mov      dx, word ptr [bp + 6]
  0x6418C: mov      bx, 1
  0x6418F: lcall    0x1a1f, 0x872
  0x64194: mov      ax, word ptr [0x853a]
  0x64197: dec      ax
  0x64198: cmp      ax, word ptr [bp + 4]
  0x6419B: jle      0x641bc
  0x6419D: push     word ptr [0x85c6]
  0x641A1: push     word ptr [0x85c4]
  0x641A5: push     word ptr [0x85c2]
  0x641A9: push     word ptr [0x85c0]
  0x641AD: mov      ax, word ptr [bp + 4]
  0x641B0: inc      ax
  0x641B1: mov      dx, word ptr [bp + 6]
  0x641B4: mov      bx, 1
  0x641B7: lcall    0x1a1f, 0x872
  0x641BC: mov      ax, word ptr [0x853c]
  0x641BF: dec      ax
  0x641C0: cmp      ax, word ptr [bp + 6]
  0x641C3: jle      0x641e4
  0x641C5: push     word ptr [0x85c6]
  0x641C9: push     word ptr [0x85c4]
  0x641CD: push     word ptr [0x85c2]
  0x641D1: push     word ptr [0x85c0]
  0x641D5: mov      dx, word ptr [bp + 6]
  0x641D8: inc      dx
  0x641D9: mov      ax, word ptr [bp + 4]
  0x641DC: mov      bx, 1
  0x641DF: lcall    0x1a1f, 0x872
  0x641E4: lcall    0x181f, 0x3ac
  0x641E9: leave    
  0x641EA: ret      

======================================================================
FUNCTION 050 at overlay+0x43ECF (file 0x64534), 24 bytes
======================================================================
  0x64534: push     bp
  0x64535: mov      bp, sp
  0x64537: push     word ptr [bp + 8]
  0x6453A: push     word ptr [bp + 6]
  0x6453D: lcall    0x181f, 0x302
  0x64542: mov      sp, bp
  0x64544: or       ax, ax
  0x64546: jne      0x6454c
  0x64548: sub      ax, ax
  0x6454A: leave    
  0x6454B: retf     

======================================================================
FUNCTION 051 at overlay+0x46531 (file 0x66B96), 26 bytes
======================================================================
  0x66B96: push     bp
  0x66B97: mov      bp, sp
  0x66B99: push     0
  0x66B9B: push     word ptr [bp + 6]
  0x66B9E: push     0x27
  0x66BA0: push     0x38
  0x66BA2: push     word ptr [0x9cca]
  0x66BA6: push     word ptr [0x9ccc]
  0x66BAA: push     cs
  0x66BAB: call     0x66df7
  0x66BAE: leave    
  0x66BAF: retf     

======================================================================
FUNCTION 052 at overlay+0x46671 (file 0x66CD6), 192 bytes
  Tags: globals:map_terrain
======================================================================
  0x66CD6: push     bp
  0x66CD7: mov      bp, sp
  0x66CD9: push     cs
  0x66CDA: call     0x66df2
  0x66CDD: cmp      word ptr [0x82c], 0
  0x66CE2: jne      0x66d08
  0x66CE4: push     word ptr [0x2dae]
  0x66CE8: push     word ptr [0x2dac]
  0x66CEC: push     word ptr [0x2daa]
  0x66CF0: push     word ptr [0x2da8]  ; map_terrain
  0x66CF4: push     0x29
  0x66CF6: push     0
  0x66CF8: mov      ax, 0xf1
  0x66CFB: mov      dx, 8
  0x66CFE: mov      bx, 0x4f
  0x66D01: lcall    0x181f, 0xba
  0x66D06: jmp      0x66d3b
  0x66D08: push     0
  0x66D0A: push     0
  0x66D0C: push     0x29
  0x66D0E: push     0x4f
  0x66D10: push     8
  0x66D12: push     0xf1
  0x66D15: mov      bx, word ptr [0x82c]
  0x66D19: push     word ptr [bx + 6]
  0x66D1C: push     word ptr [bx + 4]
  0x66D1F: push     word ptr [bx + 2]
  0x66D22: push     word ptr [bx]
  0x66D24: push     word ptr [0x2dae]
  0x66D28: push     word ptr [0x2dac]
  0x66D2C: push     word ptr [0x2daa]
  0x66D30: push     word ptr [0x2da8]  ; map_terrain
  0x66D34: lcall    0x181f, 0xc4
  0x66D39: mov      sp, bp
  0x66D3B: push     word ptr [0x2dae]
  0x66D3F: push     word ptr [0x2dac]
  0x66D43: push     word ptr [0x2daa]
  0x66D47: push     word ptr [0x2da8]  ; map_terrain
  0x66D4B: push     0x30
  0x66D4D: push     6
  0x66D4F: mov      ax, 0xfb
  0x66D52: mov      dx, 8
  0x66D55: mov      bx, 0x134
  0x66D58: lcall    0x181f, 0xce
  0x66D5D: push     word ptr [bp + 8]
  0x66D60: push     cs
  0x66D61: call     0x66e06
  0x66D64: mov      sp, bp
  0x66D66: push     word ptr [0x2dae]
  0x66D6A: push     word ptr [0x2dac]
  0x66D6E: push     word ptr [0x2daa]
  0x66D72: push     word ptr [0x2da8]  ; map_terrain
  0x66D76: mov      ax, word ptr [0x9cca]
  0x66D79: add      ax, 0x26
  0x66D7C: cmp      ax, word ptr [0x8806]
  0x66D80: jle      0x66d85
  0x66D82: mov      ax, word ptr [0x8806]
  0x66D85: sub      ax, word ptr [0x9cca]
  0x66D89: add      ax, 9
  0x66D8C: push     ax
  0x66D8D: push     0xf
  0x66D8F: mov      ax, word ptr [0x9ccc]
  0x66D92: mov      bx, ax

======================================================================
FUNCTION 053 at overlay+0x467A7 (file 0x66E0C), 69 bytes
======================================================================
  0x66E0C: push     bp
  0x66E0D: mov      bp, sp
  0x66E0F: mov      bx, word ptr [bp + 6]
  0x66E12: mov      ax, word ptr [bx]
  0x66E14: cmp      ax, word ptr [0x8328]
  0x66E18: jge      0x66e1d
  0x66E1A: mov      ax, word ptr [0x8328]
  0x66E1D: mov      word ptr [bx], ax
  0x66E1F: mov      bx, word ptr [bp + 8]
  0x66E22: mov      ax, word ptr [bx]
  0x66E24: cmp      ax, word ptr [0x832e]
  0x66E28: jge      0x66e2d
  0x66E2A: mov      ax, word ptr [0x832e]
  0x66E2D: mov      word ptr [bx], ax
  0x66E2F: mov      bx, word ptr [bp + 0xa]
  0x66E32: mov      ax, word ptr [bx]
  0x66E34: cmp      ax, word ptr [0x8804]
  0x66E38: jle      0x66e3d
  0x66E3A: mov      ax, word ptr [0x8804]
  0x66E3D: mov      word ptr [bx], ax
  0x66E3F: mov      bx, word ptr [bp + 0xc]  ; PowerRecord.congress_progress
  0x66E42: mov      ax, word ptr [bx]
  0x66E44: cmp      ax, word ptr [0x8806]
  0x66E48: jle      0x66e4d
  0x66E4A: mov      ax, word ptr [0x8806]
  0x66E4D: mov      word ptr [bx], ax
  0x66E4F: leave    
  0x66E50: retf     

======================================================================
FUNCTION 054 at overlay+0x46E11 (file 0x67476), 50 bytes
======================================================================
  0x67476: push     bp
  0x67477: mov      bp, sp
  0x67479: cmp      word ptr [0x1ea2], 0
  0x6747E: je       0x6749a
  0x67480: push     0
  0x67482: push     1
  0x67484: push     word ptr [0x5392]
  0x67488: push     cs
  0x67489: call     0x6763f
  0x6748C: mov      sp, bp
  0x6748E: cmp      word ptr [bp + 6], 0
  0x67492: je       0x674a6
  0x67494: push     1
  0x67496: push     1
  0x67498: jmp      0x6749e
  0x6749A: push     0
  0x6749C: push     0
  0x6749E: push     word ptr [0x5392]
  0x674A2: push     cs
  0x674A3: call     0x6763f
  0x674A6: leave    
  0x674A7: retf     

======================================================================
FUNCTION 055 at overlay+0x48233 (file 0x68898), 133 bytes
======================================================================
  0x68898: push     bp
  0x68899: mov      bp, sp
  0x6889B: push     ax
  0x6889C: push     cs
  0x6889D: call     0x6896a
  0x688A0: cmp      word ptr [0x832a], 0
  0x688A5: jne      0x688ae
  0x688A7: cmp      word ptr [0x832c], 0
  0x688AC: je       0x68905
  0x688AE: cmp      word ptr [0x82c], 0
  0x688B3: je       0x688ee
  0x688B5: push     -8
  0x688B7: push     0
  0x688B9: push     word ptr [0x839e]
  0x688BD: push     word ptr [0x83a0]
  0x688C1: push     0
  0x688C3: push     0
  0x688C5: mov      bx, word ptr [0x82c]
  0x688C9: push     word ptr [bx + 6]
  0x688CC: push     word ptr [bx + 4]
  0x688CF: push     word ptr [bx + 2]
  0x688D2: push     word ptr [bx]
  0x688D4: push     word ptr [0x83a4]
  0x688D8: push     word ptr [0x83a2]
  0x688DC: push     word ptr [0x83a0]
  0x688E0: push     word ptr [0x839e]
  0x688E4: lcall    0x181f, 0xc4
  0x688E9: add      sp, 0x1c
  0x688EC: jmp      0x68905
  0x688EE: push     word ptr [0x83a4]
  0x688F2: push     word ptr [0x83a2]
  0x688F6: push     word ptr [0x83a0]
  0x688FA: push     word ptr [0x839e]
  0x688FE: sub      al, al
  0x68900: lcall    0x181f, 0x484
  0x68905: push     word ptr [0x8546]
  0x68909: push     word ptr [bp - 2]
  0x6890C: mov      ax, word ptr [0x8328]
  0x6890F: mov      dx, word ptr [0x832e]
  0x68913: mov      bx, word ptr [0x8544]
  0x68917: push     cs
  0x68918: call     0x68974
  0x6891B: leave    
  0x6891C: retf     

======================================================================
FUNCTION 056 at overlay+0x4893B (file 0x68FA0), 59 bytes
======================================================================
  0x68FA0: push     bp
  0x68FA1: mov      bp, sp
  0x68FA3: push     si
  0x68FA4: cmp      word ptr [0xa5aa], 0xd8
  0x68FAA: jge      0x68fd8
  0x68FAC: mov      ax, word ptr [bp + 6]
  0x68FAF: mov      bx, word ptr [0xa5aa]
  0x68FB3: shl      bx, 1
  0x68FB5: les      si, ptr [0x1ea6]
  0x68FB9: mov      word ptr es:[bx + si], ax
  0x68FBC: mov      al, byte ptr [bp + 8]
  0x68FBF: les      bx, ptr [0x1eaa]
  0x68FC3: mov      si, word ptr [0xa5aa]
  0x68FC7: mov      byte ptr es:[bx + si], al
  0x68FCA: mov      al, byte ptr [bp + 0xa]
  0x68FCD: les      bx, ptr [0x1eae]
  0x68FD1: mov      byte ptr es:[bx + si], al
  0x68FD4: inc      word ptr [0xa5aa]
  0x68FD8: pop      si
  0x68FD9: leave    
  0x68FDA: retf     

======================================================================
FUNCTION 057 at overlay+0x48C17 (file 0x6927C), 32 bytes
======================================================================
  0x6927C: push     bp
  0x6927D: mov      bp, sp
  0x6927F: push     word ptr [bp + 8]
  0x69282: push     0x1eb2
  0x69285: push     0x1eb8
  0x69288: lcall    0x181f, 0x422
  0x6928D: mov      sp, bp
  0x6928F: push     0x833c
  0x69292: push     word ptr [bp + 6]
  0x69295: lcall    0xd1d, 0x7a4
  0x6929A: leave    
  0x6929B: retf     

======================================================================
FUNCTION 058 at overlay+0x48C37 (file 0x6929C), 103 bytes
  Tags: globals:map_terrain
======================================================================
  0x6929C: push     bp
  0x6929D: mov      bp, sp
  0x6929F: push     word ptr [0x2dae]
  0x692A3: push     word ptr [0x2dac]
  0x692A7: push     word ptr [0x2daa]
  0x692AB: push     word ptr [0x2da8]  ; map_terrain
  0x692AF: push     word ptr [0x83a4]
  0x692B3: push     word ptr [0x83a2]
  0x692B7: push     word ptr [0x83a0]
  0x692BB: push     word ptr [0x839e]
  0x692BF: push     0xc8
  0x692C2: sub      ax, ax
  0x692C4: cdq      
  0x692C5: mov      bx, 0x140
  0x692C8: lcall    0x181f, 0x444
  0x692CD: lcall    0x181f, 0x40a
  0x692D2: or       byte ptr [0x1f56], 0x20
  0x692D7: mov      ax, word ptr [0x89e]
  0x692DA: mov      dx, word ptr [0x8a0]
  0x692DE: mov      word ptr [0x1f9e], ax
  0x692E1: mov      word ptr [0x1fa0], dx
  0x692E5: lea      bx, [0x1ebe]
  0x692E9: mov      ax, word ptr [bp + 6]
  0x692EC: sub      dx, dx
  0x692EE: lcall    0x181f, 0x998
  0x692F3: mov      ax, word ptr [0x268a]
  0x692F6: mov      dx, word ptr [0x268c]
  0x692FA: mov      word ptr [0x1f9e], ax
  0x692FD: mov      word ptr [0x1fa0], dx
  0x69301: leave    
  0x69302: retf     

======================================================================
FUNCTION 059 at overlay+0x4B7EB (file 0x6BE50), 320 bytes
======================================================================
  0x6BE50: push     bp
  0x6BE51: mov      bp, sp
  0x6BE53: push     si
  0x6BE54: mov      ax, word ptr [bp + 4]
  0x6BE57: mov      dx, word ptr [bp + 6]
  0x6BE5A: add      ax, 0x84
  0x6BE5D: push     dx
  0x6BE5E: push     ax
  0x6BE5F: push     bx
  0x6BE60: mov      si, bx
  0x6BE62: lcall    0xd1d, 0x842
  0x6BE67: add      sp, 2
  0x6BE6A: inc      ax
  0x6BE6B: sub      dx, dx
  0x6BE6D: lcall    0x181f, 0x2c
  0x6BE72: les      bx, ptr [bp + 4]
  0x6BE75: mov      word ptr es:[bx + 0x6c], ax
  0x6BE79: mov      word ptr es:[bx + 0x6e], dx
  0x6BE7D: push     ds
  0x6BE7E: push     si
  0x6BE7F: push     dx
  0x6BE80: push     word ptr es:[bx + 0x6c]
  0x6BE84: lcall    0xd1d, 0x117e
  0x6BE89: add      sp, 8
  0x6BE8C: pop      si
  0x6BE8D: leave    
  0x6BE8E: ret      4
  0x6BE91: nop      
  0x6BE92: enter    0x16, 0
  0x6BE96: cmp      word ptr [0x1f5c], 7
  0x6BE9B: jle      0x6beca
  0x6BE9D: push     0x1f72
  0x6BEA0: lea      ax, [bp - 0x14]
  0x6BEA3: push     ax
  0x6BEA4: lcall    0xd1d, 0x7e4
  0x6BEA9: add      sp, 4
  0x6BEAC: mov      ax, 1
  0x6BEAF: mov      word ptr [0x1f6e], ax
  0x6BEB2: mov      word ptr [0xa5ae], ax
  0x6BEB5: lcall    0xc0c, 6
  0x6BEBA: add      ax, 0xf0
  0x6BEBD: adc      dx, 0
  0x6BEC0: mov      word ptr [0xa5b0], ax
  0x6BEC3: mov      word ptr [0xa5b2], dx
  0x6BEC7: jmp      0x6bf01
  0x6BEC9: nop      
  0x6BECA: push     word ptr [0x5398]
  0x6BECE: push     word ptr [0x1f5c]
  0x6BED2: lcall    0x181f, 0x30c
  0x6BED7: add      sp, 4
  0x6BEDA: push     ax
  0x6BEDB: lcall    0x181f, 0xa60
  0x6BEE0: add      sp, 2
  0x6BEE3: mov      word ptr [bp - 0x16], ax
  0x6BEE6: push     0x1f77
  0x6BEE9: lea      ax, [bp - 0x14]
  0x6BEEC: push     ax
  0x6BEED: lcall    0xd1d, 0x7e4
  0x6BEF2: add      sp, 4
  0x6BEF5: mov      al, byte ptr [0x1f5c]
  0x6BEF8: add      byte ptr [bp - 0x11], al
  0x6BEFB: mov      al, byte ptr [bp - 0x16]
  0x6BEFE: add      byte ptr [bp - 0xf], al
  0x6BF01: push     word ptr [bp + 6]
  0x6BF04: push     word ptr [bp + 4]
  0x6BF07: lea      bx, [bp - 0x14]
  0x6BF0A: call     0x6be50
  0x6BF0D: leave    
  0x6BF0E: ret      4
  0x6BF11: nop      
  0x6BF12: enter    0x14, 0
  0x6BF16: push     0x1f7e
  0x6BF19: lea      ax, [bp - 0x14]
  0x6BF1C: push     ax
  0x6BF1D: lcall    0xd1d, 0x7e4
  0x6BF22: add      sp, 4
  0x6BF25: mov      al, byte ptr [0x1f5e]
  0x6BF28: add      byte ptr [bp - 0x11], al
  0x6BF2B: push     word ptr [bp + 6]
  0x6BF2E: push     word ptr [bp + 4]
  0x6BF31: lea      bx, [bp - 0x14]
  0x6BF34: call     0x6be50
  0x6BF37: leave    
  0x6BF38: ret      4
  0x6BF3B: nop      
  0x6BF3C: enter    0x14, 0
  0x6BF40: push     0x1f83
  0x6BF43: lea      ax, [bp - 0x14]
  0x6BF46: push     ax
  0x6BF47: lcall    0xd1d, 0x7e4
  0x6BF4C: add      sp, 4
  0x6BF4F: mov      al, byte ptr [0x1f60]
  0x6BF52: add      byte ptr [bp - 0x11], al
  0x6BF55: push     word ptr [bp + 6]
  0x6BF58: push     word ptr [bp + 4]
  0x6BF5B: lea      bx, [bp - 0x14]
  0x6BF5E: call     0x6be50
  0x6BF61: leave    
  0x6BF62: ret      4
  0x6BF65: nop      
  0x6BF66: enter    0x8c, 0
  0x6BF6A: push     di
  0x6BF6B: push     si
  0x6BF6C: les      bx, ptr [bp + 4]
  0x6BF6F: mov      ax, word ptr es:[bx + 0x6e]
  0x6BF73: or       ax, word ptr es:[bx + 0x6c]
  0x6BF77: jne      0x6bf7c
  0x6BF79: jmp      0x6c186
  0x6BF7C: cmp      word ptr [0x1f5c], 7
  0x6BF81: jle      0x6bf88
  0x6BF83: mov      ax, 1
  0x6BF86: jmp      0x6bf8a
  0x6BF88: sub      ax, ax
  0x6BF8A: mov      word ptr [bp - 0x86], ax
  0x6BF8E: mov      ax, bx

======================================================================
FUNCTION 060 at overlay+0x4BB27 (file 0x6C18C), 148 bytes
======================================================================
  0x6C18C: push     bp
  0x6C18D: mov      bp, sp
  0x6C18F: push     ax
  0x6C190: cmp      word ptr [0x1f6c], 0
  0x6C195: je       0x6c200
  0x6C197: cmp      byte ptr [bp + 0xa], 7
  0x6C19B: jne      0x6c200
  0x6C19D: cmp      word ptr [0x1f8a], 0
  0x6C1A2: je       0x6c1cc
  0x6C1A4: push     word ptr [0x83a4]
  0x6C1A8: push     word ptr [0x83a2]
  0x6C1AC: push     word ptr [0x83a0]
  0x6C1B0: push     word ptr [0x839e]
  0x6C1B4: push     word ptr [bp + 0x1a]
  0x6C1B7: push     word ptr [bp + 0x18]
  0x6C1BA: push     word ptr [bp + 0x16]
  0x6C1BD: push     word ptr [bp + 0x14]  ; PowerRecord.founding_fathers_count
  0x6C1C0: push     word ptr [bp + 0x12]
  0x6C1C3: lcall    0x181f, 0x444
  0x6C1C8: leave    
  0x6C1C9: ret      0x18
  0x6C1CC: push     word ptr [bp + 0xe]  ; PowerRecord.liberty_bells
  0x6C1CF: push     word ptr [bp + 0x10]  ; PowerRecord.crosses
  0x6C1D2: push     word ptr [bp + 0x12]
  0x6C1D5: push     bx
  0x6C1D6: push     dx
  0x6C1D7: push     ax
  0x6C1D8: mov      bx, word ptr [0x1f6c]
  0x6C1DC: push     word ptr [bx + 6]
  0x6C1DF: push     word ptr [bx + 4]
  0x6C1E2: push     word ptr [bx + 2]
  0x6C1E5: push     word ptr [bx]
  0x6C1E7: push     word ptr [bp + 0x1a]
  0x6C1EA: push     word ptr [bp + 0x18]
  0x6C1ED: push     word ptr [bp + 0x16]
  0x6C1F0: push     word ptr [bp + 0x14]  ; PowerRecord.founding_fathers_count
  0x6C1F3: lcall    0x181f, 0xc4
  0x6C1F8: add      sp, 0x1c
  0x6C1FB: leave    
  0x6C1FC: ret      0x18
  0x6C1FF: nop      
  0x6C200: push     word ptr [bp + 0x1a]
  0x6C203: push     word ptr [bp + 0x18]
  0x6C206: push     word ptr [bp + 0x16]
  0x6C209: push     word ptr [bp + 0x14]  ; PowerRecord.founding_fathers_count
  0x6C20C: push     word ptr [bp + 0x12]
  0x6C20F: mov      al, byte ptr [bp + 0xa]
  0x6C212: push     ax
  0x6C213: mov      ax, word ptr [bp - 2]
  0x6C216: lcall    0x181f, 0xba
  0x6C21B: leave    
  0x6C21C: ret      0x18
  0x6C21F: nop      

======================================================================
FUNCTION 061 at overlay+0x4BBBB (file 0x6C220), 27 bytes
======================================================================
  0x6C220: push     bp
  0x6C221: mov      bp, sp
  0x6C223: push     word ptr [bp + 0xa]
  0x6C226: push     word ptr [bp + 8]
  0x6C229: mov      ax, word ptr [bp + 6]
  0x6C22C: shl      ax, 6
  0x6C22F: add      ax, 0x9cd2
  0x6C232: push     ds
  0x6C233: push     ax
  0x6C234: lcall    0xd1d, 0x117e
  0x6C239: leave    
  0x6C23A: retf     

======================================================================
FUNCTION 062 at overlay+0x4BBD7 (file 0x6C23C), 24 bytes
======================================================================
  0x6C23C: push     bp
  0x6C23D: mov      bp, sp
  0x6C23F: push     word ptr [bp + 8]
  0x6C242: lcall    0x181f, 0x22
  0x6C247: mov      sp, bp
  0x6C249: push     dx
  0x6C24A: push     ax
  0x6C24B: push     word ptr [bp + 6]
  0x6C24E: push     cs
  0x6C24F: call     0x6f7ea
  0x6C252: leave    
  0x6C253: retf     

======================================================================
FUNCTION 063 at overlay+0x4BC17 (file 0x6C27C), 25 bytes
======================================================================
  0x6C27C: push     bp
  0x6C27D: mov      bp, sp
  0x6C27F: mov      ax, word ptr [bp + 8]
  0x6C282: mov      dx, word ptr [bp + 0xa]
  0x6C285: mov      bx, word ptr [bp + 6]
  0x6C288: shl      bx, 2
  0x6C28B: mov      word ptr [bx - 0x6350], ax
  0x6C28F: mov      word ptr [bx - 0x634e], dx
  0x6C293: leave    
  0x6C294: retf     

======================================================================
FUNCTION 064 at overlay+0x4BC31 (file 0x6C296), 63 bytes
======================================================================
  0x6C296: push     bp
  0x6C297: mov      bp, sp
  0x6C299: mov      ax, word ptr [bp + 0xe]  ; PowerRecord.liberty_bells
  0x6C29C: les      bx, ptr [bp + 6]
  0x6C29F: mov      word ptr es:[bx], ax
  0x6C2A2: mov      ax, word ptr [bp + 0x10]  ; PowerRecord.crosses
  0x6C2A5: mov      word ptr es:[bx + 2], ax
  0x6C2A9: mov      ax, word ptr [bp + 0x12]
  0x6C2AC: mov      word ptr es:[bx + 4], ax
  0x6C2B0: mov      ax, word ptr [bp + 0x14]  ; PowerRecord.founding_fathers_count
  0x6C2B3: mov      word ptr es:[bx + 6], ax
  0x6C2B7: mov      ax, word ptr [bp + 0x16]
  0x6C2BA: mov      word ptr es:[bx + 8], ax
  0x6C2BE: mov      ax, word ptr [bp + 0x18]
  0x6C2C1: mov      word ptr es:[bx + 0xa], ax
  0x6C2C5: mov      ax, word ptr [bp + 0xa]
  0x6C2C8: mov      dx, word ptr [bp + 0xc]  ; PowerRecord.congress_progress
  0x6C2CB: mov      word ptr es:[bx + 0xc], ax  ; PowerRecord.congress_progress
  0x6C2CF: mov      word ptr es:[bx + 0xe], dx  ; PowerRecord.liberty_bells
  0x6C2D3: leave    
  0x6C2D4: retf     

======================================================================
FUNCTION 065 at overlay+0x4BCE1 (file 0x6C346), 85 bytes
======================================================================
  0x6C346: push     bp
  0x6C347: mov      bp, sp
  0x6C349: or       ax, ax
  0x6C34B: je       0x6c35a
  0x6C34D: les      bx, ptr [bp + 4]
  0x6C350: push     word ptr es:[bx + 0xa]
  0x6C354: mov      dx, word ptr es:[bx + 4]
  0x6C358: jmp      0x6c377
  0x6C35A: or       dx, dx
  0x6C35C: je       0x6c36c
  0x6C35E: les      bx, ptr [bp + 4]
  0x6C361: push     word ptr es:[bx + 0xa]
  0x6C365: mov      dx, word ptr es:[bx + 6]
  0x6C369: jmp      0x6c377
  0x6C36B: nop      
  0x6C36C: les      bx, ptr [bp + 4]
  0x6C36F: push     word ptr es:[bx + 0xa]
  0x6C373: mov      dx, word ptr es:[bx + 2]
  0x6C377: mov      bx, word ptr es:[bx + 8]
  0x6C37B: mov      ax, 0xffff
  0x6C37E: lcall    0x181f, 0x1f0
  0x6C383: leave    
  0x6C384: ret      4
  0x6C387: nop      
  0x6C388: enter    8, 0
  0x6C38C: push     bx
  0x6C38D: push     dx
  0x6C38E: push     ax
  0x6C38F: mov      byte ptr [bp - 1], 0
  0x6C393: push     word ptr [bp + 0xa]
  0x6C396: push     word ptr [bp + 8]
  0x6C399: mov      ax, bx

======================================================================
FUNCTION 066 at overlay+0x4C1CD (file 0x6C832), 29 bytes
======================================================================
  0x6C832: push     bp
  0x6C833: mov      bp, sp
  0x6C835: push     word ptr [bp + 8]
  0x6C838: push     word ptr [bp + 6]
  0x6C83B: mov      ax, word ptr [bp + 0xa]
  0x6C83E: push     cs
  0x6C83F: call     0x6f821
  0x6C842: les      bx, ptr [bp + 6]
  0x6C845: mov      word ptr es:[bx + 0x4c], ax  ; PowerRecord.market_sensitivity[0]
  0x6C849: mov      word ptr es:[bx + 0x4e], dx
  0x6C84D: leave    
  0x6C84E: retf     

======================================================================
FUNCTION 067 at overlay+0x4C40D (file 0x6CA72), 15 bytes
======================================================================
  0x6CA72: push     bp
  0x6CA73: mov      bp, sp
  0x6CA75: mov      ax, word ptr [bp + 0xa]
  0x6CA78: les      bx, ptr [bp + 6]
  0x6CA7B: mov      word ptr es:[bx + 0x28], ax
  0x6CA7F: leave    
  0x6CA80: retf     

======================================================================
FUNCTION 068 at overlay+0x4C915 (file 0x6CF7A), 61 bytes
======================================================================
  0x6CF7A: push     bp
  0x6CF7B: mov      bp, sp
  0x6CF7D: mov      ax, word ptr [bp + 6]
  0x6CF80: mov      dx, word ptr [bp + 8]
  0x6CF83: add      ax, 0x84
  0x6CF86: push     dx
  0x6CF87: push     ax
  0x6CF88: mov      ax, 0x14
  0x6CF8B: cdq      
  0x6CF8C: lcall    0x181f, 0x2c
  0x6CF91: les      bx, ptr [bp + 6]
  0x6CF94: mov      word ptr es:[bx + 0x64], ax
  0x6CF98: mov      word ptr es:[bx + 0x66], dx
  0x6CF9C: mov      ax, word ptr [bp + 0xa]
  0x6CF9F: mov      dx, word ptr [bp + 0xc]  ; PowerRecord.congress_progress
  0x6CFA2: les      bx, ptr es:[bx + 0x64]
  0x6CFA6: mov      word ptr es:[bx + 0xc], ax  ; PowerRecord.congress_progress
  0x6CFAA: mov      word ptr es:[bx + 0xe], dx  ; PowerRecord.liberty_bells
  0x6CFAE: mov      ax, word ptr [bp + 0xe]  ; PowerRecord.liberty_bells
  0x6CFB1: mov      word ptr es:[bx + 4], ax
  0x6CFB5: mov      ax, bx

======================================================================
FUNCTION 069 at overlay+0x4D227 (file 0x6D88C), 172 bytes
======================================================================
  0x6D88C: push     bp
  0x6D88D: mov      bp, sp
  0x6D88F: push     si
  0x6D890: cmp      word ptr [0x1f6a], 0
  0x6D895: je       0x6d8a1
  0x6D897: les      bx, ptr [bp + 4]
  0x6D89A: test     byte ptr es:[bx + 0xa], 0x20
  0x6D89F: jne      0x6d8c2
  0x6D8A1: les      bx, ptr [bp + 4]
  0x6D8A4: push     word ptr es:[bx + 0x1a]
  0x6D8A8: push     word ptr es:[bx + 0x1c]
  0x6D8AC: push     word ptr es:[bx + 0x1e]
  0x6D8B0: mov      ax, word ptr es:[bx + 0x18]
  0x6D8B4: mov      bx, ax
  0x6D8B6: mov      si, word ptr [bp + 4]
  0x6D8B9: mov      dx, word ptr es:[si + 0x1a]
  0x6D8BD: lcall    0x181f, 0xe2
  0x6D8C2: pop      si
  0x6D8C3: leave    
  0x6D8C4: ret      4
  0x6D8C7: nop      
  0x6D8C8: enter    0x54, 0
  0x6D8CC: cmp      word ptr [0x1f66], 0
  0x6D8D1: je       0x6d936
  0x6D8D3: les      bx, ptr [bp + 6]
  0x6D8D6: mov      ax, word ptr es:[bx + 0x14]  ; PowerRecord.founding_fathers_count
  0x6D8DA: add      ax, word ptr es:[bx + 0x10]  ; PowerRecord.crosses
  0x6D8DE: dec      ax
  0x6D8DF: dec      ax
  0x6D8E0: mov      word ptr [bp - 2], ax
  0x6D8E3: mov      ax, word ptr es:[bx + 0x16]
  0x6D8E7: add      ax, word ptr es:[bx + 0x12]
  0x6D8EB: sub      ax, 7
  0x6D8EE: mov      word ptr [bp - 0x54], ax
  0x6D8F1: mov      cx, word ptr [0x89e]
  0x6D8F5: mov      dx, word ptr [0x8a0]
  0x6D8F9: cmp      word ptr es:[bx + 0x80], cx
  0x6D8FE: jne      0x6d90c
  0x6D900: cmp      word ptr es:[bx + 0x82], dx
  0x6D905: jne      0x6d90c
  0x6D907: dec      ax
  0x6D908: dec      ax
  0x6D909: mov      word ptr [bp - 0x54], ax
  0x6D90C: mov      byte ptr [bp - 0x52], 0
  0x6D910: push     word ptr [0x2f34]
  0x6D914: lea      ax, [bp - 0x52]
  0x6D917: push     ax
  0x6D918: lcall    0x181f, 0x16e
  0x6D91D: add      sp, 4
  0x6D920: mov      al, byte ptr [0x831]
  0x6D923: sub      ah, ah
  0x6D925: push     ax
  0x6D926: push     word ptr [bp - 0x54]
  0x6D929: push     word ptr [bp - 2]
  0x6D92C: lea      ax, [bp - 0x52]
  0x6D92F: push     ss
  0x6D930: push     ax
  0x6D931: lcall    0x181f, 0x150
  0x6D936: leave    
  0x6D937: retf     

======================================================================
FUNCTION 070 at overlay+0x4DD49 (file 0x6E3AE), 34 bytes
======================================================================
  0x6E3AE: push     bp
  0x6E3AF: mov      bp, sp
  0x6E3B1: mov      ax, word ptr [bp + 0xa]
  0x6E3B4: mov      dx, word ptr [bp + 0xc]  ; PowerRecord.congress_progress
  0x6E3B7: les      bx, ptr [bp + 6]
  0x6E3BA: mov      word ptr es:[bx + 0x50], ax
  0x6E3BE: mov      word ptr es:[bx + 0x52], dx
  0x6E3C2: push     es
  0x6E3C3: push     bx
  0x6E3C4: sub      ax, ax
  0x6E3C6: mov      dx, 1
  0x6E3C9: mov      bx, dx
  0x6E3CB: call     0x6de6e
  0x6E3CE: leave    
  0x6E3CF: retf     

======================================================================
FUNCTION 071 at overlay+0x4E86F (file 0x6EED4), 24 bytes
======================================================================
  0x6EED4: push     bp
  0x6EED5: mov      bp, sp
  0x6EED7: mov      ax, word ptr [bp + 6]
  0x6EEDA: mov      dx, word ptr [bp + 8]
  0x6EEDD: mov      word ptr [0x1f9e], ax
  0x6EEE0: mov      word ptr [0x1fa0], dx
  0x6EEE4: mov      ax, word ptr [bp + 0xa]
  0x6EEE7: mov      word ptr [0x1fa2], ax
  0x6EEEA: leave    
  0x6EEEB: retf     

======================================================================
FUNCTION 072 at overlay+0x4EEEF (file 0x6F554), 25 bytes
======================================================================
  0x6F554: push     bp
  0x6F555: mov      bp, sp
  0x6F557: push     ax
  0x6F558: dec      word ptr [bp - 2]
  0x6F55B: or       dx, dx
  0x6F55D: je       0x6f56e
  0x6F55F: mov      cl, byte ptr [bp - 2]
  0x6F562: mov      ax, 1
  0x6F565: shl      ax, cl
  0x6F567: or       word ptr [0x1f54], ax
  0x6F56B: leave    
  0x6F56C: retf     

======================================================================
FUNCTION 073 at overlay+0x4EF19 (file 0x6F57E), 21 bytes
  Tags: RANDOM
======================================================================
  0x6F57E: push     bp
  0x6F57F: mov      bp, sp
  0x6F581: push     ax
  0x6F582: mov      ax, 1
  0x6F585: sub      word ptr [bp - 2], ax
  0x6F588: mov      cl, byte ptr [bp - 2]
  0x6F58B: shl      ax, cl
  0x6F58D: and      ax, word ptr [0x1f54]  ; rand() & 31 = 1/32 probability
  0x6F591: leave    
  0x6F592: retf     

======================================================================
FUNCTION 074 at overlay+0x4EF4B (file 0x6F5B0), 24 bytes
======================================================================
  0x6F5B0: push     bp
  0x6F5B1: mov      bp, sp
  0x6F5B3: mov      ax, word ptr [bp + 8]
  0x6F5B6: mov      word ptr [0x1f5c], ax
  0x6F5B9: lea      bx, [0x87c]
  0x6F5BD: mov      ax, word ptr [bp + 6]
  0x6F5C0: sub      dx, dx
  0x6F5C2: push     cs
  0x6F5C3: call     0x6f7ef
  0x6F5C6: leave    
  0x6F5C7: retf     

======================================================================
FUNCTION 075 at overlay+0x4EF75 (file 0x6F5DA), 24 bytes
======================================================================
  0x6F5DA: push     bp
  0x6F5DB: mov      bp, sp
  0x6F5DD: mov      word ptr [0x1f5c], 8
  0x6F5E3: lea      bx, [0x87c]
  0x6F5E7: mov      ax, word ptr [bp + 6]
  0x6F5EA: sub      dx, dx
  0x6F5EC: push     cs
  0x6F5ED: call     0x6f7ef
  0x6F5F0: leave    
  0x6F5F1: retf     

======================================================================
FUNCTION 076 at overlay+0x4EF8D (file 0x6F5F2), 24 bytes
======================================================================
  0x6F5F2: push     bp
  0x6F5F3: mov      bp, sp
  0x6F5F5: mov      ax, word ptr [bp + 8]
  0x6F5F8: mov      word ptr [0x1f5e], ax
  0x6F5FB: lea      bx, [0x87c]
  0x6F5FF: mov      ax, word ptr [bp + 6]
  0x6F602: sub      dx, dx
  0x6F604: push     cs
  0x6F605: call     0x6f7ef
  0x6F608: leave    
  0x6F609: retf     

======================================================================
FUNCTION 077 at overlay+0x4EFB7 (file 0x6F61C), 24 bytes
======================================================================
  0x6F61C: push     bp
  0x6F61D: mov      bp, sp
  0x6F61F: mov      ax, word ptr [bp + 8]
  0x6F622: mov      word ptr [0x1f60], ax
  0x6F625: lea      bx, [0x87c]
  0x6F629: mov      ax, word ptr [bp + 6]
  0x6F62C: sub      dx, dx
  0x6F62E: push     cs
  0x6F62F: call     0x6f7ef
  0x6F632: leave    
  0x6F633: retf     

======================================================================
FUNCTION 078 at overlay+0x4F78B (file 0x6FDF0), 44 bytes
======================================================================
  0x6FDF0: push     bp
  0x6FDF1: mov      bp, sp
  0x6FDF3: imul     ax, word ptr [bp + 6], 0x4c
  0x6FDF7: add      ax, 0xa
  0x6FDFA: mov      bx, word ptr [bp + 0xa]
  0x6FDFD: mov      word ptr [bx], ax
  0x6FDFF: cmp      word ptr [bp + 8], 1
  0x6FE03: jle      0x6fe0a
  0x6FE05: mov      ax, 0xffff
  0x6FE08: jmp      0x6fe0c
  0x6FE0A: sub      ax, ax
  0x6FE0C: imul     cx, word ptr [bp + 8], 0x3c
  0x6FE10: add      ax, cx
  0x6FE12: add      ax, 0x10
  0x6FE15: mov      bx, word ptr [bp + 0xc]  ; PowerRecord.congress_progress
  0x6FE18: mov      word ptr [bx], ax
  0x6FE1A: leave    
  0x6FE1B: retf     

======================================================================
FUNCTION 079 at overlay+0x52613 (file 0x72C78), 44 bytes
======================================================================
  0x72C78: push     bp
  0x72C79: mov      bp, sp
  0x72C7B: push     0x20e2
  0x72C7E: push     word ptr [bp + 6]
  0x72C81: lcall    0xd1d, 0x7e4
  0x72C86: mov      sp, bp
  0x72C88: push     ds
  0x72C89: push     word ptr [bp + 6]
  0x72C8C: mov      ax, word ptr [bp + 8]
  0x72C8F: mov      dx, 2
  0x72C92: lcall    0x181f, 0xe9a
  0x72C97: push     0x20e9
  0x72C9A: push     word ptr [bp + 6]
  0x72C9D: lcall    0xd1d, 0x7a4
  0x72CA2: leave    
  0x72CA3: retf     

======================================================================
FUNCTION 080 at overlay+0x53F8B (file 0x745F0), 91 bytes
======================================================================
  0x745F0: push     bp
  0x745F1: mov      bp, sp
  0x745F3: push     di
  0x745F4: push     si
  0x745F5: mov      di, word ptr [bp + 6]
  0x745F8: lcall    0x191f, 0x91c
  0x745FD: lcall    0x1a1f, 0xb22
  0x74602: mov      bx, di
  0x74604: shl      bx, 4
  0x74607: mov      word ptr [bx + 0x2f74], ax
  0x7460B: mov      si, bx
  0x7460D: lcall    0x1a1f, 0x88a
  0x74612: mov      byte ptr [si + 0x2f76], al
  0x74616: lcall    0x1a1f, 0x88a
  0x7461B: mov      byte ptr [si + 0x2f77], al
  0x7461F: lcall    0x1a1f, 0x88a
  0x74624: mov      byte ptr [si + 0x2f78], al
  0x74628: lcall    0x1a1f, 0x88a
  0x7462D: mov      byte ptr [si + 0x2f79], al
  0x74631: sub      si, si
  0x74633: lcall    0x1a1f, 0x88a
  0x74638: mov      bx, di
  0x7463A: shl      bx, 4
  0x7463D: mov      byte ptr [bx + si + 0x2f7b], al
  0x74641: inc      si
  0x74642: cmp      si, 9
  0x74645: jl       0x74633
  0x74647: pop      si
  0x74648: pop      di
  0x74649: leave    
  0x7464A: retf     

======================================================================
FUNCTION 081 at overlay+0x53FE7 (file 0x7464C), 60 bytes
======================================================================
  0x7464C: push     bp
  0x7464D: mov      bp, sp
  0x7464F: push     bx
  0x74650: push     si
  0x74651: mov      cx, word ptr [bp + 6]
  0x74654: mov      si, ax
  0x74656: mov      ax, dx
  0x74658: mov      dx, si
  0x7465A: shl      si, 1
  0x7465C: add      si, dx
  0x7465E: shl      si, 2
  0x74661: mov      byte ptr [si - 0x707b], al
  0x74665: mov      al, byte ptr [bp - 2]
  0x74668: mov      byte ptr [si - 0x707c], al
  0x7466C: mov      al, byte ptr [bp + 8]
  0x7466F: mov      byte ptr [si - 0x707a], al
  0x74673: mov      ax, cx
  0x74675: mov      byte ptr [si - 0x7078], cl
  0x74679: mov      bx, cx
  0x7467B: mov      al, byte ptr [si - 0x7079]
  0x7467F: mov      byte ptr [bx - 0x729e], al
  0x74683: pop      si
  0x74684: leave    
  0x74685: retf     4

======================================================================
FUNCTION 082 at overlay+0x54023 (file 0x74688), 856 bytes
======================================================================
  0x74688: push     bp
  0x74689: mov      bp, sp
  0x7468B: push     bx
  0x7468C: push     si
  0x7468D: mov      cx, dx
  0x7468F: mov      si, word ptr [bp + 6]
  0x74692: mov      dx, si
  0x74694: shl      si, 1
  0x74696: add      si, dx
  0x74698: shl      si, 1
  0x7469A: mov      byte ptr [si - 0x6874], al
  0x7469E: mov      byte ptr [si - 0x6873], cl
  0x746A2: mov      al, byte ptr [bp + 0xa]
  0x746A5: mov      byte ptr [si - 0x6872], al
  0x746A9: mov      ax, word ptr [bp - 2]
  0x746AC: mov      word ptr [si - 0x6870], ax
  0x746B0: mov      al, byte ptr [bp + 8]
  0x746B3: mov      byte ptr [si - 0x6871], al
  0x746B7: pop      si
  0x746B8: leave    
  0x746B9: retf     6
  0x746BC: push     1
  0x746BE: push     0
  0x746C0: sub      ax, ax
  0x746C2: mov      dx, 0xffff
  0x746C5: mov      bx, dx
  0x746C7: push     cs
  0x746C8: call     0x76384
  0x746CB: push     2
  0x746CD: push     0
  0x746CF: mov      ax, 1
  0x746D2: cdq      
  0x746D3: mov      bx, 0xffff
  0x746D6: push     cs
  0x746D7: call     0x76384
  0x746DA: push     -1
  0x746DC: push     0
  0x746DE: mov      ax, 2
  0x746E1: mov      dx, 1
  0x746E4: mov      bx, 0xffff
  0x746E7: push     cs
  0x746E8: call     0x76384
  0x746EB: push     4
  0x746ED: push     1
  0x746EF: mov      ax, 3
  0x746F2: mov      dx, 0xffff
  0x746F5: mov      bx, dx
  0x746F7: push     cs
  0x746F8: call     0x76384
  0x746FB: push     5
  0x746FD: push     1
  0x746FF: mov      ax, 4
  0x74702: mov      dx, 3
  0x74705: mov      bx, 0xffff
  0x74708: push     cs
  0x74709: call     0x76384
  0x7470C: push     -1
  0x7470E: push     1
  0x74710: mov      ax, 5
  0x74713: mov      dx, 4
  0x74716: mov      bx, 0xffff
  0x74719: push     cs
  0x7471A: call     0x76384
  0x7471D: push     7
  0x7471F: push     2
  0x74721: mov      ax, 6
  0x74724: mov      dx, 0xffff
  0x74727: mov      bx, dx
  0x74729: push     cs
  0x7472A: call     0x76384
  0x7472D: push     8
  0x7472F: push     2
  0x74731: mov      ax, 7
  0x74734: mov      dx, 6
  0x74737: mov      bx, 0xffff
  0x7473A: push     cs
  0x7473B: call     0x76384
  0x7473E: push     -1
  0x74740: push     2
  0x74742: mov      ax, 8
  0x74745: mov      dx, 7
  0x74748: mov      bx, 0xffff
  0x7474B: push     cs
  0x7474C: call     0x76384
  0x7474F: push     -1
  0x74751: push     3
  0x74753: mov      ax, 9
  0x74756: mov      dx, 0xffff
  0x74759: mov      bx, dx
  0x7475B: push     cs
  0x7475C: call     0x76384
  0x7475F: push     0xb
  0x74761: push     3
  0x74763: mov      ax, 0xa
  0x74766: mov      dx, 9
  0x74769: mov      bx, 0xffff
  0x7476C: push     cs
  0x7476D: call     0x76384
  0x74770: push     -1
  0x74772: push     3
  0x74774: mov      ax, 0xb
  0x74777: mov      dx, 0xa
  0x7477A: mov      bx, 0xffff
  0x7477D: push     cs
  0x7477E: call     0x76384
  0x74781: push     0x1f
  0x74783: push     3
  0x74785: mov      ax, 0x1e
  0x74788: mov      dx, 0xb
  0x7478B: mov      bx, 0xffff
  0x7478E: push     cs
  0x7478F: call     0x76384
  0x74792: push     -1
  0x74794: push     3
  0x74796: mov      ax, 0x1f
  0x74799: mov      dx, 0x1e
  0x7479C: mov      bx, 0xffff
  0x7479F: push     cs
  0x747A0: call     0x76384
  0x747A3: push     0xd
  0x747A5: push     4
  0x747A7: mov      ax, 0xc
  0x747AA: mov      dx, 0xffff
  0x747AD: mov      bx, dx
  0x747AF: push     cs
  0x747B0: call     0x76384
  0x747B3: push     0xe
  0x747B5: push     4
  0x747B7: mov      ax, 0xd
  0x747BA: mov      dx, 0xc
  0x747BD: mov      bx, 0xffff
  0x747C0: push     cs
  0x747C1: call     0x76384
  0x747C4: push     -1
  0x747C6: push     4
  0x747C8: mov      ax, 0xe
  0x747CB: mov      dx, 0xd
  0x747CE: mov      bx, 0xffff
  0x747D1: push     cs
  0x747D2: call     0x76384
  0x747D5: push     0x10
  0x747D7: push     5
  0x747D9: mov      ax, 0xf
  0x747DC: mov      dx, 0xffff
  0x747DF: mov      bx, dx
  0x747E1: push     cs
  0x747E2: call     0x76384
  0x747E5: push     -1
  0x747E7: push     5
  0x747E9: mov      ax, 0x10
  0x747EC: mov      dx, 0xf
  0x747EF: mov      bx, 0xffff
  0x747F2: push     cs
  0x747F3: call     0x76384
  0x747F6: push     -1
  0x747F8: push     5
  0x747FA: mov      ax, 0x11
  0x747FD: mov      dx, 0xffff
  0x74800: mov      bx, dx
  0x74802: push     cs
  0x74803: call     0x76384
  0x74806: push     -1
  0x74808: push     6
  0x7480A: mov      ax, 0x12
  0x7480D: mov      dx, 0xffff
  0x74810: mov      bx, dx
  0x74812: push     cs
  0x74813: call     0x76384
  0x74816: push     0x14
  0x74818: push     7
  0x7481A: mov      ax, 0x13
  0x7481D: mov      dx, 0xffff
  0x74820: mov      bx, dx
  0x74822: push     cs
  0x74823: call     0x76384
  0x74826: push     -1
  0x74828: push     7
  0x7482A: mov      ax, 0x14
  0x7482D: mov      dx, 0x13
  0x74830: mov      bx, 0xffff
  0x74833: push     cs
  0x74834: call     0x76384
  0x74837: push     0x16
  0x74839: push     8
  0x7483B: mov      ax, 0x15
  0x7483E: mov      dx, 0xffff
  0x74841: mov      bx, dx
  0x74843: push     cs
  0x74844: call     0x76384
  0x74847: push     0x17
  0x74849: push     8
  0x7484B: mov      ax, 0x16
  0x7484E: mov      dx, 0x15
  0x74851: mov      bx, 0xffff
  0x74854: push     cs
  0x74855: call     0x76384
  0x74858: push     -1
  0x7485A: push     8
  0x7485C: mov      ax, 0x17
  0x7485F: mov      dx, 0x16
  0x74862: mov      bx, 0xffff
  0x74865: push     cs
  0x74866: call     0x76384
  0x74869: push     0x19
  0x7486B: push     9
  0x7486D: mov      ax, 0x18
  0x74870: mov      dx, 0xffff
  0x74873: mov      bx, dx
  0x74875: push     cs
  0x74876: call     0x76384
  0x74879: push     0x1a
  0x7487B: push     9
  0x7487D: mov      ax, 0x19
  0x74880: mov      dx, 0x18
  0x74883: mov      bx, 0xffff
  0x74886: push     cs
  0x74887: call     0x76384
  0x7488A: push     -1
  0x7488C: push     9
  0x7488E: mov      ax, 0x1a
  0x74891: mov      dx, 0x19
  0x74894: mov      bx, 0xffff
  0x74897: push     cs
  0x74898: call     0x76384
  0x7489B: push     0x1c
  0x7489D: push     0xa
  0x7489F: mov      ax, 0x1b
  0x748A2: mov      dx, 0xffff
  0x748A5: mov      bx, dx
  0x748A7: push     cs
  0x748A8: call     0x76384
  0x748AB: push     0x1d
  0x748AD: push     0xa
  0x748AF: mov      ax, 0x1c
  0x748B2: mov      dx, 0x1b
  0x748B5: mov      bx, 0xffff
  0x748B8: push     cs
  0x748B9: call     0x76384
  0x748BC: push     -1
  0x748BE: push     0xa
  0x748C0: mov      ax, 0x1d
  0x748C3: mov      dx, 0x1c
  0x748C6: mov      bx, 0xffff
  0x748C9: push     cs
  0x748CA: call     0x76384
  0x748CD: push     0x21
  0x748CF: push     0xb
  0x748D1: mov      ax, 0x20
  0x748D4: mov      dx, 0xffff
  0x748D7: mov      bx, dx
  0x748D9: push     cs
  0x748DA: call     0x76384
  0x748DD: push     0x22
  0x748DF: push     0xb
  0x748E1: mov      ax, 0x21
  0x748E4: mov      dx, 0x20
  0x748E7: mov      bx, 0xffff
  0x748EA: push     cs
  0x748EB: call     0x76384
  0x748EE: push     -1
  0x748F0: push     0xb
  0x748F2: mov      ax, 0x22
  0x748F5: mov      dx, 0x21
  0x748F8: mov      bx, 0xffff
  0x748FB: push     cs
  0x748FC: call     0x76384
  0x748FF: push     0x24
  0x74901: push     0xc
  0x74903: mov      ax, 0x23
  0x74906: mov      dx, 0xffff
  0x74909: mov      bx, dx
  0x7490B: push     cs
  0x7490C: call     0x76384
  0x7490F: push     -1
  0x74911: push     0xc
  0x74913: mov      ax, 0x24
  0x74916: mov      dx, 0x23
  0x74919: mov      bx, 0xffff
  0x7491C: push     cs
  0x7491D: call     0x76384
  0x74920: push     0x26
  0x74922: push     0xd
  0x74924: mov      ax, 0x25
  0x74927: mov      dx, 0xffff
  0x7492A: mov      bx, dx
  0x7492C: push     cs
  0x7492D: call     0x76384
  0x74930: push     -1
  0x74932: push     0xd
  0x74934: mov      ax, 0x26
  0x74937: mov      dx, 0x25
  0x7493A: mov      bx, 0xffff
  0x7493D: push     cs
  0x7493E: call     0x76384
  0x74941: push     0x28
  0x74943: push     0xe
  0x74945: mov      ax, 0x27
  0x74948: mov      dx, 0xffff
  0x7494B: mov      bx, dx
  0x7494D: push     cs
  0x7494E: call     0x76384
  0x74951: push     0x29
  0x74953: push     0xe
  0x74955: mov      ax, 0x28
  0x74958: mov      dx, 0x27
  0x7495B: mov      bx, 0xffff
  0x7495E: push     cs
  0x7495F: call     0x76384
  0x74962: push     -1
  0x74964: push     0xe
  0x74966: mov      ax, 0x29
  0x74969: mov      dx, 0x28
  0x7496C: mov      bx, 0xffff
  0x7496F: push     cs
  0x74970: call     0x76384
  0x74973: push     2
  0x74975: push     -1
  0x74977: push     0
  0x74979: sub      ax, ax
  0x7497B: mov      dx, 0xb
  0x7497E: mov      bx, 0x1f4
  0x74981: push     cs
  0x74982: call     0x7638e
  0x74985: push     2
  0x74987: push     -1
  0x74989: push     1
  0x7498B: sub      ax, ax
  0x7498D: mov      dx, 0xd
  0x74990: mov      bx, 0x3e8
  0x74993: push     cs
  0x74994: call     0x7638e
  0x74997: push     4
  0x74999: push     -1
  0x7499B: push     2
  0x7499D: sub      ax, ax
  0x7499F: mov      dx, 0xe
  0x749A2: mov      bx, 0x7d0
  0x749A5: push     cs
  0x749A6: call     0x7638e
  0x749A9: push     6
  0x749AB: push     -1
  0x749AD: push     3
  0x749AF: sub      ax, ax
  0x749B1: mov      dx, 0xf
  0x749B4: mov      bx, 0xbb8
  0x749B7: push     cs
  0x749B8: call     0x7638e
  0x749BB: push     3
  0x749BD: push     -1
  0x749BF: push     4
  0x749C1: sub      ax, ax
  0x749C3: mov      dx, 0x10
  0x749C6: mov      bx, 0x7d0
  0x749C9: push     cs
  0x749CA: call     0x7638e
  0x749CD: push     8
  0x749CF: push     -1
  0x749D1: push     5
  0x749D3: sub      ax, ax
  0x749D5: mov      dx, 0x11
  0x749D8: mov      bx, 0x1388
  0x749DB: push     cs
  0x749DC: call     0x7638e
  0x749DF: retf     

======================================================================
FUNCTION 083 at overlay+0x569F5 (file 0x7705A), 18 bytes
======================================================================
  0x7705A: push     bp
  0x7705B: mov      bp, sp
  0x7705D: push     si
  0x7705E: mov      bx, ax
  0x77060: les      si, ptr [bp + 6]
  0x77063: mov      byte ptr es:[si + 0x2b], bl
  0x77067: pop      si
  0x77068: leave    
  0x77069: retf     4

======================================================================
FUNCTION 084 at overlay+0x56A07 (file 0x7706C), 590 bytes
======================================================================
  0x7706C: push     bp
  0x7706D: mov      bp, sp
  0x7706F: push     di
  0x77070: push     si
  0x77071: les      si, ptr [bp + 6]
  0x77074: sub      di, di
  0x77076: cmp      word ptr es:[si], di
  0x77079: je       0x770f0
  0x7707B: cmp      byte ptr es:[si + 4], 1
  0x77080: je       0x770da
  0x77082: cmp      byte ptr es:[si + 4], 2
  0x77087: je       0x770da
  0x77089: cmp      word ptr es:[si + 2], di
  0x7708D: jne      0x770c8
  0x7708F: push     word ptr es:[si + 6]
  0x77093: mov      di, es
  0x77095: lcall    0xd1d, 0xad8
  0x7709A: add      sp, 2
  0x7709D: mov      ax, si
  0x7709F: mov      dx, di
  0x770A1: add      ax, 0x1a
  0x770A4: push     dx
  0x770A5: push     ax
  0x770A6: push     0
  0x770A8: push     1
  0x770AA: mov      es, di
  0x770AC: mov      bx, si
  0x770AE: mov      bx, word ptr es:[bx + 6]
  0x770B2: mov      ax, 0xb0
  0x770B5: cdq      
  0x770B6: lcall    0x1a1f, 0xc9c
  0x770BB: or       dx, ax
  0x770BD: jne      0x770c6
  0x770BF: mov      di, 1
  0x770C2: jmp      0x770c8
  0x770C4: nop      
  0x770C5: nop      
  0x770C6: sub      di, di
  0x770C8: mov      es, word ptr [bp + 8]
  0x770CB: push     word ptr es:[si + 6]
  0x770CF: lcall    0xd1d, 0x3f4
  0x770D4: add      sp, 2
  0x770D7: jmp      0x770f0
  0x770D9: nop      
  0x770DA: mov      word ptr es:[si + 0x10], 0xffff  ; PowerRecord.crosses
  0x770E0: mov      word ptr es:[si + 0x12], 0x4000
  0x770E6: sub      ax, ax
  0x770E8: mov      word ptr es:[si + 0xe], ax  ; PowerRecord.liberty_bells
  0x770EC: mov      word ptr es:[si + 0xc], ax  ; PowerRecord.congress_progress
  0x770F0: mov      es, word ptr [bp + 8]
  0x770F3: mov      word ptr es:[si], 0
  0x770F8: mov      ax, di
  0x770FA: pop      si
  0x770FB: pop      di
  0x770FC: leave    
  0x770FD: retf     4
  0x77100: enter    0x20, 0
  0x77104: push     dx
  0x77105: push     ax
  0x77106: push     di
  0x77107: push     si
  0x77108: sub      ax, ax
  0x7710A: mov      word ptr [bp - 0xc], ax
  0x7710D: mov      word ptr [bp - 0xe], ax
  0x77110: mov      word ptr [bp - 0x16], ax
  0x77113: mov      word ptr [bp - 0x18], ax
  0x77116: mov      word ptr [bp - 0x14], ax
  0x77119: mov      ax, dx
  0x7711B: or       ax, word ptr [bp - 0x24]
  0x7711E: jne      0x7712a
  0x77120: sub      ax, ax
  0x77122: sub      dx, dx
  0x77124: pop      si
  0x77125: pop      di
  0x77126: leave    
  0x77127: retf     0xc
  0x7712A: cmp      word ptr [bp + 0xa], 1
  0x7712E: jne      0x7713c
  0x77130: cmp      word ptr [bp + 0xc], 0  ; PowerRecord.congress_progress
  0x77134: jne      0x7713c
  0x77136: mov      ax, word ptr [bp - 0x24]
  0x77139: jmp      0x7714b
  0x7713B: nop      
  0x7713C: push     dx
  0x7713D: push     word ptr [bp - 0x24]
  0x77140: push     word ptr [bp + 0xc]  ; PowerRecord.congress_progress
  0x77143: push     word ptr [bp + 0xa]
  0x77146: lcall    0xd1d, 0xf60
  0x7714B: mov      word ptr [bp - 4], ax
  0x7714E: mov      word ptr [bp - 2], dx
  0x77151: les      si, ptr [bp + 6]
  0x77154: mov      di, word ptr es:[si + 0x18]
  0x77158: inc      word ptr es:[si + 0x18]
  0x7715C: cmp      byte ptr es:[si + 4], 1
  0x77161: je       0x77172
  0x77163: cmp      byte ptr es:[si + 4], 2
  0x77168: jne      0x77178
  0x7716A: sub      ax, ax
  0x7716C: mov      word ptr [bp - 0xc], ax
  0x7716F: mov      word ptr [bp - 0xe], ax
  0x77172: mov      di, word ptr [bp - 0x18]
  0x77175: jmp      0x77279
  0x77178: sub      ax, ax
  0x7717A: mov      word ptr [bp - 0xc], ax
  0x7717D: mov      word ptr [bp - 0xe], ax
  0x77180: mov      bx, si
  0x77182: mov      ax, di
  0x77184: shl      ax, 2
  0x77187: add      ax, di
  0x77189: shl      ax, 1
  0x7718B: add      bx, ax
  0x7718D: mov      al, byte ptr es:[bx + 0x2a]  ; PowerRecord.gold
  0x77191: sub      ah, ah
  0x77193: mov      word ptr [0x26ca], ax
  0x77196: mov      cx, word ptr es:[bx + 0x30]
  0x7719A: mov      dx, word ptr es:[bx + 0x32]
  0x7719E: mov      word ptr [bp - 8], cx
  0x771A1: mov      word ptr [bp - 6], dx
  0x771A4: cmp      ax, 1
  0x771A7: sbb      ax, ax
  0x771A9: and      ax, 1
  0x771AC: inc      ax
  0x771AD: mov      word ptr [bp - 0xa], ax
  0x771B0: dec      ax
  0x771B1: je       0x771b6
  0x771B3: jmp      0x772a0
  0x771B6: mov      ax, cx
  0x771B8: lcall    0x181f, 0x29a
  0x771BD: mov      di, ax
  0x771BF: mov      word ptr [bp - 0x16], dx
  0x771C2: or       dx, ax
  0x771C4: je       0x7720e
  0x771C6: push     word ptr [bp - 0x16]
  0x771C9: push     di
  0x771CA: push     0
  0x771CC: push     1
  0x771CE: mov      es, word ptr [bp + 8]
  0x771D1: mov      bx, word ptr es:[si + 6]
  0x771D5: mov      ax, word ptr [bp - 8]
  0x771D8: mov      dx, word ptr [bp - 6]
  0x771DB: lcall    0x1a1f, 0xcb4
  0x771E0: or       dx, ax
  0x771E2: jne      0x771e7
  0x771E4: jmp      0x77279
  0x771E7: push     word ptr [bp - 2]
  0x771EA: push     word ptr [bp - 4]
  0x771ED: push     word ptr [bp - 0x16]
  0x771F0: push     di
  0x771F1: push     word ptr [bp + 0x10]  ; PowerRecord.crosses
  0x771F4: push     word ptr [bp + 0xe]  ; PowerRecord.liberty_bells
  0x771F7: mov      ax, word ptr [bp - 0xa]
  0x771FA: sub      dx, dx
  0x771FC: sub      bx, bx
  0x771FE: lcall    0x1a1f, 0xeba
  0x77203: mov      word ptr [bp - 0xe], ax
  0x77206: mov      word ptr [bp - 0xc], dx
  0x77209: mov      word ptr [bp - 0x14], 1
  0x7720E: cmp      word ptr [bp - 0x14], 0
  0x77212: jne      0x77279
  0x77214: lea      ax, [bp - 0x1c]
  0x77217: push     ax
  0x77218: mov      es, word ptr [bp + 8]
  0x7721B: push     word ptr es:[si + 6]
  0x7721F: mov      word ptr [bp - 0x20], si
  0x77222: mov      word ptr [bp - 0x1e], es
  0x77225: lcall    0xd1d, 0x9a2
  0x7722A: add      sp, 4
  0x7722D: push     word ptr [bp - 2]
  0x77230: push     word ptr [bp - 4]
  0x77233: les      bx, ptr [bp - 0x20]
  0x77236: push     ds
  0x77237: push     word ptr es:[bx + 6]
  0x7723B: push     word ptr [bp + 0x10]  ; PowerRecord.crosses
  0x7723E: push     word ptr [bp + 0xe]  ; PowerRecord.liberty_bells
  0x77241: mov      ax, word ptr [bp - 0xa]
  0x77244: mov      dx, 1
  0x77247: sub      bx, bx
  0x77249: lcall    0x1a1f, 0xeba
  0x7724E: mov      word ptr [bp - 0xe], ax
  0x77251: mov      word ptr [bp - 0xc], dx
  0x77254: cmp      word ptr [bp - 0xa], 1
  0x77258: jne      0x77279
  0x7725A: push     0
  0x7725C: mov      ax, word ptr [bp - 8]
  0x7725F: mov      dx, word ptr [bp - 6]
  0x77262: add      ax, word ptr [bp - 0x1c]
  0x77265: adc      dx, word ptr [bp - 0x1a]
  0x77268: push     dx
  0x77269: push     ax
  0x7726A: mov      es, word ptr [bp + 8]
  0x7726D: push     word ptr es:[si + 6]
  0x77271: lcall    0xd1d, 0xa3e
  0x77276: add      sp, 8
  0x77279: mov      ax, word ptr [bp - 0x16]
  0x7727C: or       ax, di
  0x7727E: je       0x7728a
  0x77280: mov      ax, word ptr [bp - 0x16]
  0x77283: push     ax
  0x77284: push     di
  0x77285: lcall    0x191f, 0x1a8
  0x7728A: mov      ax, word ptr [bp - 0xe]
  0x7728D: mov      dx, word ptr [bp - 0xc]
  0x77290: cmp      word ptr [bp - 0x24], ax
  0x77293: jne      0x772a6
  0x77295: cmp      word ptr [bp - 0x22], dx
  0x77298: jne      0x772a6
  0x7729A: mov      ax, 1
  0x7729D: jmp      0x77122
  0x772A0: mov      di, word ptr [bp - 0x18]
  0x772A3: jmp      0x7720e
  0x772A6: push     word ptr [bp - 0x22]
  0x772A9: push     word ptr [bp - 0x24]
  0x772AC: push     dx
  0x772AD: push     ax
  0x772AE: lcall    0xd1d, 0xec6
  0x772B3: pop      si
  0x772B4: pop      di
  0x772B5: leave    
  0x772B6: retf     0xc
  0x772B9: nop      

======================================================================
FUNCTION 085 at overlay+0x56C55 (file 0x772BA), 8 bytes
======================================================================
  0x772BA: push     bp
  0x772BB: mov      bp, sp
  0x772BD: les      bx, ptr [bp + 6]
  0x772C0: mov      ax, bx

======================================================================
FUNCTION 086 at overlay+0x56C5F (file 0x772C4), 21 bytes
======================================================================
  0x772C4: push     bp
  0x772C5: mov      bp, sp
  0x772C7: push     di
  0x772C8: les      di, ptr [0x245e]
  0x772CC: mov      ax, es
  0x772CE: or       ax, di
  0x772D0: je       0x772d6
  0x772D2: lcall    [0x245e]
  0x772D6: pop      di
  0x772D7: leave    
  0x772D8: retf     

======================================================================
FUNCTION 087 at overlay+0x56C75 (file 0x772DA), 31 bytes
======================================================================
  0x772DA: push     bp
  0x772DB: mov      bp, sp
  0x772DD: mov      ax, word ptr [bp + 6]
  0x772E0: mov      dx, word ptr [bp + 8]
  0x772E3: mov      word ptr [0x245a], ax
  0x772E6: mov      word ptr [0x245c], dx
  0x772EA: mov      ax, word ptr [bp + 0xa]
  0x772ED: mov      dx, word ptr [bp + 0xc]  ; PowerRecord.congress_progress
  0x772F0: mov      word ptr [0x245e], ax
  0x772F3: mov      word ptr [0x2460], dx
  0x772F7: leave    
  0x772F8: retf     

======================================================================
FUNCTION 088 at overlay+0x57479 (file 0x77ADE), 49 bytes
======================================================================
  0x77ADE: push     bp
  0x77ADF: mov      bp, sp
  0x77AE1: lcall    0x181f, 0x5e2
  0x77AE6: or       ax, ax
  0x77AE8: je       0x77af8
  0x77AEA: push     0
  0x77AEC: lcall    0x181f, 0x4de
  0x77AF1: mov      sp, bp
  0x77AF3: lcall    0x181f, 0x5d8
  0x77AF8: lcall    0x181f, 0x5ce
  0x77AFD: push     3
  0x77AFF: push     0
  0x77B01: lcall    0x181f, 0x5c4
  0x77B06: mov      sp, bp
  0x77B08: mov      ax, 3
  0x77B0B: int      0x10
  0x77B0D: leave    
  0x77B0E: retf     

======================================================================
FUNCTION 089 at overlay+0x57ADD (file 0x78142), 66 bytes
======================================================================
  0x78142: push     bp
  0x78143: mov      bp, sp
  0x78145: push     ds
  0x78146: push     word ptr [bp + 6]
  0x78149: push     0
  0x7814B: lcall    0x181f, 0x416
  0x78150: mov      sp, bp
  0x78152: mov      ax, word ptr [bp + 8]
  0x78155: cdq      
  0x78156: mov      word ptr [0x9cb0], ax
  0x78159: mov      word ptr [0x9cb2], dx
  0x7815D: mov      ax, word ptr [bp + 0xa]
  0x78160: cdq      
  0x78161: mov      word ptr [0x9cb4], ax
  0x78164: mov      word ptr [0x9cb6], dx
  0x78168: mov      ax, word ptr [bp + 0xc]  ; PowerRecord.congress_progress
  0x7816B: cdq      
  0x7816C: mov      word ptr [0x9cb8], ax
  0x7816F: mov      word ptr [0x9cba], dx
  0x78173: lea      bx, [0x25bb]
  0x78177: lea      ax, [0x25b4]
  0x7817B: sub      dx, dx
  0x7817D: lcall    0x181f, 0x998
  0x78182: leave    
  0x78183: retf     

======================================================================
FUNCTION 090 at overlay+0x57BDD (file 0x78242), 39 bytes
======================================================================
  0x78242: push     bp
  0x78243: mov      bp, sp
  0x78245: push     di
  0x78246: push     si
  0x78247: push     ds
  0x78248: les      di, ptr [bp + 0xa]
  0x7824B: lds      si, ptr [bp + 6]
  0x7824E: mov      cx, 0x300
  0x78251: lodsb    al, byte ptr [si]
  0x78252: push     cx
  0x78253: mov      cx, word ptr [bp + 0xe]  ; PowerRecord.liberty_bells
  0x78256: shr      al, cl
  0x78258: pop      cx
  0x78259: adc      al, 0
  0x7825B: or       al, al
  0x7825D: jne      0x78261
  0x7825F: inc      al
  0x78261: stosb    byte ptr es:[di], al
  0x78262: loop     0x78251
  0x78264: pop      ds
  0x78265: pop      si
  0x78266: pop      di
  0x78267: leave    
  0x78268: retf     

======================================================================
FUNCTION 091 at overlay+0x57EE3 (file 0x78548), 49 bytes
======================================================================
  0x78548: push     bp
  0x78549: mov      bp, sp
  0x7854B: push     di
  0x7854C: push     si
  0x7854D: mov      word ptr [0x808], 1
  0x78553: mov      bx, 0x40
  0x78556: mov      si, 0x300
  0x78559: les      di, ptr [bp + 6]
  0x7855C: mov      dx, 0x3c7
  0x7855F: xor      al, al
  0x78561: out      dx, al
  0x78562: mov      dx, 0x3da
  0x78565: mov      ah, 8
  0x78567: in       al, dx
  0x78568: and      al, ah
  0x7856A: jne      0x78567
  0x7856C: in       al, dx
  0x7856D: and      al, ah
  0x7856F: je       0x7856c
  0x78571: cli      
  0x78572: mov      dx, 0x3c9
  0x78575: mov      cx, si
  0x78577: cmp      cx, bx

======================================================================
FUNCTION 092 at overlay+0x58099 (file 0x786FE), 164 bytes
======================================================================
  0x786FE: push     bp
  0x786FF: mov      bp, sp
  0x78701: push     bx
  0x78702: push     si
  0x78703: mov      si, ax
  0x78705: lea      ax, [bp + 8]
  0x78708: push     ax
  0x78709: lea      ax, [bp + 6]
  0x7870C: push     ax
  0x7870D: mov      bx, word ptr [bp - 2]
  0x78710: lea      ax, [bp + 0xc]  ; PowerRecord.congress_progress
  0x78713: lea      dx, [bp + 0xa]
  0x78716: lcall    0x181f, 0xecc
  0x7871B: or       ax, ax
  0x7871D: jne      0x7879c
  0x7871F: mov      ax, si
  0x78721: sub      ax, 0xffed
  0x78724: jl       0x7879c
  0x78726: sub      ax, 9
  0x78729: jle      0x78736
  0x7872B: sub      ax, 9
  0x7872E: je       0x7875a
  0x78730: pop      si
  0x78731: leave    
  0x78732: retf     8
  0x78735: nop      
  0x78736: push     word ptr [bp + 0xc]  ; PowerRecord.congress_progress
  0x78739: push     word ptr [bp + 0xa]
  0x7873C: push     word ptr [bp + 8]
  0x7873F: push     word ptr [bp + 6]
  0x78742: lea      ax, [si + 0xa]
  0x78745: not      ax
  0x78747: inc      ax
  0x78748: mov      bx, word ptr [bp - 2]
  0x7874B: mov      dx, word ptr [0x2622]
  0x7874F: lcall    0x1a1f, 0xf8c
  0x78754: pop      si
  0x78755: leave    
  0x78756: retf     8
  0x78759: nop      
  0x7875A: push     word ptr [0x2d2e]
  0x7875E: push     word ptr [0x2d2c]
  0x78762: push     word ptr [0x2d2a]
  0x78766: push     word ptr [0x2d28]
  0x7876A: mov      bx, word ptr [bp - 2]
  0x7876D: push     word ptr [bx + 6]
  0x78770: push     word ptr [bx + 4]
  0x78773: push     word ptr [bx + 2]
  0x78776: push     word ptr [bx]
  0x78778: push     word ptr [bp + 0xa]
  0x7877B: push     word ptr [bp + 8]
  0x7877E: push     word ptr [bp + 6]
  0x78781: sub      ax, ax
  0x78783: cdq      
  0x78784: mov      bx, word ptr [bp + 0xc]  ; PowerRecord.congress_progress
  0x78787: lcall    0x181f, 0x33a
  0x7878C: cmp      word ptr [0x2622], 0
  0x78791: jne      0x7879c
  0x78793: lea      bx, [0x2d28]
  0x78797: lcall    0x1a1f, 0xf7e
  0x7879C: pop      si
  0x7879D: leave    
  0x7879E: retf     8
  0x787A1: nop      

======================================================================
FUNCTION 093 at overlay+0x5813D (file 0x787A2), 38 bytes
======================================================================
  0x787A2: push     bp
  0x787A3: mov      bp, sp
  0x787A5: push     dx
  0x787A6: push     ax
  0x787A7: push     bx
  0x787A8: push     si
  0x787A9: mov      cx, ax
  0x787AB: mov      ax, dx
  0x787AD: mul      cx
  0x787AF: mov      si, bx
  0x787B1: lcall    0x181f, 0x29a
  0x787B6: mov      word ptr [si + 4], ax
  0x787B9: mov      word ptr [si + 6], dx
  0x787BC: mov      ax, dx
  0x787BE: or       ax, word ptr [si + 4]
  0x787C1: jne      0x787c8
  0x787C3: sub      ax, ax
  0x787C5: pop      si
  0x787C6: leave    
  0x787C7: retf     

======================================================================
FUNCTION 094 at overlay+0x58177 (file 0x787DC), 121 bytes
======================================================================
  0x787DC: push     bp
  0x787DD: mov      bp, sp
  0x787DF: push     dx
  0x787E0: push     ax
  0x787E1: push     bx
  0x787E2: push     si
  0x787E3: push     ds
  0x787E4: push     word ptr [bp + 6]
  0x787E7: mov      cx, ax
  0x787E9: mov      ax, dx
  0x787EB: mul      cx
  0x787ED: mov      si, bx
  0x787EF: lcall    0x1a1f, 0xe90
  0x787F4: mov      word ptr [si + 4], ax
  0x787F7: mov      word ptr [si + 6], dx
  0x787FA: mov      ax, dx
  0x787FC: or       ax, word ptr [si + 4]
  0x787FF: jne      0x78808
  0x78801: sub      ax, ax
  0x78803: pop      si
  0x78804: leave    
  0x78805: retf     2
  0x78808: mov      ax, word ptr [bp - 4]
  0x7880B: mov      bx, word ptr [bp - 6]
  0x7880E: mov      word ptr [bx + 2], ax
  0x78811: mov      ax, word ptr [bp - 2]
  0x78814: mov      word ptr [bx], ax
  0x78816: mov      ax, 0xffff
  0x78819: pop      si
  0x7881A: leave    
  0x7881B: retf     2
  0x7881E: enter    2, 0
  0x78822: push     bx
  0x78823: mov      word ptr [bp - 2], 0
  0x78828: mov      ax, word ptr [bx + 6]
  0x7882B: or       ax, word ptr [bx + 4]
  0x7882E: je       0x78840
  0x78830: push     word ptr [bx + 6]
  0x78833: push     word ptr [bx + 4]
  0x78836: lcall    0x191f, 0x1a8
  0x7883B: mov      word ptr [bp - 2], 0xffff
  0x78840: mov      bx, word ptr [bp - 4]
  0x78843: sub      ax, ax
  0x78845: mov      word ptr [bx + 6], ax
  0x78848: mov      word ptr [bx + 4], ax
  0x7884B: mov      word ptr [bx + 2], ax
  0x7884E: mov      word ptr [bx], ax
  0x78850: mov      ax, word ptr [bp - 2]
  0x78853: leave    
  0x78854: retf     

======================================================================
FUNCTION 095 at overlay+0x581F1 (file 0x78856), 28 bytes
======================================================================
  0x78856: push     bp
  0x78857: mov      bp, sp
  0x78859: mov      ax, word ptr [bp + 6]
  0x7885C: or       ax, word ptr [bp + 8]
  0x7885F: je       0x78870
  0x78861: mov      word ptr [0x2672], 1
  0x78867: lcall    [bp + 6]
  0x7886A: mov      word ptr [0x2672], 0
  0x78870: leave    
  0x78871: retf     

======================================================================
FUNCTION 096 at overlay+0x5848D (file 0x78AF2), 23 bytes
======================================================================
  0x78AF2: push     bp
  0x78AF3: mov      bp, sp
  0x78AF5: mov      ah, 0x48
  0x78AF7: mov      bx, 0xffff
  0x78AFA: int      0x21
  0x78AFC: xor      dh, dh
  0x78AFE: mov      dl, bh
  0x78B00: shl      dx, 4
  0x78B03: mov      dl, dh
  0x78B05: xor      dh, dh
  0x78B07: mov      ax, bx

======================================================================
FUNCTION 097 at overlay+0x58569 (file 0x78BCE), 62 bytes
======================================================================
  0x78BCE: push     bp
  0x78BCF: mov      bp, sp
  0x78BD1: les      bx, ptr [bp + 0xe]  ; PowerRecord.liberty_bells
  0x78BD4: mov      byte ptr es:[bx + 1], 0
  0x78BD9: mov      byte ptr es:[bx], al
  0x78BDC: mov      ax, word ptr [bp + 0xa]
  0x78BDF: mov      dx, word ptr [bp + 0xc]  ; PowerRecord.congress_progress
  0x78BE2: mov      word ptr es:[bx + 6], ax
  0x78BE6: mov      word ptr es:[bx + 8], dx
  0x78BEA: mov      word ptr es:[bx + 2], ax
  0x78BEE: mov      word ptr es:[bx + 4], dx
  0x78BF2: mov      ax, word ptr [bp + 6]
  0x78BF5: mov      dx, word ptr [bp + 8]
  0x78BF8: mov      word ptr es:[bx + 0xe], ax  ; PowerRecord.liberty_bells
  0x78BFC: mov      word ptr es:[bx + 0x10], dx  ; PowerRecord.crosses
  0x78C00: mov      word ptr es:[bx + 0xa], ax
  0x78C04: mov      word ptr es:[bx + 0xc], dx  ; PowerRecord.congress_progress
  0x78C08: leave    
  0x78C09: retf     0xc

======================================================================
FUNCTION 098 at overlay+0x585A7 (file 0x78C0C), 108 bytes
======================================================================
  0x78C0C: push     bp
  0x78C0D: mov      bp, sp
  0x78C0F: les      bx, ptr [bp + 6]
  0x78C12: cmp      byte ptr es:[bx + 1], 0
  0x78C17: je       0x78c26
  0x78C19: push     word ptr es:[bx + 4]
  0x78C1D: push     word ptr es:[bx + 2]
  0x78C21: lcall    0x191f, 0x1a8
  0x78C26: les      bx, ptr [bp + 6]
  0x78C29: sub      ax, ax
  0x78C2B: mov      word ptr es:[bx + 4], ax
  0x78C2F: mov      word ptr es:[bx + 2], ax
  0x78C33: mov      word ptr es:[bx + 0x10], ax  ; PowerRecord.crosses
  0x78C37: mov      word ptr es:[bx + 0xe], ax  ; PowerRecord.liberty_bells
  0x78C3B: mov      word ptr es:[bx + 0xc], ax  ; PowerRecord.congress_progress
  0x78C3F: mov      word ptr es:[bx + 0xa], ax
  0x78C43: leave    
  0x78C44: retf     4
  0x78C47: nop      
  0x78C48: enter    4, 0
  0x78C4C: push     dx
  0x78C4D: push     ax
  0x78C4E: sub      cx, cx
  0x78C50: mov      word ptr [bp - 2], cx
  0x78C53: mov      word ptr [bp - 4], cx
  0x78C56: les      bx, ptr [bp + 6]
  0x78C59: cmp      word ptr es:[bx + 0x10], dx  ; PowerRecord.crosses
  0x78C5D: jg       0x78c84
  0x78C5F: jl       0x78c67
  0x78C61: cmp      word ptr es:[bx + 0xe], ax  ; PowerRecord.liberty_bells
  0x78C65: jae      0x78c84
  0x78C67: push     dx
  0x78C68: push     ax
  0x78C69: push     word ptr es:[bx + 0x10]  ; PowerRecord.crosses
  0x78C6D: push     word ptr es:[bx + 0xe]  ; PowerRecord.liberty_bells
  0x78C71: mov      bl, byte ptr es:[bx]
  0x78C74: sub      bh, bh