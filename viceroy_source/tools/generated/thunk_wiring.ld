/* AUTO-GENERATED by tools/thunkwire.py -- do not edit.
 * Each thunk stub becomes the ADDRESS of its real ported target,
 * so the call site's own argument setup flows into the real body.
 * Arity-gated: only provably-safe aliases are emitted. */
PROVIDE(box_fill = func_00E76A_logic_sz_505);   /* exe:resident+name, arity 0 */
PROVIDE(box_show_191F_08F8_b = func_00DB80_op_sz_226);   /* exe:resident+name, arity 2 */
PROVIDE(cd_list_first_ok = func_0082B2_logic_sz_38);   /* exe:resident+name, arity 1 */
PROVIDE(colony_effect_id9 = ff_acquire_dispatch);   /* exe:resident+name, arity 2 */
PROVIDE(colony_event_82 = func_02EE34_logic_sz_12);   /* exe:overlay+name, arity 1 */
PROVIDE(colony_field_C86 = func_008524_colony_sz_18);   /* exe:resident+name, arity 0 */
PROVIDE(colony_helper_C5E_count = func_008D00_colony_stock_cap);   /* exe:resident+name, arity 0 */
PROVIDE(colony_load_pik_bg = func_00A994_colony_sz_293);   /* exe:resident+name, arity 0 */
PROVIDE(coronado_reveal = func_0063B6_logic_sz_14);   /* exe:resident+name, arity 2 */
PROVIDE(crt_memset = func_01037E_logic_sz_45);   /* direct+name, arity 3 */
PROVIDE(destroy_unit_808 = func_006E94_logic_sz_198);   /* exe:resident+name, arity 1 */
PROVIDE(display_flush = func_004D1E_op_sz_217);   /* exe:resident+name, arity 0 */
PROVIDE(ff_finish = func_067700_compose_active_tile);   /* exe:overlay+name, arity 1 */
PROVIDE(find_landing_slot = func_008D26_op_sz_69);   /* exe:resident+name, arity 2 */
PROVIDE(func_0613F0 = func_05FE60_set_active_tile_ptr);   /* exe:overlay+name, arity 1 */
PROVIDE(func_061413 = func_060382_tile_terrain_nibble);   /* exe:overlay+name, arity 1 */
PROVIDE(game_timer_ticks = func_00E4C6_read_far_dword_via_267A);   /* json+name, arity 0 */
PROVIDE(hof_present = func_004AFA_op_sz_28);   /* exe:resident+name, arity 0 */
PROVIDE(hud_begin = func_002544_logic_sz_60);   /* exe:resident+name, arity 1 */
PROVIDE(hud_print_74 = func_002632_tooltip_append_indexed);   /* exe:resident+name, arity 1 */
PROVIDE(hud_print_7e = func_002648_tooltip_append_int);   /* exe:resident+name, arity 1 */
PROVIDE(kbd_poll = func_00D286_logic_sz_15);   /* exe:resident+name, arity 0 */
PROVIDE(layer_ptr_aux = func_005D84_logic_sz_23);   /* exe:resident+name, arity 2 */
PROVIDE(layer_ptr_feature = func_005D1A_logic_sz_23);   /* exe:resident+name, arity 2 */
PROVIDE(layer_ptr_terrain = func_005CE6_logic_sz_24);   /* exe:resident+name, arity 2 */
PROVIDE(map_index = func_005E90_op_sz_64);   /* exe:resident+name, arity 2 */
PROVIDE(map_tile_notify_037F_228 = func_005E18_op_sz_120);   /* direct+name, arity 3 */
PROVIDE(map_tile_reveal_037F_598 = func_006188_op_sz_91);   /* direct+name, arity 2 */
PROVIDE(map_tile_set_occupant_037F_0A = func_005BFA_logic_sz_49);   /* direct+name, arity 2 */
PROVIDE(market_price = func_008110_logic_sz_14);   /* exe:resident+name, arity 1 */
PROVIDE(mn_colony_attr = func_009102);   /* exe:resident+name, arity 1 */
PROVIDE(mn_colony_field = func_0090C8);   /* exe:resident+name, arity 1 */
PROVIDE(names_read_int_byte = func_0787DC_calloc_far);   /* json+name, arity 0 */
PROVIDE(ov_colony_at_xy = func_005EE8_logic_sz_28);   /* exe:resident+name, arity 2 */
PROVIDE(ov_feature_flags_10E = func_005CFE_map_tile_read_layer_15C);   /* direct+name, arity 2 */
PROVIDE(ov_feature_flags_142 = func_005D32_map_tile_read_layer_160);   /* direct+name, arity 2 */
PROVIDE(ov_open_colony = func_00BEDE_op_sz_93);   /* exe:resident+name, arity 3 */
PROVIDE(ov_play_audience_anim = func_0050BC_op_sz_51);   /* exe:resident+name, arity 1 */
PROVIDE(ov_power_flag = func_00BC10_ff_owned);   /* direct+name, arity 2 */
PROVIDE(ov_report_blit = func_00E702_logic_sz_21);   /* direct+name, arity 3 */
PROVIDE(ov_resource_at_4B0 = func_0060A0_logic_sz_128);   /* direct+name, arity 2 */
PROVIDE(ov_set_font = func_076C70_read_record_field);   /* exe:overlay+name, arity 0 */
PROVIDE(ov_unit_select = func_0069EE_logic_sz_33);   /* exe:resident+name, arity 1 */
PROVIDE(overlay_call_024C_0040 = func_004900_logic_sz_15);   /* direct, arity 2 */
PROVIDE(overlay_call_0262_00DA = func_004AFA_op_sz_28);   /* direct, arity 0 */
PROVIDE(overlay_call_029F_00F6 = func_004EE6_op_sz_297);   /* direct, arity 0 */
PROVIDE(overlay_call_029F_0318 = func_005108_op_sz_51);   /* direct, arity 1 */
PROVIDE(overlay_call_02FD_006C = func_00543C_op_sz_131);   /* direct, arity 1 */
PROVIDE(overlay_call_037F_000A = func_005BFA_logic_sz_49);   /* direct, arity 2 */
PROVIDE(overlay_call_037F_003C = func_005C2C_logic_sz_132);   /* direct, arity 3 */
PROVIDE(overlay_call_037F_010E = func_005CFE_map_tile_read_layer_15C);   /* direct, arity 2 */
PROVIDE(overlay_call_037F_0142 = func_005D32_map_tile_read_layer_160);   /* direct, arity 2 */
PROVIDE(overlay_call_037F_01CA = func_005DBA_logic_sz_17);   /* direct, arity 2 */
PROVIDE(overlay_call_037F_0200 = func_005DF0_logic_sz_40);   /* direct, arity 2 */
PROVIDE(overlay_call_037F_02A0 = func_005E90_op_sz_64);   /* direct, arity 2 */
PROVIDE(overlay_call_037F_02F8 = func_005EE8_logic_sz_28);   /* direct, arity 2 */
PROVIDE(overlay_call_037F_0314 = func_005F04_map_xy_bounds_or_neg1);   /* direct, arity 2 */
PROVIDE(overlay_call_037F_0358 = func_005F48_logic_sz_58);   /* direct, arity 2 */
PROVIDE(overlay_call_037F_03E4 = func_005FD4_map_xy_bounds_or_neg1_alt);   /* direct, arity 2 */
PROVIDE(overlay_call_037F_04B0 = func_0060A0_logic_sz_128);   /* direct, arity 2 */
PROVIDE(overlay_call_037F_0598 = func_006188_op_sz_91);   /* direct, arity 2 */
PROVIDE(overlay_call_03E4_003A = func_00627A_op_sz_57);   /* direct, arity 2 */
PROVIDE(overlay_call_03E4_0074 = func_0062B4_op_sz_39);   /* direct, arity 2 */
PROVIDE(overlay_call_0427_06B4 = func_006D24_op_sz_197);   /* direct, arity 4 */
PROVIDE(overlay_call_0427_0824 = func_006E94_logic_sz_198);   /* direct, arity 1 */
PROVIDE(overlay_call_0427_155E = func_007BCE_logic_sz_25);   /* direct, arity 1 */
PROVIDE(overlay_call_057E_004A = func_007C2A_logic_sz_46);   /* direct, arity 2 */
PROVIDE(overlay_call_05B3_0004 = func_007F34_logic_sz_27);   /* direct, arity 2 */
PROVIDE(overlay_call_05B3_01E0 = func_008110_logic_sz_14);   /* direct, arity 1 */
PROVIDE(overlay_call_05B3_024E = func_00817E_logic_sz_14);   /* direct, arity 1 */
PROVIDE(overlay_call_05DC_006A = func_00822A_logic_sz_36);   /* direct, arity 1 */
PROVIDE(overlay_call_0984_04F6 = func_00C136_screen_refresh);   /* json, arity 0 */
PROVIDE(overlay_call_09EF_001A = func_00C30A_rtl_sz_17);   /* direct, arity 1 */
PROVIDE(overlay_call_0A58_05BE = func_00CF3E_logic_sz_134);   /* direct, arity 0 */
PROVIDE(overlay_call_0AE7_0002 = func_00D272_logic_sz_13);   /* direct, arity 0 */
PROVIDE(overlay_call_0AE7_0016 = func_00D286_logic_sz_15);   /* direct, arity 0 */
PROVIDE(overlay_call_0B01_000E = func_00D41E_logic_sz_29);   /* direct, arity 0 */
PROVIDE(overlay_call_0C0C_0006 = func_00E4C6_read_far_dword_via_267A);   /* json, arity 0 */
PROVIDE(overlay_call_0C11_000C = func_00E51C_logic_sz_24);   /* direct, arity 0 */
PROVIDE(overlay_call_0C28_000A = func_00E68A_set_global_269E_byte_pair);   /* direct, arity 0 */
PROVIDE(overlay_call_0C36_000A = func_00E76A_logic_sz_505);   /* direct, arity 0 */
PROVIDE(overlay_call_0C56_0004 = func_00E964_logic_sz_717);   /* direct, arity 0 */
PROVIDE(overlay_call_0CD8_0004 = func_00F184_logic_sz_517);   /* direct, arity 0 */
PROVIDE(overlay_call_0D1D_0712 = func_00FCE2_logic_sz_14);   /* direct, arity 0 */
PROVIDE(overlay_call_0D1D_0916 = func_00FEE6_logic_sz_10);   /* direct, arity 0 */
PROVIDE(overlay_call_0D1D_0942 = func_00FF12_rtl_sz_87);   /* direct, arity 1 */
PROVIDE(overlay_call_0D1D_0E63 = func_010433_dos_find);   /* direct, arity 0 */
PROVIDE(overlay_call_0D1D_0E9D = func_01046D_logic_sz_5);   /* direct, arity 0 */
PROVIDE(overlay_call_181F_00A6 = func_00273E_logic_sz_10);   /* exe:resident, arity 4 */
PROVIDE(overlay_call_181F_00EC = func_004AFA_op_sz_28);   /* exe:resident, arity 0 */
PROVIDE(overlay_call_181F_00F6 = func_00D272_logic_sz_13);   /* exe:resident, arity 0 */
PROVIDE(overlay_call_181F_01F0 = func_00E68A_set_global_269E_byte_pair);   /* exe:resident, arity 0 */
PROVIDE(overlay_call_181F_01FA = func_00E51C_logic_sz_24);   /* exe:resident, arity 0 */
PROVIDE(overlay_call_181F_0254 = func_00E76A_logic_sz_505);   /* exe:resident, arity 0 */
PROVIDE(overlay_call_181F_02F8 = func_00E964_logic_sz_717);   /* exe:resident, arity 0 */
PROVIDE(overlay_call_181F_0370 = func_004900_logic_sz_15);   /* exe:resident, arity 2 */
PROVIDE(overlay_call_181F_03AC = func_004D1E_op_sz_217);   /* exe:resident, arity 0 */
PROVIDE(overlay_call_181F_03C0 = func_004A80_logic_sz_26);   /* exe:resident, arity 0 */
PROVIDE(overlay_call_181F_03E0 = func_00D286_logic_sz_15);   /* exe:resident, arity 0 */
PROVIDE(overlay_call_181F_03EA = func_005160_op_sz_45);   /* exe:resident, arity 1 */
PROVIDE(overlay_call_181F_0444 = func_00DCF6_logic_sz_11);   /* exe:resident, arity 0 */
PROVIDE(overlay_call_181F_0466 = func_00D106_op_sz_158);   /* exe:resident, arity 0 */
PROVIDE(overlay_call_181F_0470 = func_004EE6_op_sz_297);   /* exe:resident, arity 0 */
PROVIDE(overlay_call_181F_047A = func_00D0E0_input_window_reset);   /* exe:resident, arity 0 */
PROVIDE(overlay_call_181F_048E = func_0050BC_op_sz_51);   /* exe:resident, arity 1 */
PROVIDE(overlay_call_181F_0498 = func_0050F0_logic_sz_11);   /* exe:resident, arity 1 */
PROVIDE(overlay_call_181F_04A2 = func_0050FC_logic_sz_11);   /* exe:resident, arity 1 */
PROVIDE(overlay_call_181F_04B6 = func_00513C_logic_sz_26);   /* exe:resident, arity 1 */
PROVIDE(overlay_call_181F_04FC = func_0051D2_logic_sz_62);   /* exe:resident, arity 9 */
PROVIDE(overlay_call_181F_0546 = func_005760_op_sz_127);   /* exe:resident, arity 0 */
PROVIDE(overlay_call_181F_0550 = func_056B08_compute_power_scores);   /* exe:overlay, arity 0 */
PROVIDE(overlay_call_181F_056A = func_00C136_screen_refresh);   /* exe:resident, arity 0 */
PROVIDE(overlay_call_181F_0574 = func_03B2F8_rtl_sz_113);   /* exe:overlay, arity 0 */
PROVIDE(overlay_call_181F_05EC = func_075F98_region_save_restore_768);   /* json, arity 0 */
PROVIDE(overlay_call_181F_05FA = func_035B06_sec_sz_118);   /* exe:overlay, arity 2 */
PROVIDE(overlay_call_181F_061E = king_war_turn);   /* exe:overlay, arity 0 */
PROVIDE(overlay_call_181F_0644 = king_process_power_events);   /* exe:overlay, arity 0 */
PROVIDE(overlay_call_181F_06A0 = func_005D84_logic_sz_23);   /* exe:resident, arity 2 */
PROVIDE(overlay_call_181F_06F0 = func_005F82_logic_sz_31);   /* exe:resident, arity 2 */
PROVIDE(overlay_call_181F_0736 = func_005ED0_logic_sz_23);   /* exe:resident, arity 2 */
PROVIDE(overlay_call_181F_07A0 = func_006608_logic_sz_106);   /* exe:resident, arity 1 */
PROVIDE(overlay_call_181F_07F4 = func_007A80_op_sz_143);   /* exe:resident, arity 1 */
PROVIDE(overlay_call_181F_0844 = func_00693A_logic_sz_14);   /* exe:resident, arity 3 */
PROVIDE(overlay_call_181F_084E = func_007356_logic_sz_56);   /* exe:resident, arity 1 */
PROVIDE(overlay_call_181F_0862 = func_0075E4_logic_sz_26);   /* exe:resident, arity 2 */
PROVIDE(overlay_call_181F_0876 = func_0075FE_logic_sz_17);   /* exe:resident, arity 1 */
PROVIDE(overlay_call_181F_089E = func_0069EE_logic_sz_33);   /* exe:resident, arity 1 */
PROVIDE(overlay_call_181F_097A = func_007A20_logic_sz_96);   /* exe:resident, arity 1 */
PROVIDE(overlay_call_181F_09D2 = func_007BE8_op_sz_66);   /* exe:resident, arity 0 */
PROVIDE(overlay_call_181F_0A56 = func_00822A_logic_sz_36);   /* exe:resident, arity 1 */
PROVIDE(overlay_call_181F_0AA6 = func_00994C_logic_sz_40);   /* exe:resident, arity 1 */
PROVIDE(overlay_call_181F_0AE2 = func_00BB6A_logic_sz_45);   /* exe:resident, arity 0 */
PROVIDE(overlay_call_181F_0B00 = func_008D9C_lookup_table_2F4_signed);   /* exe:resident, arity 1 */
PROVIDE(overlay_call_181F_0B14 = func_008686_logic_sz_34);   /* exe:resident, arity 2 */
PROVIDE(overlay_call_181F_0B5A = func_00887C_logic_sz_21);   /* exe:resident, arity 1 */
PROVIDE(overlay_call_181F_0B78 = func_008BB2_logic_sz_20);   /* exe:resident, arity 1 */
PROVIDE(overlay_call_181F_0B82 = func_009626);   /* exe:resident, arity 1 */
PROVIDE(overlay_call_181F_0BBE = ff_acquire_dispatch);   /* exe:resident, arity 2 */
PROVIDE(overlay_call_181F_0BDC = func_0086E4_logic_sz_34);   /* exe:resident, arity 1 */
PROVIDE(overlay_call_181F_0C40 = func_0084F2_logic_sz_21);   /* exe:resident, arity 1 */
PROVIDE(overlay_call_181F_0C5E = func_008720);   /* exe:resident, arity 0 */
PROVIDE(overlay_call_181F_0C72 = func_00A994_colony_sz_293);   /* exe:resident, arity 0 */
PROVIDE(overlay_call_181F_0C86 = func_008524_colony_sz_18);   /* exe:resident, arity 0 */
PROVIDE(overlay_call_181F_0CAE = func_00913C_logic_sz_72);   /* exe:resident, arity 2 */
PROVIDE(overlay_call_181F_0D3A = func_008D00_colony_stock_cap);   /* exe:resident, arity 0 */
PROVIDE(overlay_call_181F_0D44 = func_008982_logic_sz_532);   /* exe:resident, arity 3 */
PROVIDE(overlay_call_181F_0D62 = func_009726_logic_sz_52);   /* exe:resident, arity 0 */
PROVIDE(overlay_call_181F_0DC2 = func_00C07A_logic_sz_32);   /* exe:resident, arity 3 */
PROVIDE(overlay_call_181F_0DCC = func_00BD4A_op_sz_404);   /* exe:resident, arity 0 */
PROVIDE(overlay_call_181F_0DD6 = func_00C09A_logic_sz_19);   /* exe:resident, arity 1 */
PROVIDE(overlay_call_181F_0DEA = func_00C0D0_logic_sz_57);   /* exe:resident, arity 1 */
PROVIDE(overlay_call_181F_0E1C = func_067700_compose_active_tile);   /* exe:overlay, arity 1 */
PROVIDE(overlay_call_181F_0E90 = func_00C498_op_sz_11);   /* exe:resident, arity 0 */
PROVIDE(overlay_call_181F_0EA4 = func_00C646_rtl_sz_74);   /* exe:resident, arity 1 */
PROVIDE(overlay_call_191F_018E = func_06787C_render_frame_setup);   /* exe:overlay, arity 0 */
PROVIDE(overlay_call_191F_0254 = func_02EE34_logic_sz_12);   /* exe:overlay, arity 1 */
PROVIDE(overlay_call_191F_0288 = func_066F68_draw_route_path);   /* exe:overlay, arity 0 */
PROVIDE(overlay_call_191F_02A4 = func_068898_draw_minimap_or_cursor_box);   /* exe:overlay, arity 0 */
PROVIDE(overlay_call_191F_03B8 = func_039888_op_sz_28);   /* exe:overlay, arity 0 */
PROVIDE(overlay_call_191F_0934 = func_0694AE_cargo_select_dialog);   /* exe:overlay, arity 1 */
PROVIDE(overlay_call_191F_0A74 = func_042138_power_census);   /* exe:overlay, arity 1 */
PROVIDE(overlay_call_191F_0AAC = func_076594_terrain_layer_load3);   /* exe:overlay, arity 0 */
PROVIDE(overlay_call_191F_0B6C = func_036574_newgame_player_setup);   /* exe:overlay, arity 0 */
PROVIDE(overlay_call_191F_0CBC = market_price_drift);   /* exe:overlay, arity 2 */
PROVIDE(overlay_call_191F_0F8E = func_03ADA6_rtl_sz_1362);   /* exe:overlay, arity 1 */
PROVIDE(overlay_call_191F_0FC4 = func_0787A2_calloc_near);   /* json, arity 0 */
PROVIDE(overlay_call_191F_0FD0 = func_076524_view_scroll_step);   /* exe:overlay, arity 0 */
PROVIDE(overlay_call_191F_0FDE = func_0764D0_gamewindow_view_init);   /* exe:overlay, arity 0 */
PROVIDE(overlay_call_1A1F_0192 = func_059B90_europe_dispatch);   /* exe:overlay, arity 0 */
PROVIDE(overlay_call_1A1F_022A = func_060382_tile_terrain_nibble);   /* exe:overlay, arity 1 */
PROVIDE(overlay_call_1A1F_0238 = func_041E7E_next_ship);   /* exe:overlay, arity 0 */
PROVIDE(overlay_call_1A1F_0372 = func_076642_load_game_record);   /* exe:overlay, arity 0 */
PROVIDE(overlay_call_1A1F_0380 = func_00D2AC_logic_sz_57);   /* exe:resident, arity 0 */
PROVIDE(overlay_call_1A1F_038A = func_078242_palette_dim);   /* json, arity 0 */
PROVIDE(overlay_call_1A1F_088A = func_0787DC_calloc_far);   /* json, arity 0 */
PROVIDE(overlay_call_1A1F_0976 = clear_object_layer);   /* exe:overlay, arity 0 */
PROVIDE(overlay_call_1A1F_0A86 = func_076C70_read_record_field);   /* exe:overlay, arity 0 */
PROVIDE(overlay_call_1A1F_0B2E = func_07881E_free_block);   /* json, arity 0 */
PROVIDE(overlay_call_1A1F_0B3A = func_00E46C_op_sz_48);   /* exe:resident, arity 0 */
PROVIDE(overlay_call_1A1F_0B58 = func_07092E_draw_nation_screen);   /* exe:overlay, arity 0 */
PROVIDE(overlay_call_1A1F_0B66 = func_070580_difficulty_pick_dispatch);   /* exe:overlay, arity 0 */
PROVIDE(overlay_call_1A1F_0B74 = func_070A1A_nation_pick_dispatch);   /* exe:overlay, arity 0 */
PROVIDE(overlay_call_1A1F_0BBA = func_06FF94_report_screen_frame);   /* exe:overlay, arity 0 */
PROVIDE(overlay_call_1A1F_0BE4 = func_070060_report_screen_run);   /* exe:overlay, arity 0 */
PROVIDE(overlay_call_1A1F_0BF2 = func_070494_draw_difficulty_screen);   /* exe:overlay, arity 0 */
PROVIDE(overlay_call_1A1F_0C2A = func_070DE8_load_config_col);   /* exe:overlay, arity 0 */
PROVIDE(overlay_call_1A1F_0C38 = func_075FB6_map_scenario_setup);   /* json, arity 0 */
PROVIDE(overlay_call_1A1F_0C50 = func_0129FC_logic_sz_57);   /* exe:resident, arity 0 */
PROVIDE(overlay_call_1A1F_0C80 = func_0713D4_load_default_map);   /* exe:overlay, arity 0 */
PROVIDE(overlay_call_1A1F_0C8E = func_071106_load_mp_map);   /* exe:overlay, arity 0 */
PROVIDE(overlay_call_1A1F_0CB4 = func_00D41E_logic_sz_29);   /* exe:resident, arity 0 */
PROVIDE(overlay_call_1A1F_0CF6 = func_0734F8_scenario_dispatch);   /* json, arity 0 */
PROVIDE(overlay_call_1A1F_0E10 = func_0764F2_view_origin_alloc);   /* exe:overlay, arity 0 */
PROVIDE(ovl_shipcombat_fx = func_067644_compose_tile_overlays);   /* exe:overlay+name, arity 5 */
PROVIDE(ovly_181F_0182 = func_0029DE_rtl_sz_39);   /* exe:resident, arity 3 */
PROVIDE(ovly_181F_035C = func_0048CC_logic_sz_13);   /* exe:resident, arity 3 */
PROVIDE(ovly_181F_048E = func_0050BC_op_sz_51);   /* exe:resident, arity 1 */
PROVIDE(ovly_181F_04D4 = func_00C322_rtl_sz_63);   /* exe:resident, arity 2 */
PROVIDE(ovly_181F_0590 = func_00BCEA_op_sz_61);   /* exe:resident, arity 1 */
PROVIDE(ovly_181F_05FA = func_035B06_sec_sz_118);   /* exe:overlay, arity 2 */
PROVIDE(ovly_set_subject_A42 = func_0081C6_logic_sz_44);   /* exe:resident+name, arity 1 */
PROVIDE(ovly_text_appd8_0D8 = func_002A98_rtl_sz_46);   /* exe:resident+name, arity 4 */
PROVIDE(ovly_text_drawcol_132 = func_002AFE_op_sz_58);   /* exe:resident+name, arity 4 */
PROVIDE(ovly_tile_owner_6DC = func_005DF0_logic_sz_40);   /* exe:resident+name, arity 2 */
PROVIDE(ovly_unit_fortify_858 = func_0075D4_logic_sz_16);   /* exe:resident+name, arity 1 */
PROVIDE(ovly_unit_maxmoves_90C = func_006CCA_logic_sz_13);   /* exe:resident+name, arity 1 */
PROVIDE(ovly_unit_query_B78 = func_008BB2_logic_sz_20);   /* exe:resident+name, arity 1 */
PROVIDE(power_set_a06 = func_007F96_op_sz_105);   /* exe:resident+name, arity 3 */
PROVIDE(power_set_a10 = func_008000_op_sz_115);   /* exe:resident+name, arity 3 */
PROVIDE(rpt_select_player = func_030550_power_select);   /* exe:overlay+name, arity 1 */
PROVIDE(str_clear = func_002912_append_pct);   /* exe:resident+name, arity 1 */
PROVIDE(str_end = func_002932_append_rparen);   /* exe:resident+name, arity 1 */
PROVIDE(str_finish = func_002922_append_lparen);   /* exe:resident+name, arity 1 */
PROVIDE(str_pad = func_0028E2_append_comma);   /* exe:resident+name, arity 1 */
PROVIDE(tile_base2 = func_00627A_op_sz_57);   /* exe:resident+name, arity 2 */
PROVIDE(tile_feature_bits = func_005CFE_map_tile_read_layer_15C);   /* exe:resident+name, arity 2 */
PROVIDE(tile_flow_probe = func_0060A0_logic_sz_128);   /* exe:resident+name, arity 2 */
PROVIDE(tile_in_bounds = func_005BFA_logic_sz_49);   /* exe:resident+name, arity 2 */
PROVIDE(tile_owner = func_005DBA_logic_sz_17);   /* exe:resident+name, arity 2 */
PROVIDE(tile_set_feature = func_005D4E_logic_sz_40);   /* exe:resident+name, arity 4 */
PROVIDE(ui_commit_message = func_03B2F8_rtl_sz_113);   /* exe:overlay+name, arity 0 */
PROVIDE(ui_redraw_power = func_042138_power_census);   /* exe:overlay+name, arity 1 */
PROVIDE(unit_select = func_006608_logic_sz_106);   /* exe:resident+name, arity 1 */
