/* AUTO-GENERATED by tools/linkgap.py -- do not edit.
 * Byte-exact aliases: each DGROUP global lives at its real
 * offset inside g_dgroup[], so reads/writes hit the same byte
 * the original game did.  Supply as an extra linker INPUT file
 * (not -T) so it augments, not replaces, the default script.
 */
PROVIDE(g_compass_dx8_00B4 = g_dgroup + 0xB4);
PROVIDE(g_compass_dy8_00BE = g_dgroup + 0xBE);
PROVIDE(g_opt_104 = g_dgroup + 0x104);
PROVIDE(g_some_flag_0104 = g_dgroup + 0x104);
PROVIDE(g_found_flag_014C = g_dgroup + 0x14C);
PROVIDE(g_found_value_014E = g_dgroup + 0x14E);
PROVIDE(g_map_id_152 = g_dgroup + 0x152);
PROVIDE(g_result_158 = g_dgroup + 0x158);
PROVIDE(g_map_buf_alloc_15A = g_dgroup + 0x15A);
PROVIDE(g_map_layer0_15C = g_dgroup + 0x15C);
PROVIDE(g_map_layer_15c = g_dgroup + 0x15C);
PROVIDE(g_map_layer0_15E = g_dgroup + 0x15E);
PROVIDE(g_map_layer1_160 = g_dgroup + 0x160);
PROVIDE(g_map_layer1_162 = g_dgroup + 0x162);
PROVIDE(g_map_layer2_164 = g_dgroup + 0x164);
PROVIDE(g_map_layer2_166 = g_dgroup + 0x166);
PROVIDE(g_map_layer3_168 = g_dgroup + 0x168);
PROVIDE(g_map_layer3_16A = g_dgroup + 0x16A);
PROVIDE(g_map_size_lo_180 = g_dgroup + 0x180);
PROVIDE(g_map_size_hi_182 = g_dgroup + 0x182);
PROVIDE(g_cli_default_map_18C = g_dgroup + 0x18C);
PROVIDE(g_byte_2A2 = g_dgroup + 0x2A2);
PROVIDE(g_byte_2F4 = g_dgroup + 0x2F4);
PROVIDE(g_submode_032E = g_dgroup + 0x32E);
PROVIDE(g_byte_0337 = g_dgroup + 0x337);
PROVIDE(g_player_0337 = g_dgroup + 0x337);
PROVIDE(g_color_033A = g_dgroup + 0x33A);
PROVIDE(g_count_033C = g_dgroup + 0x33C);
PROVIDE(g_sel_unit_033E = g_dgroup + 0x33E);
PROVIDE(g_redraw_0346 = g_dgroup + 0x346);
PROVIDE(g_tutorial_flag_348 = g_dgroup + 0x348);
PROVIDE(g_dword_034A = g_dgroup + 0x34A);
PROVIDE(g_flag_034C = g_dgroup + 0x34C);
PROVIDE(g_tutorial_flag_35C = g_dgroup + 0x35C);
PROVIDE(g_result_flag_035E = g_dgroup + 0x35E);
PROVIDE(g_opt_36C = g_dgroup + 0x36C);
PROVIDE(g_cursor_372 = g_dgroup + 0x372);
PROVIDE(g_word_372 = g_dgroup + 0x372);
PROVIDE(g_flag_7E4 = g_dgroup + 0x7E4);
PROVIDE(g_popup_07E4 = g_dgroup + 0x7E4);
PROVIDE(g_flag_7E8 = g_dgroup + 0x7E8);
PROVIDE(g_cursor_y_07EA = g_dgroup + 0x7EA);
PROVIDE(g_flag_7EA = g_dgroup + 0x7EA);
PROVIDE(g_flag_07EC = g_dgroup + 0x7EC);
PROVIDE(g_flag_7EC = g_dgroup + 0x7EC);
PROVIDE(g_word_7EC = g_dgroup + 0x7EC);
PROVIDE(g_flag_07EE = g_dgroup + 0x7EE);
PROVIDE(g_flag_7EE = g_dgroup + 0x7EE);
PROVIDE(g_flag_07F0 = g_dgroup + 0x7F0);
PROVIDE(g_input_flag_07F0 = g_dgroup + 0x7F0);
PROVIDE(g_flag_7F4 = g_dgroup + 0x7F4);
PROVIDE(g_in_combat_7F4 = g_dgroup + 0x7F4);
PROVIDE(g_int_mode_07F4 = g_dgroup + 0x7F4);
PROVIDE(g_flag_07F6 = g_dgroup + 0x7F6);
PROVIDE(g_flag_7F6 = g_dgroup + 0x7F6);
PROVIDE(g_input_flag_07F6 = g_dgroup + 0x7F6);
PROVIDE(g_word_7F6 = g_dgroup + 0x7F6);
PROVIDE(g_init_81C = g_dgroup + 0x81C);
PROVIDE(g_opt_81E = g_dgroup + 0x81E);
PROVIDE(g_err_822 = g_dgroup + 0x822);
PROVIDE(g_opt_dev_826 = g_dgroup + 0x826);
PROVIDE(g_b_0828 = g_dgroup + 0x828);
PROVIDE(g_flag_828 = g_dgroup + 0x828);
PROVIDE(g_intro_played_828 = g_dgroup + 0x828);
PROVIDE(g_opt_cheat_828 = g_dgroup + 0x828);
PROVIDE(g_quickstart_828 = g_dgroup + 0x828);
PROVIDE(g_opt_82A = g_dgroup + 0x82A);
PROVIDE(g_flag_82B = g_dgroup + 0x82B);
PROVIDE(g_opt_82B = g_dgroup + 0x82B);
PROVIDE(g_colors_830 = g_dgroup + 0x830);
PROVIDE(g_layout_col_836 = g_dgroup + 0x836);
PROVIDE(g_word_83E = g_dgroup + 0x83E);
PROVIDE(g_word_840 = g_dgroup + 0x840);
PROVIDE(g_class_table_0848 = g_dgroup + 0x848);
PROVIDE(g_pwr_substate_0848 = g_dgroup + 0x848);
PROVIDE(g_class_tbl_0864 = g_dgroup + 0x864);
PROVIDE(g_flag_890 = g_dgroup + 0x890);
PROVIDE(g_flags_894 = g_dgroup + 0x894);
PROVIDE(g_cursor_x_089E = g_dgroup + 0x89E);
PROVIDE(g_font_ptr_89E = g_dgroup + 0x89E);
PROVIDE(g_word_89E = g_dgroup + 0x89E);
PROVIDE(g_cursor_y_08A0 = g_dgroup + 0x8A0);
PROVIDE(g_word_8A0 = g_dgroup + 0x8A0);
PROVIDE(g_byte_B98 = g_dgroup + 0xB98);
PROVIDE(g_word_0B98 = g_dgroup + 0xB98);
PROVIDE(g_b_0B9A = g_dgroup + 0xB9A);
PROVIDE(g_byte_B9A = g_dgroup + 0xB9A);
PROVIDE(g_b_0B9B = g_dgroup + 0xB9B);
PROVIDE(g_byte_B9B = g_dgroup + 0xB9B);
PROVIDE(g_b_0B9C = g_dgroup + 0xB9C);
PROVIDE(g_b_0B9D = g_dgroup + 0xB9D);
PROVIDE(g_byte_B9D = g_dgroup + 0xB9D);
PROVIDE(g_b_0B9E = g_dgroup + 0xB9E);
PROVIDE(g_byte_B9E = g_dgroup + 0xB9E);
PROVIDE(g_b_0B9F = g_dgroup + 0xB9F);
PROVIDE(g_byte_B9F = g_dgroup + 0xB9F);
PROVIDE(g_ai_bitmask_173C = g_dgroup + 0x173C);
PROVIDE(g_ai_bitmask_173E = g_dgroup + 0x173E);
PROVIDE(g_flag_1740 = g_dgroup + 0x1740);
PROVIDE(g_word_1DD6 = g_dgroup + 0x1DD6);
PROVIDE(g_list_vals_1EA6 = g_dgroup + 0x1EA6);
PROVIDE(g_list_attrA_1EAA = g_dgroup + 0x1EAA);
PROVIDE(g_list_attrB_1EAE = g_dgroup + 0x1EAE);
PROVIDE(g_panel_words_1F3C = g_dgroup + 0x1F3C);
PROVIDE(g_font_1F4A = g_dgroup + 0x1F4A);
PROVIDE(g_font_1F50 = g_dgroup + 0x1F50);
PROVIDE(g_font_1F52 = g_dgroup + 0x1F52);
PROVIDE(g_active_mask_1F54 = g_dgroup + 0x1F54);
PROVIDE(g_font_1F56 = g_dgroup + 0x1F56);
PROVIDE(g_panel_color_1F56 = g_dgroup + 0x1F56);
PROVIDE(g_msg_power_1F5C = g_dgroup + 0x1F5C);
PROVIDE(g_panel_anchor_1F5C = g_dgroup + 0x1F5C);
PROVIDE(g_screen_mode_1F5C = g_dgroup + 0x1F5C);
PROVIDE(g_panel_anchor_1F5E = g_dgroup + 0x1F5E);
PROVIDE(g_screen_mode_1F5E = g_dgroup + 0x1F5E);
PROVIDE(g_opt_field_1F60 = g_dgroup + 0x1F60);
PROVIDE(g_panel_anchor_1F60 = g_dgroup + 0x1F60);
PROVIDE(g_font_latch_1F62 = g_dgroup + 0x1F62);
PROVIDE(g_panel_field_1F64 = g_dgroup + 0x1F64);
PROVIDE(g_word_1F64 = g_dgroup + 0x1F64);
PROVIDE(g_dlg_active_1F66 = g_dgroup + 0x1F66);
PROVIDE(g_panel_flag_1F66 = g_dgroup + 0x1F66);
PROVIDE(g_panel_flag_1F68 = g_dgroup + 0x1F68);
PROVIDE(g_panel_flag_1F6A = g_dgroup + 0x1F6A);
PROVIDE(g_panel_field_1F6C = g_dgroup + 0x1F6C);
PROVIDE(g_panel_h_1F6E = g_dgroup + 0x1F6E);
PROVIDE(g_panel_flag_1F70 = g_dgroup + 0x1F70);
PROVIDE(g_panel_flag_1F8A = g_dgroup + 0x1F8A);
PROVIDE(g_ctx_1F9E = g_dgroup + 0x1F9E);
PROVIDE(g_textctx_1F9E = g_dgroup + 0x1F9E);
PROVIDE(g_ctx_1FA0 = g_dgroup + 0x1FA0);
PROVIDE(g_textctx_1FA0 = g_dgroup + 0x1FA0);
PROVIDE(g_ctx_1FA2 = g_dgroup + 0x1FA2);
PROVIDE(g_flag_2008 = g_dgroup + 0x2008);
PROVIDE(g_handle_2014 = g_dgroup + 0x2014);
PROVIDE(g_opt_201E = g_dgroup + 0x201E);
PROVIDE(g_dbg_threshold_2476 = g_dgroup + 0x2476);
PROVIDE(g_dbg_logopen_25F0 = g_dgroup + 0x25F0);
PROVIDE(g_opt_2606 = g_dgroup + 0x2606);
PROVIDE(g_opt_mode_2608 = g_dgroup + 0x2608);
PROVIDE(g_word_268A = g_dgroup + 0x268A);
PROVIDE(g_word_268C = g_dgroup + 0x268C);
PROVIDE(g_init_26E6 = g_dgroup + 0x26E6);
PROVIDE(g_rand_seed_28EE = g_dgroup + 0x28EE);
PROVIDE(g_default_text_mode_2B01 = g_dgroup + 0x2B01);
PROVIDE(g_iob_dispatch_2B16 = g_dgroup + 0x2B16);
PROVIDE(g_sel_2D12 = g_dgroup + 0x2D12);
PROVIDE(g_output_stream_2D40 = g_dgroup + 0x2D40);
PROVIDE(g_output_count_2D52 = g_dgroup + 0x2D52);
PROVIDE(g_region_2DA8 = g_dgroup + 0x2DA8);
PROVIDE(g_label_tab_2DBA = g_dgroup + 0x2DBA);
PROVIDE(g_label_ptr_2DDC = g_dgroup + 0x2DDC);
PROVIDE(g_label_ptr_2DDE = g_dgroup + 0x2DDE);
PROVIDE(g_label_ptr_2DF8 = g_dgroup + 0x2DF8);
PROVIDE(g_label_ptr_2E60 = g_dgroup + 0x2E60);
PROVIDE(g_rpt_title_2EFA = g_dgroup + 0x2EFA);
PROVIDE(g_rpt_subtitle_2EFC = g_dgroup + 0x2EFC);
PROVIDE(g_terrain_movecost_2F76 = g_dgroup + 0x2F76);
PROVIDE(g_occtype_weight_2F77 = g_dgroup + 0x2F77);
PROVIDE(g_terrcost_2F77 = g_dgroup + 0x2F77);
PROVIDE(g_unit_table_3144 = g_dgroup + 0x3144);
PROVIDE(g_unitrecord_3144 = g_dgroup + 0x3144);
PROVIDE(g_units_3144 = g_dgroup + 0x3144);
PROVIDE(g_unit_table_3146 = g_dgroup + 0x3146);
PROVIDE(g_unit_type_3146 = g_dgroup + 0x3146);
PROVIDE(g_unit_stat_5230 = g_dgroup + 0x5230);
PROVIDE(g_unittype_attr_5230 = g_dgroup + 0x5230);
PROVIDE(g_unittype_name_5230 = g_dgroup + 0x5230);
PROVIDE(g_unit_type_flags_5236 = g_dgroup + 0x5236);
PROVIDE(g_unittype_combatstr_5236 = g_dgroup + 0x5236);
PROVIDE(g_unittype_tbl_5236 = g_dgroup + 0x5236);
PROVIDE(g_unit_type_flags_523D = g_dgroup + 0x523D);
PROVIDE(g_byte_524E = g_dgroup + 0x524E);
PROVIDE(g_b_5376 = g_dgroup + 0x5376);
PROVIDE(g_b_537D = g_dgroup + 0x537D);
PROVIDE(g_ai_turn_flag_5381 = g_dgroup + 0x5381);
PROVIDE(g_flags_5381 = g_dgroup + 0x5381);
PROVIDE(g_b_5382 = g_dgroup + 0x5382);
PROVIDE(g_diplo_guard_5382 = g_dgroup + 0x5382);
PROVIDE(g_econ_flags_5382 = g_dgroup + 0x5382);
PROVIDE(g_flag_5382 = g_dgroup + 0x5382);
PROVIDE(g_flags_5382 = g_dgroup + 0x5382);
PROVIDE(g_game_mode_5382 = g_dgroup + 0x5382);
PROVIDE(g_game_mode_flags_5382 = g_dgroup + 0x5382);
PROVIDE(g_opt_5382 = g_dgroup + 0x5382);
PROVIDE(g_b_5383 = g_dgroup + 0x5383);
PROVIDE(g_cheat_5383 = g_dgroup + 0x5383);
PROVIDE(g_cheat_flag_5383 = g_dgroup + 0x5383);
PROVIDE(g_flag_5383 = g_dgroup + 0x5383);
PROVIDE(g_mode_flag_5383 = g_dgroup + 0x5383);
PROVIDE(g_byte_5384 = g_dgroup + 0x5384);
PROVIDE(g_flag_5384 = g_dgroup + 0x5384);
PROVIDE(g_opt_5384 = g_dgroup + 0x5384);
PROVIDE(g_flag_5385 = g_dgroup + 0x5385);
PROVIDE(g_opt_5385 = g_dgroup + 0x5385);
PROVIDE(g_b_5386 = g_dgroup + 0x5386);
PROVIDE(g_flag_5386 = g_dgroup + 0x5386);
PROVIDE(g_opt_5386 = g_dgroup + 0x5386);
PROVIDE(g_b_5387 = g_dgroup + 0x5387);
PROVIDE(g_mode_flag_5387 = g_dgroup + 0x5387);
PROVIDE(g_year_538A = g_dgroup + 0x538A);
PROVIDE(g_index_538C = g_dgroup + 0x538C);
PROVIDE(g_turn_in_year_538C = g_dgroup + 0x538C);
PROVIDE(g_diplo_phase_538e = g_dgroup + 0x538E);
PROVIDE(g_event_turn_538E = g_dgroup + 0x538E);
PROVIDE(g_turn_538E = g_dgroup + 0x538E);
PROVIDE(g_turn_counter_538E = g_dgroup + 0x538E);
PROVIDE(g_mode_5390 = g_dgroup + 0x5390);
PROVIDE(g_selected_unit_5392 = g_dgroup + 0x5392);
PROVIDE(g_active_power_idx_5394 = g_dgroup + 0x5394);
PROVIDE(g_human_player_index_5394 = g_dgroup + 0x5394);
PROVIDE(g_self_power_5394 = g_dgroup + 0x5394);
PROVIDE(g_subject_power_5394 = g_dgroup + 0x5394);
PROVIDE(g_view_nation_index_5396 = g_dgroup + 0x5396);
PROVIDE(g_active_power_5398 = g_dgroup + 0x5398);
PROVIDE(g_current_nation_index_5398 = g_dgroup + 0x5398);
PROVIDE(g_human_player_5398 = g_dgroup + 0x5398);
PROVIDE(g_nation_5398 = g_dgroup + 0x5398);
PROVIDE(g_power_anger_5398 = g_dgroup + 0x5398);
PROVIDE(g_sel_nation_5398 = g_dgroup + 0x5398);
PROVIDE(g_word_5398 = g_dgroup + 0x5398);
PROVIDE(g_native_count_539A = g_dgroup + 0x539A);
PROVIDE(g_local_player_state_539C = g_dgroup + 0x539C);
PROVIDE(g_unit_count_539C = g_dgroup + 0x539C);
PROVIDE(g_colony_count_539E = g_dgroup + 0x539E);
PROVIDE(g_retire_flag_53A2 = g_dgroup + 0x53A2);
PROVIDE(g_reveal_53A2 = g_dgroup + 0x53A2);
PROVIDE(g_word_53A2 = g_dgroup + 0x53A2);
PROVIDE(g_word_53A4 = g_dgroup + 0x53A4);
PROVIDE(g_byte_53A6 = g_dgroup + 0x53A6);
PROVIDE(g_difficulty_53A6 = g_dgroup + 0x53A6);
PROVIDE(g_flag_53C2 = g_dgroup + 0x53C2);
PROVIDE(g_score_result_53C2 = g_dgroup + 0x53C2);
PROVIDE(g_flag_53C6 = g_dgroup + 0x53C6);
PROVIDE(g_counter_53D0 = g_dgroup + 0x53D0);
PROVIDE(g_sol_value_53D0 = g_dgroup + 0x53D0);
PROVIDE(g_active_power_53D2 = g_dgroup + 0x53D2);
PROVIDE(g_enemy_power_53D2 = g_dgroup + 0x53D2);
PROVIDE(g_intervention_ally_53D2 = g_dgroup + 0x53D2);
PROVIDE(g_rebel_power_53D2 = g_dgroup + 0x53D2);
PROVIDE(g_scripted_target_53D2 = g_dgroup + 0x53D2);
PROVIDE(g_self_marker_53D2 = g_dgroup + 0x53D2);
PROVIDE(g_tory_color_53D2 = g_dgroup + 0x53D2);
PROVIDE(g_word_53D2 = g_dgroup + 0x53D2);
PROVIDE(g_intervene_target_53D4 = g_dgroup + 0x53D4);
PROVIDE(g_word_53D4 = g_dgroup + 0x53D4);
PROVIDE(g_sol_prev10_53D8 = g_dgroup + 0x53D8);
PROVIDE(g_ref_regulars_53DA = g_dgroup + 0x53DA);
PROVIDE(g_ref_cavalry_53DC = g_dgroup + 0x53DC);
PROVIDE(g_ref_manowar_53DE = g_dgroup + 0x53DE);
PROVIDE(g_ref_artillery_53E0 = g_dgroup + 0x53E0);
PROVIDE(g_ai_personality_540E = g_dgroup + 0x540E);
PROVIDE(g_ai_personality_543F = g_dgroup + 0x543F);
PROVIDE(g_perpower_flag_543F = g_dgroup + 0x543F);
PROVIDE(g_player_flag_543F = g_dgroup + 0x543F);
PROVIDE(g_power_active_543F = g_dgroup + 0x543F);
PROVIDE(g_power_is_ai_543F = g_dgroup + 0x543F);
PROVIDE(g_native_settlement_54EC = g_dgroup + 0x54EC);
PROVIDE(g_native_table_54EC = g_dgroup + 0x54EC);
PROVIDE(g_table_54EF = g_dgroup + 0x54EF);
PROVIDE(g_native_alarm_54F6 = g_dgroup + 0x54F6);
PROVIDE(g_raid_counter_54F6 = g_dgroup + 0x54F6);
PROVIDE(g_raid_tension_54F6 = g_dgroup + 0x54F6);
PROVIDE(g_native_value_table_5AD8 = g_dgroup + 0x5AD8);
PROVIDE(native_class_weight_5AD8 = g_dgroup + 0x5AD8);
PROVIDE(g_tribe_relation_5B04 = g_dgroup + 0x5B04);
PROVIDE(g_colony_5D46 = g_dgroup + 0x5D46);
PROVIDE(g_colony_table_5D46 = g_dgroup + 0x5D46);
PROVIDE(g_colony_owners_5D60 = g_dgroup + 0x5D60);
PROVIDE(g_colony_bits_5DCA = g_dgroup + 0x5DCA);
PROVIDE(g_per_nation_6BF0 = g_dgroup + 0x6BF0);
PROVIDE(g_per_nation_6D68 = g_dgroup + 0x6D68);
PROVIDE(g_power_metric_6D68 = g_dgroup + 0x6D68);
PROVIDE(g_power_unit_count_7304 = g_dgroup + 0x7304);
PROVIDE(g_disp_price_7B44 = g_dgroup + 0x7B44);
PROVIDE(g_namelist_buf_833C = g_dgroup + 0x833C);
PROVIDE(g_power_word_838C = g_dgroup + 0x838C);
PROVIDE(g_region_839E = g_dgroup + 0x839E);
PROVIDE(g_active_power_84fc = g_dgroup + 0x84FC);
PROVIDE(g_king_record_84FC = g_dgroup + 0x84FC);
PROVIDE(g_payer_record_84FC = g_dgroup + 0x84FC);
PROVIDE(g_power_cur_84FC = g_dgroup + 0x84FC);
PROVIDE(g_powerrec_84FC = g_dgroup + 0x84FC);
PROVIDE(g_map_w_853A = g_dgroup + 0x853A);
PROVIDE(g_map_h_853C = g_dgroup + 0x853C);
PROVIDE(g_cursor_y_853E = g_dgroup + 0x853E);
PROVIDE(g_cursor_x_8540 = g_dgroup + 0x8540);
PROVIDE(g_active_colony_ptr_8542 = g_dgroup + 0x8542);
PROVIDE(g_colony_8542 = g_dgroup + 0x8542);
PROVIDE(g_colony_base_8542 = g_dgroup + 0x8542);
PROVIDE(g_colony_buf_8542 = g_dgroup + 0x8542);
PROVIDE(g_colony_ctx_8542 = g_dgroup + 0x8542);
PROVIDE(g_colony_ptr_8542 = g_dgroup + 0x8542);
PROVIDE(g_map_dim_w_8550 = g_dgroup + 0x8550);
PROVIDE(g_map_dim_h_8552 = g_dgroup + 0x8552);
PROVIDE(g_map_area_85A4 = g_dgroup + 0x85A4);
PROVIDE(g_map_area_85A6 = g_dgroup + 0x85A6);
PROVIDE(g_ai_word_tbl_85C8 = g_dgroup + 0x85C8);
PROVIDE(g_power_8808 = g_dgroup + 0x8808);
PROVIDE(g_power_block_8808 = g_dgroup + 0x8808);
PROVIDE(g_power_record_8808 = g_dgroup + 0x8808);
PROVIDE(g_powerrecord_8808 = g_dgroup + 0x8808);
PROVIDE(g_power_byte_8809 = g_dgroup + 0x8809);
PROVIDE(g_powerrecord_8809 = g_dgroup + 0x8809);
PROVIDE(g_war_matrix_883C = g_dgroup + 0x883C);
PROVIDE(g_war_matrix_cdown_8848 = g_dgroup + 0x8848);
PROVIDE(g_power_price_8854 = g_dgroup + 0x8854);
PROVIDE(g_market_hist_8864 = g_dgroup + 0x8864);
PROVIDE(g_target_power_8CFA = g_dgroup + 0x8CFA);
PROVIDE(g_terrname_tbl_8CFC = g_dgroup + 0x8CFC);
PROVIDE(g_ai_scratch_8D00 = g_dgroup + 0x8D00);
PROVIDE(g_ai_scratch_8D01 = g_dgroup + 0x8D01);
PROVIDE(g_ai_scratch_8D02 = g_dgroup + 0x8D02);
PROVIDE(g_ai_scratch_8D03 = g_dgroup + 0x8D03);
PROVIDE(g_def_terrain_bonus_8D04 = g_dgroup + 0x8D04);
PROVIDE(g_power_word_8D0A = g_dgroup + 0x8D0A);
PROVIDE(g_bound_record_8D4A = g_dgroup + 0x8D4A);
PROVIDE(g_cur_settlement_8D4A = g_dgroup + 0x8D4A);
PROVIDE(g_tribe_ctx_8D4A = g_dgroup + 0x8D4A);
PROVIDE(g_active_settlement_ptr_8D4E = g_dgroup + 0x8D4E);
PROVIDE(g_active_tribe_8d4e_rec = g_dgroup + 0x8D4E);
PROVIDE(g_cur_settlement_8D4E = g_dgroup + 0x8D4E);
PROVIDE(g_market_8D4E = g_dgroup + 0x8D4E);
PROVIDE(g_market_array_8D4E = g_dgroup + 0x8D4E);
PROVIDE(g_settlement_ptr_8D4E = g_dgroup + 0x8D4E);
PROVIDE(g_tribe_bound_rec_8D4E = g_dgroup + 0x8D4E);
PROVIDE(g_current_power_8D52 = g_dgroup + 0x8D52);
PROVIDE(g_native_cargo_8D52 = g_dgroup + 0x8D52);
PROVIDE(g_trade_tribe_8D52 = g_dgroup + 0x8D52);
PROVIDE(g_tribe_id_8D52 = g_dgroup + 0x8D52);
PROVIDE(g_tribe_index_8D52 = g_dgroup + 0x8D52);
PROVIDE(g_tribe_ptr_8D52 = g_dgroup + 0x8D52);
PROVIDE(g_screen_mode_8D54 = g_dgroup + 0x8D54);
PROVIDE(g_flag_8D56 = g_dgroup + 0x8D56);
PROVIDE(g_flag_8D58 = g_dgroup + 0x8D58);
PROVIDE(g_burial_size_8DB8 = g_dgroup + 0x8DB8);
PROVIDE(g_8DC4 = g_dgroup + 0x8DC4);
PROVIDE(g_trade_qty_8DC4 = g_dgroup + 0x8DC4);
PROVIDE(g_8DC6 = g_dgroup + 0x8DC6);
PROVIDE(g_active_colony_8DC6 = g_dgroup + 0x8DC6);
PROVIDE(g_class_word_8DC8 = g_dgroup + 0x8DC8);
PROVIDE(g_8DD8 = g_dgroup + 0x8DD8);
PROVIDE(g_8DE6 = g_dgroup + 0x8DE6);
PROVIDE(g_8DE8 = g_dgroup + 0x8DE8);
PROVIDE(g_8DEA = g_dgroup + 0x8DEA);
PROVIDE(g_8DEC = g_dgroup + 0x8DEC);
PROVIDE(g_8E6A = g_dgroup + 0x8E6A);
PROVIDE(g_state_word_8EA2 = g_dgroup + 0x8EA2);
PROVIDE(g_terrain_ui_8F82 = g_dgroup + 0x8F82);
PROVIDE(g_tbl_8F85 = g_dgroup + 0x8F85);
PROVIDE(g_band_rec_8F89 = g_dgroup + 0x8F89);
PROVIDE(g_trade_supply_b_9184 = g_dgroup + 0x9184);
PROVIDE(g_trade_supply_91CC = g_dgroup + 0x91CC);
PROVIDE(g_ai_pwr_tbl_9298 = g_dgroup + 0x9298);
PROVIDE(g_player_flag_9298 = g_dgroup + 0x9298);
PROVIDE(g_label_ptr_93A0 = g_dgroup + 0x93A0);
PROVIDE(g_label_ptr_93B0 = g_dgroup + 0x93B0);
PROVIDE(g_wtab_93B2 = g_dgroup + 0x93B2);
PROVIDE(g_ai_pwr_v0_9410 = g_dgroup + 0x9410);
PROVIDE(g_power_gate_9410 = g_dgroup + 0x9410);
PROVIDE(g_ai_pwr_scale_9414 = g_dgroup + 0x9414);
PROVIDE(g_trade_accum_941C = g_dgroup + 0x941C);
PROVIDE(g_trade_demand_w_941C = g_dgroup + 0x941C);
PROVIDE(g_diplo_contact_942C = g_dgroup + 0x942C);
PROVIDE(g_ai_pwr_cap_944E = g_dgroup + 0x944E);
PROVIDE(g_ai_pwr_pool_9456 = g_dgroup + 0x9456);
PROVIDE(g_ai_byte_tbl_947E = g_dgroup + 0x947E);
PROVIDE(g_ai_sub_tbl_94E6 = g_dgroup + 0x94E6);
PROVIDE(g_ai_pwr_ratio_9567 = g_dgroup + 0x9567);
PROVIDE(g_trade_demand_95B2 = g_dgroup + 0x95B2);
PROVIDE(g_ai_flagtbl_95F2 = g_dgroup + 0x95F2);
PROVIDE(g_power_scalar_9622 = g_dgroup + 0x9622);
PROVIDE(g_power_scalar_962A = g_dgroup + 0x962A);
PROVIDE(g_tribe_settlement_count_962A = g_dgroup + 0x962A);
PROVIDE(g_label_ptr_96F4 = g_dgroup + 0x96F4);
PROVIDE(g_label_ptr_96F6 = g_dgroup + 0x96F6);
PROVIDE(g_cargo_params_96FC = g_dgroup + 0x96FC);
PROVIDE(g_good_shift_9704 = g_dgroup + 0x9704);
PROVIDE(g_unit_cost_tbl_9790 = g_dgroup + 0x9790);
PROVIDE(g_power_word_97C0 = g_dgroup + 0x97C0);
PROVIDE(g_label_ptr_97DC = g_dgroup + 0x97DC);
PROVIDE(g_label_tbl_97F0 = g_dgroup + 0x97F0);
PROVIDE(g_label_tbl_9800 = g_dgroup + 0x9800);
PROVIDE(g_label_tbl_9804 = g_dgroup + 0x9804);
PROVIDE(g_kbd_scan_981E = g_dgroup + 0x981E);
PROVIDE(g_ai_workplan_9870 = g_dgroup + 0x9870);
PROVIDE(g_ai_queue_a_98B0 = g_dgroup + 0x98B0);
PROVIDE(g_overlay_grid64_98B2 = g_dgroup + 0x98B2);
PROVIDE(g_dialog_slot_9CB0 = g_dgroup + 0x9CB0);
PROVIDE(g_loot_accum_9CB0 = g_dgroup + 0x9CB0);
PROVIDE(g_fmt_field_9CC8 = g_dgroup + 0x9CC8);
PROVIDE(g_active_player_9E12 = g_dgroup + 0x9E12);
PROVIDE(g_word_9E1C = g_dgroup + 0x9E1C);
PROVIDE(g_word_9E20 = g_dgroup + 0x9E20);
PROVIDE(g_phase_9E3A = g_dgroup + 0x9E3A);
PROVIDE(g_panel_extent_9E56 = g_dgroup + 0x9E56);
PROVIDE(g_prod_cap_9E58 = g_dgroup + 0x9E58);
PROVIDE(g_trade_stock_9E58 = g_dgroup + 0x9E58);
PROVIDE(g_prod_yield_9E78 = g_dgroup + 0x9E78);
PROVIDE(g_trade_want_9E78 = g_dgroup + 0x9E78);
PROVIDE(g_prod_scale_9E96 = g_dgroup + 0x9E96);
PROVIDE(g_ai_best_target_9EA8 = g_dgroup + 0x9EA8);
PROVIDE(g_ai_queue_b_9EAA = g_dgroup + 0x9EAA);
PROVIDE(g_overlay_grid16_9EAA = g_dgroup + 0x9EAA);
PROVIDE(g_ai_mapgrid_9FAA = g_dgroup + 0x9FAA);
PROVIDE(g_ai_pwr_gate_A0B8 = g_dgroup + 0xA0B8);
PROVIDE(g_ai_supply_A0CC = g_dgroup + 0xA0CC);
PROVIDE(g_ai_count_A0D4 = g_dgroup + 0xA0D4);
PROVIDE(g_ai_count_A0DA = g_dgroup + 0xA0DA);
PROVIDE(g_ai_count_A0DB = g_dgroup + 0xA0DB);
PROVIDE(g_ai_table_c_A0DC = g_dgroup + 0xA0DC);
PROVIDE(g_byte_A153 = g_dgroup + 0xA153);
PROVIDE(g_dialog_active_A154 = g_dgroup + 0xA154);
PROVIDE(g_ai_scratch_A156 = g_dgroup + 0xA156);
PROVIDE(g_ai_scratch_A158 = g_dgroup + 0xA158);
PROVIDE(g_list_count_A5AA = g_dgroup + 0xA5AA);
PROVIDE(g_list_base_A5AC = g_dgroup + 0xA5AC);
PROVIDE(g_report_count_A5AE = g_dgroup + 0xA5AE);
PROVIDE(g_msg_arg_lo_A5B4 = g_dgroup + 0xA5B4);
PROVIDE(g_msg_arg_hi_A5B6 = g_dgroup + 0xA5B6);
PROVIDE(g_strbuf_A5B8 = g_dgroup + 0xA5B8);
PROVIDE(g_namelist_cur_A608 = g_dgroup + 0xA608);
PROVIDE(g_sel_index_A60A = g_dgroup + 0xA60A);
PROVIDE(g_table_A88A = g_dgroup + 0xA88A);
PROVIDE(g_btn_hit_A88B = g_dgroup + 0xA88B);
PROVIDE(g_drag_active_A88C = g_dgroup + 0xA88C);
PROVIDE(g_drag_id_A88D = g_dgroup + 0xA88D);
PROVIDE(g_drag_qty_A88E = g_dgroup + 0xA88E);
PROVIDE(g_drag_cell_A88F = g_dgroup + 0xA88F);
PROVIDE(g_byte_A890 = g_dgroup + 0xA890);
PROVIDE(g_table_A891 = g_dgroup + 0xA891);
PROVIDE(g_table_A892 = g_dgroup + 0xA892);
PROVIDE(g_table_A893 = g_dgroup + 0xA893);
PROVIDE(g_table_A894 = g_dgroup + 0xA894);
PROVIDE(g_table_A895 = g_dgroup + 0xA895);
PROVIDE(g_report_count_A896 = g_dgroup + 0xA896);
PROVIDE(g_table_A896 = g_dgroup + 0xA896);
PROVIDE(g_human_gate_A897 = g_dgroup + 0xA897);
PROVIDE(g_report_gate_A897 = g_dgroup + 0xA897);
PROVIDE(g_msg_toggle_A898 = g_dgroup + 0xA898);
PROVIDE(g_report_shown_A898 = g_dgroup + 0xA898);
PROVIDE(g_ai_count_A89C = g_dgroup + 0xA89C);
PROVIDE(g_menubar_a89e = g_dgroup + 0xA89E);
PROVIDE(g_menubar_a8a0 = g_dgroup + 0xA8A0);
